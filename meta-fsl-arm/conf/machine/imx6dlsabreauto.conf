## meta-fsl-arm/conf/machine/imx6dlsabreauto.conf
```bitbake
#@TYPE: Machine
#@NAME: Freescale i.MX6DL SABRE Automotive
#@SOC: i.MX6DL
#@DESCRIPTION: Machine configuration for Freescale i.MX6DL SABRE Automotive
#@MAINTAINER: Daiane Angolini <daiane.angolini@freescale.com>

require conf/machine/include/imx6sabreauto-common.inc

SOC_FAMILY = "mx6:mx6dl"

KERNEL_DEVICETREE = "imx6dl-sabreauto.dtb imx6dl-sabreauto-gpmi-weim.dtb imx6dl-sabreauto-ecspi.dtb "
KERNEL_DEVICETREE += "imx6dl-sabreauto-flexcan1.dtb "

UBOOT_CONFIG ??= "sd"
UBOOT_CONFIG[sd] = "mx6dlsabreauto_config,sdcard"
UBOOT_CONFIG[eimnor] = "mx6dlsabreauto_eimnor_config"
UBOOT_CONFIG[nand] = "mx6dlsabreauto_nand_config,ubifs"
UBOOT_CONFIG[spinor] = "mx6dlsabreauto_spinor_config"
UBOOT_CONFIG[mfgtool] = "mx6dlsabreauto_config"
```

## meta-fsl-arm/conf/machine/imx6dlsabresd.conf
```bitbake
#@TYPE: Machine
#@NAME: Freescale i.MX6DL SABRE Smart Device
#@SOC: i.MX6DL
#@DESCRIPTION: Machine configuration for Freescale i.MX6DL SABRE Smart Device
#@MAINTAINER: Otavio Salvador <otavio@ossystems.com.br>

require conf/machine/include/imx6sabresd-common.inc

SOC_FAMILY = "mx6:mx6dl"

KERNEL_DEVICETREE = "imx6dl-sabresd.dtb imx6dl-sabresd-ldo.dtb imx6dl-sabresd-hdcp.dtb"

UBOOT_CONFIG ??= "sd"
UBOOT_CONFIG[sd] = "mx6dlsabresd_config,sdcard"
UBOOT_CONFIG[mfgtool] = "mx6dlsabresd_config"
```

## meta-fsl-arm/conf/machine/imx6qsabreauto.conf
```bitbake
#@TYPE: Machine
#@NAME: Freescale i.MX6Q SABRE Automotive
#@SOC: i.MX6Q
#@DESCRIPTION: Machine configuration for Freescale i.MX6Q SABRE Automotive

require conf/machine/include/imx6sabreauto-common.inc

SOC_FAMILY = "mx6:mx6q"

KERNEL_DEVICETREE = "imx6q-sabreauto.dtb imx6q-sabreauto-gpmi-weim.dtb"

UBOOT_CONFIG ??= "sd"
UBOOT_CONFIG[sd] = "mx6qsabreauto_config,sdcard"
UBOOT_CONFIG[eimnor] = "mx6qsabreauto_eimnor_config"
UBOOT_CONFIG[nand] = "mx6qsabreauto_nand_config,ubifs"
UBOOT_CONFIG[spinor] = "mx6qsabreauto_spinor_config"
```

## meta-fsl-arm/conf/machine/imx6qsabrelite.conf
```bitbake
#@TYPE: Machine
#@NAME: i.MX6Q SABRE Lite
#@DESCRIPTION: Machine configuration for Freescale i.MX6Q SABRE Lite

include conf/machine/include/imx-base.inc
include conf/machine/include/tune-cortexa9.inc

SOC_FAMILY = "mx6q:mx6"

KERNEL_DEVICETREE = "${S}/arch/arm/boot/dts/imx6q-sabrelite.dts"

UBOOT_MACHINE = "mx6qsabrelite_config"

SERIAL_CONSOLE = "115200 ttymxc1"

MACHINE_FEATURES += " pci wifi bluetooth"
```

## meta-fsl-arm/conf/machine/imx6qsabresd.conf
```bitbake
#@TYPE: Machine
#@NAME: Freescale i.MX6Q SABRE Smart Device
#@SOC: i.MX6Q
#@DESCRIPTION: Machine configuration for Freescale i.MX6Q SABRE Smart Device

require conf/machine/include/imx6sabresd-common.inc

SOC_FAMILY = "mx6:mx6q"

KERNEL_DEVICETREE = "imx6q-sabresd.dtb imx6q-sabresd-ldo.dtb imx6q-sabresd-hdcp.dtb"

UBOOT_CONFIG ??= "sd"
UBOOT_CONFIG[sd] = "mx6qsabresd_config,sdcard"
UBOOT_CONFIG[sata] = "mx6qsabresd_sata_config"
```

## meta-fsl-arm/conf/machine/imx6slevk.conf
```bitbake
#@TYPE: Machine
#@NAME: Freescale i.MX6SL Evaluation Kit
#@SOC: i.MX6SL
#@DESCRIPTION: Machine configuration for Freescale i.MX6SL Evaluation Kit
#@MAINTAINER: Otavio Salvador <otavio@ossystems.com.br>

include conf/machine/include/imx-base.inc
include conf/machine/include/tune-cortexa9.inc

SOC_FAMILY = "mx6:mx6sl"

KERNEL_DEVICETREE = "imx6sl-evk.dtb imx6sl-evk-csi.dtb imx6sl-evk-ldo.dtb"

UBOOT_CONFIG ??= "sd"
UBOOT_CONFIG[sd] = "mx6slevk_config,sdcard"
UBOOT_CONFIG[spinor] = "mx6slevk_spinor_config"
UBOOT_CONFIG[mfgtool] = "mx6slevk_config"

SERIAL_CONSOLE = "115200 ttymxc0"

MACHINE_FEATURES += " pci wifi bluetooth"

MACHINE_FIRMWARE += "linux-firmware-ath6k"
```

## meta-fsl-arm/conf/machine/imx6solosabreauto.conf
```bitbake
#@TYPE: Machine
#@NAME: Freescale i.MX6Solo SABRE Automotive
#@SOC: i.MX6S
#@DESCRIPTION: Machine configuration for Freescale i.MX6Solo SABRE Automotive

require conf/machine/include/imx6sabresd-common.inc

SOC_FAMILY = "mx6:mx6dl"

KERNEL_DEVICETREE = "imx6dl-sabreauto.dtb"

PREFERRED_PROVIDER_u-boot = "u-boot-imx"
PREFERRED_PROVIDER_virtual/bootloader = "u-boot-imx"
KERNEL_IMAGETYPE = "uImage"

UBOOT_CONFIG ??= "sd"
UBOOT_CONFIG[sd] = "mx6solosabreauto_config,sdcard"
UBOOT_CONFIG[eimnor] = "mx6solosabreauto_eimnor_config"
UBOOT_CONFIG[nand] = "mx6solosabreauto_nand_config,ubifs"
UBOOT_CONFIG[spinor] = "mx6solosabreauto_spinor_config"
UBOOT_CONFIG[mfgtool] = "mx6solosabreauto_config"
```

## meta-fsl-arm/conf/machine/imx6solosabresd.conf
```bitbake
#@TYPE: Machine
#@NAME: Freescale i.MX6Solo SABRE Smart Device
#@SOC: i.MX6S
#@DESCRIPTION: Machine configuration for Freescale i.MX6Solo SABRE Smart Device
#@MAINTAINER: Otavio Salvador <otavio@ossystems.com.br>

require conf/machine/include/imx6sabresd-common.inc

SOC_FAMILY = "mx6:mx6dl"

KERNEL_DEVICETREE = "imx6dl-sabresd.dtb imx6dl-sabresd-ldo.dtb"

PREFERRED_PROVIDER_u-boot = "u-boot-imx"
PREFERRED_PROVIDER_virtual/bootloader = "u-boot-imx"
KERNEL_IMAGETYPE = "uImage"

UBOOT_CONFIG ??= "sd"
UBOOT_CONFIG[sd] = "mx6solosabresd_config,sdcard"
UBOOT_CONFIG[mfgtool] = "mx6solosabresd_config"
```

## meta-fsl-arm/conf/machine/imx6sxsabreauto.conf
```bitbake
#@TYPE: Machine
#@NAME: Freescale i.MX6SoloX Sabre Automotive
#@SOC: i.MX6SX
#@DESCRIPTION: Machine configuration for Freescale i.MX6SoloX Sabre Automotive
#@MAINTAINER: Lauren Post <Lauren.Post@freescale.com>

require conf/machine/include/imx6sabreauto-common.inc

SOC_FAMILY = "mx6:mx6sx"

KERNEL_DEVICETREE = "imx6sx-sabreauto.dtb imx6sx-sabreauto-m4.dtb"

UBOOT_ENTRYPOINT = "0x80008000"

UBOOT_CONFIG ??= "sd"
UBOOT_CONFIG[sd] = "mx6sxsabreauto_config,sdcard"
UBOOT_CONFIG[qspi1] = "mx6sxsabreauto_qspi1_config"
UBOOT_CONFIG[nand] = "mx6sxsabreauto_nand_config"
UBOOT_CONFIG[mfgtool] = "mx6sxsabreauto_config"
```

## meta-fsl-arm/conf/machine/imx6sxsabresd.conf
```bitbake
#@TYPE: Machine
#@NAME: Freescale i.MX6SoloX SabreSD
#@SOC: i.MX6SX
#@DESCRIPTION: Machine configuration for Freescale i.MX6SoloX Sabre SD
#@MAINTAINER: Lauren Post <Lauren.Post@freescale.com>

require conf/machine/include/imx6sabresd-common.inc

SOC_FAMILY = "mx6:mx6sx"

KERNEL_DEVICETREE = "imx6sx-sdb.dtb imx6sx-sdb-emmc.dtb imx6sx-sdb-m4.dtb \
                     imx6sx-sdb-sai.dtb imx6sx-sdb-lcdif1.dtb \
                     imx6sx-sdb-reva-ldo.dtb imx6sx-sdb-reva.dtb"

UBOOT_ENTRYPOINT = "0x80008000"

UBOOT_CONFIG ??= "sd"
UBOOT_CONFIG[sd] = "mx6sxsabresd_config,sdcard"
UBOOT_CONFIG[emmc] = "mx6sxsabresd_emmc_config,sdcard"
UBOOT_CONFIG[qspi2] = "mx6sxsabresd_qspi2_config"
UBOOT_CONFIG[m4fastup] = "mx6sxsabresd_m4fastup_config"
UBOOT_CONFIG[mfgtool] = "mx6sxsabresd_config"
```

## meta-fsl-arm/conf/machine/include/fsl-default-providers.inc
```bitbake
# Freescale BSP default providers

PREFERRED_PROVIDER_virtual/xserver = "xserver-xorg"
PREFERRED_PROVIDER_virtual/kernel ??= "linux-imx"
PREFERRED_PROVIDER_u-boot ??= "u-boot-fslc"
PREFERRED_PROVIDER_virtual/bootloader ??= "u-boot-fslc"
```

## meta-fsl-arm/conf/machine/include/imx-base.inc
```bitbake
# Provides the i.MX common settings

include conf/machine/include/fsl-default-settings.inc
include conf/machine/include/fsl-default-versions.inc

include conf/machine/include/soc-family.inc

# Set specific make target and binary suffix
PREFERRED_PROVIDER_u-boot ??= "u-boot-fslc"
PREFERRED_PROVIDER_virtual/bootloader ??= "u-boot-fslc"
UBOOT_MAKE_TARGET = "u-boot.imx"
UBOOT_SUFFIX ?= "imx"

UBOOT_ENTRYPOINT_mx3 = "0x80008000"
UBOOT_ENTRYPOINT_mx51  = "0x90008000"
UBOOT_ENTRYPOINT_mx53  = "0x70008000"
UBOOT_ENTRYPOINT_mx6  = "0x10008000"
UBOOT_ENTRYPOINT_mx6sl = "0x80008000"
UBOOT_ENTRYPOINT_mx6sx = "0x80008000"
UBOOT_ENTRYPOINT_vf = "0x80008000"

PREFERRED_PROVIDER_virtual/xserver = "xserver-xorg"
XSERVER_DRIVER = "xf86-video-fbdev"
XSERVER_DRIVER_mx5 = "xf86-video-imxfb"
XSERVER_DRIVER_mx6 = "xf86-video-imxfb-vivante"
XSERVER = "xserver-xorg \
           xf86-input-evdev \
           ${XSERVER_DRIVER}"

PREFERRED_VERSION_directfb_mx6 = "1.7.4"

# Ship kernel modules
MACHINE_EXTRA_RRECOMMENDS = "kernel-modules"

# Tunes for hard/soft float-point selection. Note that we allow building for
# thumb support giving distros the chance to enable thumb by setting
# ARM_INSTRUCTION_SET = "thumb"
#
# handled by software
# DEFAULTTUNE_mx6 ?= "cortexa9t-neon"
# handled by hardware
DEFAULTTUNE_mx6 ?= "cortexa9thf-neon"

# Sub-architecture support
MACHINE_SOCARCH_SUFFIX ?= ""
MACHINE_SOCARCH_SUFFIX_mx3 = "-mx3"
MACHINE_SOCARCH_SUFFIX_mx5 = "-mx5"
MACHINE_SOCARCH_SUFFIX_mx6q = "-mx6qdl"
MACHINE_SOCARCH_SUFFIX_mx6dl = "-mx6qdl"
MACHINE_SOCARCH_SUFFIX_mx6sx = "-mx6sx"
MACHINE_SOCARCH_SUFFIX_mx6sl = "-mx6sl"
MACHINE_SOCARCH_SUFFIX_vf60 = "-vf60"
MACHINE_SOCARCH_SUFFIX_vf50 = "-vf50"

MACHINE_ARCH_FILTER = "virtual/kernel"
MACHINE_SOCARCH_FILTER = "libfslcodec libfslvpuwrap libfslparser"
MACHINE_SOCARCH_FILTER_append_mx5 = " virtual/libgles1 virtual/libgles2 virtual/egl virtual/mesa virtual/libgl"
MACHINE_SOCARCH_FILTER_append_mx6 = " virtual/libopenvg virtual/libgles1 virtual/libgles2 virtual/egl virtual/mesa virtual/libgl virtual/libg2d"

INHERIT += "fsl-dynamic-packagearch"

# Firmware
MACHINE_FIRMWARE ?= ""
MACHINE_FIRMWARE_append_mx6q = " firmware-imx-vpu-imx6q"
MACHINE_FIRMWARE_append_mx6dl = " firmware-imx-vpu-imx6d"
MACHINE_FIRMWARE_append_mx53 = " firmware-imx-vpu-imx53 firmware-imx-sdma-imx53"
MACHINE_FIRMWARE_append_mx51 = " firmware-imx-vpu-imx51 firmware-imx-sdma-imx51"

# FIXME: Needs addition of firmware-imx of official BSPs
#MACHINE_FIRMWARE_append_mx35 = " firmware-imx-sdma-imx35"
#MACHINE_FIRMWARE_append_mx31 = " firmware-imx-sdma-imx31"
#MACHINE_FIRMWARE_append_mx27 = " firmware-imx-vpu-imx27"
#MACHINE_FIRMWARE_append_mx25 = " firmware-imx-sdma-imx25"

MACHINE_EXTRA_RRECOMMENDS += "${MACHINE_FIRMWARE}"

# Extra audio support
# FIXME: Add support for ALL SoC families
MACHINE_EXTRA_RRECOMMENDS_append_mx6 = " ${@base_contains('DISTRO_FEATURES', 'alsa', 'fsl-alsa-plugins', '', d)}"

# Extra udev rules
MACHINE_EXTRA_RRECOMMENDS += "udev-rules-imx"

# GStreamer 1.0 plugins
MACHINE_GSTREAMER_1_0_PLUGIN ?= ""
MACHINE_GSTREAMER_1_0_PLUGIN_mx6q ?= "gstreamer1.0-plugins-imx-meta"
MACHINE_GSTREAMER_1_0_PLUGIN_mx6dl ?= "gstreamer1.0-plugins-imx-meta"

# mx5 GPU libraries
GPU_FLAVOUR = "${@base_contains('DISTRO_FEATURES', 'x11', 'x11-', '', d)}"
PREFERRED_PROVIDER_virtual/egl_mx5 ?= "amd-gpu-${GPU_FLAVOUR}bin-mx51"
PREFERRED_PROVIDER_virtual/libgles1_mx5 ?= "amd-gpu-${GPU_FLAVOUR}bin-mx51"
PREFERRED_PROVIDER_virtual/libgles2_mx5 ?= "amd-gpu-${GPU_FLAVOUR}bin-mx51"
PREFERRED_PROVIDER_amd-gpu-mx51 ?= "amd-gpu-${GPU_FLAVOUR}bin-mx51"

# mx6 GPU libraries
PREFERRED_PROVIDER_virtual/egl_mx6 ?= "imx-gpu-viv"
PREFERRED_PROVIDER_virtual/libgles1_mx6q ?= "imx-gpu-viv"
PREFERRED_PROVIDER_virtual/libgles1_mx6dl ?= "imx-gpu-viv"
PREFERRED_PROVIDER_virtual/libgles1_mx6sx ?= "imx-gpu-viv"
PREFERRED_PROVIDER_virtual/libgles1_mx6sl ?= "mesa"
PREFERRED_PROVIDER_virtual/libgles2_mx6q ?= "imx-gpu-viv"
PREFERRED_PROVIDER_virtual/libgles2_mx6dl ?= "imx-gpu-viv"
PREFERRED_PROVIDER_virtual/libgles2_mx6sx ?= "imx-gpu-viv"
PREFERRED_PROVIDER_virtual/libgles2_mx6sl ?= "mesa"
PREFERRED_PROVIDER_virtual/libgl_mx6q ?= "imx-gpu-viv"
PREFERRED_PROVIDER_virtual/libgl_mx6dl ?= "imx-gpu-viv"
PREFERRED_PROVIDER_virtual/libgl_mx6sx ?= "imx-gpu-viv"
PREFERRED_PROVIDER_virtual/libgl_mx6sl ?= "mesa"
PREFERRED_PROVIDER_virtual/libg2d_mx6 ?= "imx-gpu-viv"

# Handle default kernel
IMX_DEFAULT_KERNEL = "linux-imx"
IMX_DEFAULT_KERNEL_mx3 = "linux-fslc"
IMX_DEFAULT_KERNEL_mx6 = "linux-fslc-mx6"
PREFERRED_PROVIDER_virtual/kernel ??= "${IMX_DEFAULT_KERNEL}"

SDCARD_ROOTFS ?= "${DEPLOY_DIR_IMAGE}/${IMAGE_NAME}.rootfs.ext3"
IMAGE_FSTYPES ?= "tar.bz2 ext3 sdcard"

SERIAL_CONSOLE = "115200 ttymxc0"

KERNEL_IMAGETYPE = "zImage"

MACHINE_FEATURES = "apm usbgadget usbhost vfat alsa touchscreen"
```

## meta-fsl-arm/conf/machine/include/imx53-base.inc
```bitbake
# Provides the i.MX53 common settings

include conf/machine/include/tune-cortexa8.inc

include conf/distro/include/fsl-default-versions.inc
include conf/distro/include/fsl-default-revisions.inc
include conf/distro/include/fsl-default-providers.inc

# Todo:
# 	Check Freescale x11 framebuffer
#	Check jffs2 extra commands

PREFERRED_PROVIDER_virtual/xserver = "xserver-xorg-lite"
PREFERRED_PROVIDER_virtual/xserver-xf86 = "xserver-xorg-lite"
XSERVER = "xserver-xorg-lite \
           xf86-input-evdev \
           xf86-input-keyboard \
           xf86-input-mouse \
           xf86-video-imxfb"

# Ship kernel modules
MACHINE_EXTRA_RRECOMMENDS = "kernel-modules"

# Extra audio support
MACHINE_EXTRA_RRECOMMENDS += "imx-lib imx-audio \
                              pulseaudio \
                              fsl-mm-codeclib \
                              gst-fsl-plugin"

EXTRA_IMAGE_DEPENDS = "u-boot-imx"

IMAGE_FSTYPES ?= "tar.bz2 jffs2"
EXTRA_IMAGECMD_jffs2 = "-lnp "

SERIAL_CONSOLE = "115200 ttymxc0"

KERNEL_IMAGETYPE = "uImage"

UBOOT_ENTRYPOINT = "0x70800000"
UBOOT_LOADADDRESS = "0x70800000"

MACHINE_FEATURES = "kernel26 apm usbgadget usbhost vfat alsa touchscreen"
```

## meta-fsl-arm/conf/machine/include/imx6sabreauto-common.inc
```bitbake
# Provides the i.MX6 SABRE AUTO common settings

require conf/machine/include/imx-base.inc
require conf/machine/include/tune-cortexa9.inc

SERIAL_CONSOLE = "115200 ttymxc3"

MACHINE_FIRMWARE_append_mx6 = " linux-firmware-ath6k"

MACHINE_FEATURES += " pci wifi bluetooth"
```

## meta-fsl-arm/conf/machine/include/ls-base.inc
```bitbake
require conf/machine/include/soc-family.inc

# Freescale BSP default providers
PREFERRED_PROVIDER_u-boot_ls102xa ?= "u-boot-ls1"
PREFERRED_PROVIDER_virtual/bootloader_ls102xa ?= "u-boot-ls1"
PREFERRED_PROVIDER_virtual/kernel_ls102xa ?= "linux-ls1"

# Define the default image type
IMAGE_CLASSES ?= "image_types_uboot"
KERNEL_IMAGETYPE ?= "uImage"

UBOOT_ENTRYPOINT_ls102xa = "0x80008000"

MACHINE_FEATURES = "pci ext2 ext3 serial"
MACHINE_EXTRA_RRECOMMENDS = "udev-extraconf"

DEFAULTTUNE_ls102xa = "cortexa7hf-neon"
```

## meta-fsl-arm/conf/machine/include/mxs-base.inc
```bitbake
# Provides the i.MXS common settings

include conf/machine/include/fsl-default-settings.inc
include conf/machine/include/fsl-default-versions.inc

include conf/machine/include/soc-family.inc
include conf/machine/include/tune-arm926ejs.inc

SOC_FAMILY = "mxs"

PREFERRED_PROVIDER_virtual/kernel ??= "linux-imx"
PREFERRED_PROVIDER_virtual/kernel_mx23 ?= "linux-fslc"

PREFERRED_PROVIDER_u-boot ??= "u-boot-fslc"
PREFERRED_PROVIDER_virtual/bootloader ??= "u-boot-fslc"
UBOOT_ENTRYPOINT = "0x40008000"
UBOOT_MAKE_TARGET = "u-boot.sb"
UBOOT_SUFFIX = "sb"

PREFERRED_PROVIDER_virtual/xserver = "xserver-xorg"
XSERVER = "xserver-xorg \
           xf86-input-evdev \
           xf86-video-fbdev"

# Sub-architecture support
MACHINE_SOCARCH_SUFFIX ?= ""

MACHINE_ARCH_FILTER = "virtual/kernel"

INHERIT += "fsl-dynamic-packagearch"

# Ship kernel modules
MACHINE_EXTRA_RRECOMMENDS = "kernel-modules"

SERIAL_CONSOLE = "115200 ttyAMA0"

KERNEL_IMAGETYPE = "zImage"
```

## meta-fsl-arm/conf/machine/ls1021aqds.conf
```bitbake
#@TYPE: Machine
#@NAME: Freescale LS1021AQDS board
#@SOC: ls102xa
#@DESCRIPTION: Machine configuration for running LS1021AQDS in 32-bit mode
#@MAINTAINER: Zhenhua Luo <zhenhua.luo@freescale.com>

require conf/machine/include/ls-base.inc
require conf/machine/include/tune-cortexa7.inc

SOC_FAMILY = "ls102xa"

UBOOT_CONFIG ??= "nor"
UBOOT_CONFIG[nor] = "ls1021aqds_nor_config"
UBOOT_CONFIG[qspi] = "ls1021aqds_qspi_config"
UBOOT_CONFIG[nor-secboot] = "ls1021aqds_nor_secboot_config"
UBOOT_CONFIG[lpuart] = "ls1021aqds_lpuart_config"
UBOOT_CONFIG[sdcard] = "ls1021aqds_sdcard_config"

QE_UCODE="iram_Type_A_LS1021a_r1.0.bin"

KERNEL_DEVICETREE = "ls1021a-qds.dtb"

SERIAL_CONSOLES ?= "115200;ttyS0 115200;ttyS1 115200;ttyEHV0 115200;ttyLP0 115200;ttyAMA0"
SERIAL_CONSOLES_CHECK ?= "${SERIAL_CONSOLES}"
USE_VT ?= "0"
```
