## meta-fsl-ppc/conf/distro/fsl.conf
```bitbake
DISTRO = "fsl"
DISTRO_NAME = "Yocto (Built by Poky 7.0)"
DISTRO_VERSION = "1.2"
SDK_VENDOR = "-fslsdk"
SDK_VERSION := "${@'${DISTRO_VERSION}'.replace('snapshot-${DATE}','snapshot')}"

MAINTAINER = "Matthew McClintock <msm@freescale.com>"

TARGET_VENDOR = "-fsl"
TARGET_VENDOR_virtclass-multilib-lib32 = "-fsl"
TARGET_VENDOR_virtclass-multilib-lib64 = "-fsl"

LOCALCONF_VERSION = "1"
LAYER_CONF_VERSION ?= "6"

DISTRO_FEATURES_append = " largefile multiarch"

SDK_NAME = "${DISTRO}-${TCLIBC}-${SDK_ARCH}-${TUNE_PKGARCH}"
SDKPATH = "/opt/${DISTRO}/${SDK_VERSION}"

DISTRO_EXTRA_RDEPENDS += "packagegroup-core-boot"
DISTRO_EXTRA_RRECOMMENDS += ""

POKYQEMUDEPS = "${@base_contains("INCOMPATIBLE_LICENSE", "GPLv3", "", "qemu-config",d)}"
DISTRO_EXTRA_RDEPENDS_append_qemuarm = " ${POKYQEMUDEPS}"
DISTRO_EXTRA_RDEPENDS_append_qemumips = " ${POKYQEMUDEPS}"
DISTRO_EXTRA_RDEPENDS_append_qemuppc = " ${POKYQEMUDEPS}"
DISTRO_EXTRA_RDEPENDS_append_qemux86 = " ${POKYQEMUDEPS}"
DISTRO_EXTRA_RDEPENDS_append_qemux86-64 = " ${POKYQEMUDEPS}"

TCLIBCAPPEND = ""

PREMIRRORS ?= "\
bzr://.*/.*   http://downloads.yoctoproject.org/mirror/sources/ \n \
cvs://.*/.*   http://downloads.yoctoproject.org/mirror/sources/ \n \
git://.*/.*   http://downloads.yoctoproject.org/mirror/sources/ \n \
hg://.*/.*    http://downloads.yoctoproject.org/mirror/sources/ \n \
osc://.*/.*   http://downloads.yoctoproject.org/mirror/sources/ \n \
p4://.*/.*    http://downloads.yoctoproject.org/mirror/sources/ \n \
svk://.*/.*   http://downloads.yoctoproject.org/mirror/sources/ \n \
svn://.*/.*   http://downloads.yoctoproject.org/mirror/sources/ \n"

MIRRORS =+ "\
ftp://.*/.*      http://downloads.yoctoproject.org/mirror/sources/ \n \
http://.*/.*     http://downloads.yoctoproject.org/mirror/sources/ \n \
https://.*/.*    http://downloads.yoctoproject.org/mirror/sources/ \n"

# The CONNECTIVITY_CHECK_URI's are used to test whether we can succesfully
# fetch from the network (and warn you if not). To disable the test set
# the variable to be empty.
CONNECTIVITY_CHECK_URIS ?= "git://git.yoctoproject.org/yocto-firewall-test;protocol=git;rev=HEAD \
                          https://eula-downloads.yoctoproject.org/index.php \
                          http://bugzilla.yoctoproject.org/report.cgi"

SANITY_TESTED_DISTROS ?= " \
            Yocto (Built by Poky 7.0) 1.2 \n \
            Ubuntu 10.04.4 LTS \n \
            Ubuntu 11.10 \n \
            Ubuntu 12.04 LTS \n \
            Ubuntu 12.04.1 LTS \n \
            Fedora release 13 (Goddard) \n \
            Fedora release 15 (Lovelock) \n \
            Fedora release 16 (Verne) \n \
            Fedora release 17 (Beefy Miracle) \n \
            CentOS release 5.5 (Final) \n \
            CentOS release 5.6 (Final) \n \
            CentOS release 5.7 (Final) \n \
            CentOS release 5.8 (Final) \n \
            CentOS release 6.2 (Final) \n \
            CentOS release 6.3 (Final) \n \
            Debian GNU/Linux 6.0.4 (squeeze) \n \
            openSUSE 11.4 \n \
            openSUSE 12.1 \n \
	    "

# Default hash policy for distro
BB_SIGNATURE_HANDLER ?= 'OEBasicHash'
#
# OELAYOUT_ABI allows us to notify users when the format of TMPDIR changes in 
# an incompatible way. Such changes should usually be detailed in the commit
# that breaks the format and have been previously discussed on the mailing list 
# with general agreement from the core team.
#
OELAYOUT_ABI = "8"

INHERIT += "own-mirrors"
SOURCE_MIRROR_URL ?= "http://autobuilder.yoctoproject.org/sources/"

IMAGE_CLASSES = "image_types_uboot"

PREFERRED_VERSION_u-boot-mkimage-native_powerpc = "2011.06"
PREFERRED_PROVIDER_virtual/libx11 = "libx11"

CCACHE = ""
```

## meta-fsl-ppc/conf/layer.conf
```bitbake
# We have a packages directory, add to BBFILES
BBPATH .= ":${LAYERDIR}"

BBFILES += "${LAYERDIR}/recipes-*/*/*.bb*"
BBFILES += "${LAYERDIR}/images/*.bb*"
BBFILES += "${LAYERDIR}/classes/*.bb*"

BBFILE_COLLECTIONS += "fsl-ppc"
BBFILE_PATTERN_fsl-ppc = "^${LAYERDIR}/"
BBFILE_PRIORITY_fsl-ppc = "5"

LICENSE_PATH += "${LAYERDIR}/custom-licenses"

# Let us add layer-specific bbappends which are only applied when that
# layer is included in our configuration
BBFILES += "${@' '.join('${LAYERDIR}/%s/recipes*/*/*.bbappend' % layer \
               for layer in BBFILE_COLLECTIONS.split())}"
```
