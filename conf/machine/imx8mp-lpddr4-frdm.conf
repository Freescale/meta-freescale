## conf/machine/imx8ulp-9x9-lpddr4x-evk.conf
```bitbake
#@TYPE: Machine
#@NAME: i.MX 8ULP 9x9 EVK
#@SOC: i.MX8ULP
#@DESCRIPTION: Machine configuration for NXP i.MX 8ULP 9x9 Evaluation Kit with LPDDR4x
#@MAINTAINER: Jun Zhu <junzhu@nxp.com>

require conf/machine/include/imx8ulp-evk.inc

KERNEL_DEVICETREE_BASENAME = "imx8ulp-9x9-evk"

KERNEL_DEVICETREE:append:use-nxp-bsp = " \
    freescale/${KERNEL_DEVICETREE_BASENAME}-i3c.dtb \
    freescale/${KERNEL_DEVICETREE_BASENAME}-lpa.dtb \
    freescale/${KERNEL_DEVICETREE_BASENAME}-lpspi.dtb \
    freescale/${KERNEL_DEVICETREE_BASENAME}-lpspi-slave.dtb \
    freescale/${KERNEL_DEVICETREE_BASENAME}-sof-btsco.dtb \
    freescale/${KERNEL_DEVICETREE_BASENAME}-tpm.dtb \
    freescale/${KERNEL_DEVICETREE_BASENAME}-rk055hdmipi4m.dtb \
    freescale/${KERNEL_DEVICETREE_BASENAME}-rk055hdmipi4mv2.dtb \
"

UBOOT_CONFIG_BASENAME = "imx8ulp_9x9_evk"

MACHINE_FEATURES += "soc-reva1"
UPOWER_FIRMWARE_NAME = "upower_a1.bin"
IMX_DEFAULT_BSP = "nxp"
```

## conf/machine/imx91-11x11-lpddr4-evk.conf
```bitbake
#@TYPE: Machine
#@NAME: NXP i.MX 91 11x11 Evaluation Kit with LPDDR4
#@SOC: i.MX91
#@DESCRIPTION: Machine configuration for NXP i.MX 91 11x11 EVK with LPDDR4
#@MAINTAINER: Jun Zhu <junzhu@nxp.com>

MACHINEOVERRIDES =. "mx91:"

require conf/machine/include/imx91-evk.inc

KERNEL_DEVICETREE_BASENAME = "imx91-11x11-evk"

KERNEL_DEVICETREE:append:use-nxp-bsp = " \
    freescale/${KERNEL_DEVICETREE_BASENAME}-aud-hat.dtb \
    freescale/${KERNEL_DEVICETREE_BASENAME}-flexspi-m2.dtb \
    freescale/${KERNEL_DEVICETREE_BASENAME}-flexspi-nand-m2.dtb \
    freescale/${KERNEL_DEVICETREE_BASENAME}-i2c-spi-slave.dtb \
    freescale/${KERNEL_DEVICETREE_BASENAME}-i3c.dtb \
    freescale/${KERNEL_DEVICETREE_BASENAME}-ld.dtb \
    freescale/${KERNEL_DEVICETREE_BASENAME}-lpuart.dtb \
    freescale/${KERNEL_DEVICETREE_BASENAME}-mqs.dtb \
    freescale/${KERNEL_DEVICETREE_BASENAME}-mt9m114.dtb \
    freescale/${KERNEL_DEVICETREE_BASENAME}-tianma-wvga-panel.dtb \
    freescale/${KERNEL_DEVICETREE_BASENAME}-usbwifi.dtb \
    freescale/${KERNEL_DEVICETREE_BASENAME}-8mic-reve.dtb \
"

UBOOT_CONFIG_BASENAME = "imx91_11x11_evk"

UBOOT_CONFIG[fspi] = "${UBOOT_CONFIG_BASENAME}_defconfig"
UBOOT_CONFIG[nand] = "${UBOOT_CONFIG_BASENAME}_spinand_defconfig"

DDR_FIRMWARE_NAME = " \
    lpddr4_dmem_1d_v202201.bin \
    lpddr4_dmem_2d_v202201.bin \
    lpddr4_imem_1d_v202201.bin \
    lpddr4_imem_2d_v202201.bin \
"
```

## conf/machine/imx91-11x11-lpddr4-frdm-s.conf
```bitbake
#@TYPE: Machine
#@NAME: NXP i.MX 91S 11x11 FRDM with LPDDR4
#@SOC: i.MX91S
#@DESCRIPTION: Machine configuration for NXP i.MX 91S FRDM-IMX91S with LPDDR4
#@MAINTAINER: Lei Xu <lei.xu@nxp.com>

MACHINEOVERRIDES =. "mx91:"

require conf/machine/include/imx91-evk.inc

KERNEL_DEVICETREE_BASENAME = "imx91-11x11-frdm-s"

KERNEL_DEVICETREE:append:use-nxp-bsp = " \
    freescale/${KERNEL_DEVICETREE_BASENAME}-8mic-revE.dtb \
    freescale/${KERNEL_DEVICETREE_BASENAME}-aud-hat.dtb \
    freescale/${KERNEL_DEVICETREE_BASENAME}-ld.dtb \
    freescale/${KERNEL_DEVICETREE_BASENAME}-mt9m114.dtb \
    freescale/${KERNEL_DEVICETREE_BASENAME}-tianma-wvga-panel.dtb \
"

UBOOT_CONFIG_BASENAME = "imx91_11x11_frdm_imx91s"

UBOOT_CONFIG[nand] = "${UBOOT_CONFIG_BASENAME}_spinand_defconfig"
UBOOT_CONFIG_IMAGE_FSTYPES[nand] = "ubifs"

IMXBOOT_TARGETS = "${@bb.utils.contains('UBOOT_CONFIG', 'nand', '${IMXBOOT_TARGETS_NAND}', \
                                                                  'flash_singleboot', d)}"

DDR_FIRMWARE_NAME = " \
    lpddr4_dmem_1d_v202201.bin \
    lpddr4_dmem_2d_v202201.bin \
    lpddr4_imem_1d_v202201.bin \
    lpddr4_imem_2d_v202201.bin \
"
```

## conf/machine/imx91-11x11-lpddr4-frdm.conf
```bitbake
#@TYPE: Machine
#@NAME: NXP i.MX 91 11x11 FRDM with LPDDR4
#@SOC: i.MX91
#@DESCRIPTION: Machine configuration for NXP i.MX 91 11x11 FRDM with LPDDR4
#@MAINTAINER: Lei Xu <lei.xu@nxp.com>

MACHINEOVERRIDES =. "mx91:"

require conf/machine/include/imx91-evk.inc

KERNEL_DEVICETREE_BASENAME = "imx91-11x11-frdm"

KERNEL_DEVICETREE:append:use-nxp-bsp = " \
    freescale/${KERNEL_DEVICETREE_BASENAME}-8mic-reve.dtb \
    freescale/${KERNEL_DEVICETREE_BASENAME}-aud-hat.dtb \
    freescale/${KERNEL_DEVICETREE_BASENAME}-mt9m114.dtb \
    freescale/${KERNEL_DEVICETREE_BASENAME}-tianma-wvga-panel.dtb \
"

UBOOT_CONFIG_BASENAME = "imx91_11x11_frdm"

DDR_FIRMWARE_NAME = " \
    lpddr4_dmem_1d_v202201.bin \
    lpddr4_dmem_2d_v202201.bin \
    lpddr4_imem_1d_v202201.bin \
    lpddr4_imem_2d_v202201.bin \
"
```

## conf/machine/imx91-9x9-lpddr4-qsb.conf
```bitbake
#@TYPE: Machine
#@NAME: NXP i.MX 91 9x9 Quick Start Board with LPDDR4
#@SOC: i.MX91
#@DESCRIPTION: Machine configuration for NXP i.MX 91 9x9 QSB with LPDDR4
#@MAINTAINER: Jun Zhu <junzhu@nxp.com>

MACHINEOVERRIDES =. "mx91:"

require conf/machine/include/imx91-evk.inc

KERNEL_DEVICETREE_BASENAME = "imx91-9x9-qsb"

KERNEL_DEVICETREE:append:use-nxp-bsp = " \
    freescale/${KERNEL_DEVICETREE_BASENAME}-aud-hat.dtb \
    freescale/${KERNEL_DEVICETREE_BASENAME}-can1.dtb \
    freescale/${KERNEL_DEVICETREE_BASENAME}-flexspi-m2.dtb \
    freescale/${KERNEL_DEVICETREE_BASENAME}-flexspi-nand.dtb \
    freescale/${KERNEL_DEVICETREE_BASENAME}-i2c-spi-slave.dtb \
    freescale/${KERNEL_DEVICETREE_BASENAME}-i3c.dtb \
    freescale/${KERNEL_DEVICETREE_BASENAME}-ld.dtb \
    freescale/${KERNEL_DEVICETREE_BASENAME}-mt9m114.dtb \
    freescale/${KERNEL_DEVICETREE_BASENAME}-tianma-wvga-panel.dtb \
"

UBOOT_CONFIG_BASENAME = "imx91_9x9_qsb"

UBOOT_CONFIG[fspi] = "${UBOOT_CONFIG_BASENAME}_fspi_defconfig"
UBOOT_CONFIG[nand] = "${UBOOT_CONFIG_BASENAME}_defconfig"

DDR_FIRMWARE_NAME = " \
    lpddr4_dmem_1d_v202201.bin \
    lpddr4_dmem_2d_v202201.bin \
    lpddr4_imem_1d_v202201.bin \
    lpddr4_imem_2d_v202201.bin \
"
```

## conf/machine/imx93-11x11-lpddr4x-frdm.conf
```bitbake
require conf/machine/include/imx93-evk.inc

DDR_FIRMWARE_NAME = " \
   lpddr4_dmem_1d_v202201.bin \
   lpddr4_dmem_2d_v202201.bin \
   lpddr4_imem_1d_v202201.bin \
   lpddr4_imem_2d_v202201.bin \
"

# Bootloader
PREFERRED_PROVIDER_virtual/bootloader ?= "u-boot-imx"
UBOOT_CONFIG_BASENAME = "imx93_11x11_frdm"
UBOOT_DTB_NAME = "imx93-11x11-frdm"

# Kernel
PREFERRED_PROVIDER_virtual/kernel ?= "linux-imx"

KERNEL_DEVICETREE_BASENAME = "imx93-11x11-frdm"
KERNEL_DEVICETREE = "freescale/${KERNEL_DEVICETREE_BASENAME}.dtb"

# TODO: add the device trees below once linux-imx
# is bumped to lf-6.18.20-2.0.0:
# freescale/imx93-jailhouse-inmate.dtb
# freescale/${KERNEL_DEVICETREE_BASENAME}-root.dtb

KERNEL_DEVICETREE:append:use-nxp-bsp = " \
    freescale/${KERNEL_DEVICETREE_BASENAME}-8mic-reve.dtb \
    freescale/${KERNEL_DEVICETREE_BASENAME}-aud-hat.dtb \
    freescale/${KERNEL_DEVICETREE_BASENAME}-ld.dtb \
    freescale/${KERNEL_DEVICETREE_BASENAME}-lpuart.dtb \
    freescale/${KERNEL_DEVICETREE_BASENAME}-mt9m114.dtb \
    freescale/${KERNEL_DEVICETREE_BASENAME}-ov5640.dtb \
    freescale/${KERNEL_DEVICETREE_BASENAME}-tianma-wvga-panel.dtb \
    freescale/${KERNEL_DEVICETREE_BASENAME}-waveshare-7inch-c-panel.dtb \
 "
```

## conf/machine/imx93-11x11-lpddr4x-pf0900-evk.conf
```bitbake
#@TYPE: Machine
#@NAME: NXP i.MX 93 11x11 Evaluation Kit with LPDDR4X and PMIC pf0900
#@SOC: i.MX93
#@DESCRIPTION: Machine configuration for NXP i.MX 93 11x11 EVK with LPDDR4X and PMIC pf0900
#@MAINTAINER: Flora Hu <flora.hu@nxp.com>

require conf/machine/include/imx93-evk.inc

KERNEL_DEVICETREE_BASENAME = "imx93-11x11-evk-pmic-pf0900"

KERNEL_DEVICETREE:append:use-nxp-bsp = " \
    freescale/${KERNEL_DEVICETREE_BASENAME}-aud-hat.dtb \
    freescale/${KERNEL_DEVICETREE_BASENAME}-boe-wxga-lvds-panel.dtb \
    freescale/${KERNEL_DEVICETREE_BASENAME}-flexio-i2c.dtb \
    freescale/${KERNEL_DEVICETREE_BASENAME}-flexspi-m2.dtb \
    freescale/${KERNEL_DEVICETREE_BASENAME}-i2c-spi-slave.dtb \
    freescale/${KERNEL_DEVICETREE_BASENAME}-i3c.dtb \
    freescale/${KERNEL_DEVICETREE_BASENAME}-ld.dtb \
    freescale/${KERNEL_DEVICETREE_BASENAME}-lpuart.dtb \
    freescale/${KERNEL_DEVICETREE_BASENAME}-mqs.dtb \
    freescale/${KERNEL_DEVICETREE_BASENAME}-mt9m114.dtb \
    freescale/${KERNEL_DEVICETREE_BASENAME}-rm67199.dtb \
    freescale/${KERNEL_DEVICETREE_BASENAME}-root.dtb \
    freescale/${KERNEL_DEVICETREE_BASENAME}-rpmsg.dtb \
"

UBOOT_CONFIG_BASENAME = "imx93_11x11_evk"

UBOOT_CONFIG ??= "sd"
UBOOT_CONFIG[sd]   = "${UBOOT_CONFIG_BASENAME}_pf0900_defconfig"
UBOOT_CONFIG[ecc]  = "${UBOOT_CONFIG_BASENAME}_inline_ecc_pf0900_defconfig"

DDR_FIRMWARE_NAME = " \
    lpddr4_dmem_1d_v202201.bin \
    lpddr4_dmem_2d_v202201.bin \
    lpddr4_imem_1d_v202201.bin \
    lpddr4_imem_2d_v202201.bin \
"

IMXBOOT_TARGETS = "${@bb.utils.contains('UBOOT_CONFIG', 'ecc', '${IMXBOOT_TARGETS_ECC}', '${IMXBOOT_TARGETS_SD}', d)}"
```

## conf/machine/imx93-frdm.conf
```bitbake
require conf/machine/include/imx93-evk.inc

DDR_FIRMWARE_NAME = " \
   lpddr4_dmem_1d_v202201.bin \
   lpddr4_dmem_2d_v202201.bin \
   lpddr4_imem_1d_v202201.bin \
   lpddr4_imem_2d_v202201.bin \
"

PREFERRED_PROVIDER_virtual/bootloader ?= "u-boot-imx"
UBOOT_CONFIG_BASENAME = "imx93_11x11_frdm"
UBOOT_DTB_NAME = "imx93-11x11-frdm"

PREFERRED_PROVIDER_virtual/kernel ?= "linux-imx"
KERNEL_DEVICETREE = "freescale/imx93-11x11-frdm.dtb"
```

## conf/machine/imx937-15x15-lpddr5-frdm.conf
```bitbake
#@TYPE: Machine
#@NAME: NXP i.MX 937 15x15 FRDM with LPDDR5
#@SOC: i.MX937
#@DESCRIPTION: Machine configuration for NXP i.MX 937 15x15 FRDM with LPDDR5
#@MAINTAINER: Jun Zhu <junzhu@nxp.com>

require conf/machine/include/imx937-evk.inc

KERNEL_DEVICETREE_BASENAME = "imx937-frdm"

KERNEL_DEVICETREE:append:use-nxp-bsp = " \
    freescale/imx937-jailhouse-inmate.dtb \
    freescale/${KERNEL_DEVICETREE_BASENAME}-ap1302-csi0-2lanes.dtb \
    freescale/${KERNEL_DEVICETREE_BASENAME}-ap1302-csi0-2lanes.dtbo \
    freescale/${KERNEL_DEVICETREE_BASENAME}-ap1302-csi1-2lanes.dtb \
    freescale/${KERNEL_DEVICETREE_BASENAME}-ap1302-csi1-2lanes.dtbo \
    freescale/${KERNEL_DEVICETREE_BASENAME}-aud-hat.dtb \
    freescale/${KERNEL_DEVICETREE_BASENAME}-boe-wxga-lvds-panel.dtb \
    freescale/${KERNEL_DEVICETREE_BASENAME}-dual-ap1302.dtb \
    freescale/${KERNEL_DEVICETREE_BASENAME}-pcie-ep.dtb \
    freescale/${KERNEL_DEVICETREE_BASENAME}-sgmii.dtb \
    freescale/${KERNEL_DEVICETREE_BASENAME}-root.dtb \
    freescale/${KERNEL_DEVICETREE_BASENAME}-v2x-she0.dtb \
    freescale/${KERNEL_DEVICETREE_BASENAME}-waveshare-7inch-c-panel.dtb \
"

UBOOT_CONFIG_BASENAME = "imx937_frdm"

IMXBOOT_TARGETS_BASENAME = "flash"

OEI_BOARD  = "mx937lp5-15-frdm"
DDR_TYPE   = "lpddr5"
DDR_FIRMWARE_NAME = " \
    lpddr5_dmem_v202409.bin \
    lpddr5_dmem_qb_v202409.bin \
    lpddr5_imem_v202409.bin \
    lpddr5_imem_qb_v202409.bin \
"
OEI_DDR_CONFIG     = "MIMX937_LPDDR5_FRDM_15X15_3733MTS_FW2024.09-SP2_timing"
OEI_DDR_CONFIG_ECC = "MIMX937_LPDDR5_FRDM_15X15_3733MTS_FW2024.09-SP2_ECC_enabled_timing"
SYSTEM_MANAGER_CONFIG_DEFAULT = "mx937frdm"

M4_DEFAULT_IMAGE = "imx937-15x15-frdm_m7_TCM_power_mode_switch.bin"
```

## conf/machine/imx93w-14x12-lpddr4x-evk.conf
```bitbake
#@TYPE: Machine
#@NAME: NXP i.MX 93W 14x12 Evaluation Kit with LPDDR4X
#@SOC: i.MX93W
#@DESCRIPTION: Machine configuration for NXP i.MX 93W 14x12 EVK with LPDDR4X
#@MAINTAINER: Jun Zhu <junzhu@nxp.com>

MACHINEOVERRIDES =. "mx93w:"

require conf/machine/include/imx93-evk.inc

MACHINE_FEATURES:append:use-nxp-bsp = " nxpiw610-sdio"

KERNEL_DEVICETREE_BASENAME = "imx93w-evk"

KERNEL_DEVICETREE:append:use-nxp-bsp = " \
    freescale/imx93-jailhouse-inmate.dtb \
    freescale/${KERNEL_DEVICETREE_BASENAME}-8mic-reve.dtb \
    freescale/${KERNEL_DEVICETREE_BASENAME}-boe-wxga-lvds-panel.dtb \
    freescale/${KERNEL_DEVICETREE_BASENAME}-i2c-spi-slave.dtb \
    freescale/${KERNEL_DEVICETREE_BASENAME}-i3c.dtb \
    freescale/${KERNEL_DEVICETREE_BASENAME}-ld.dtb \
    freescale/${KERNEL_DEVICETREE_BASENAME}-root.dtb \
    freescale/${KERNEL_DEVICETREE_BASENAME}-rm67199.dtb \
    freescale/${KERNEL_DEVICETREE_BASENAME}-rpmsg.dtb \
"

UBOOT_CONFIG_BASENAME = "imx93w_evk"

DDR_FIRMWARE_NAME = " \
    lpddr4_dmem_1d_v202201.bin \
    lpddr4_dmem_2d_v202201.bin \
    lpddr4_imem_1d_v202201.bin \
    lpddr4_imem_2d_v202201.bin \
"

WKS_FILE_DEPENDS:append:imx-nxp-bsp = " imx-m33-demos"
IMAGE_BOOT_FILES:append:imx-nxp-bsp = " \
    mcore-demos/imx93w-14x12-evk_m33_TCM_power_mode_switch.bin \
    mcore-demos/imx93w-14x12-evk_m33_TCM_rpmsg_lite_pingpong_rtos_linux_remote.bin \
    mcore-demos/imx93w-14x12-evk_m33_TCM_rpmsg_lite_str_echo_rtos.bin \
    mcore-demos/imx93w-14x12-evk_m33_TCM_sai_low_power_audio.bin \
"

IMXBOOT_TARGETS = "flash_singleboot"
```

## conf/machine/imx93w-14x12-lpddr4x-frdm.conf
```bitbake
#@TYPE: Machine
#@NAME: NXP i.MX 93W 14x12 FRDM with LPDDR4X
#@SOC: i.MX93W
#@DESCRIPTION: Machine configuration for NXP i.MX 93W 14x12 FRDM with LPDDR4X
#@MAINTAINER: Jun Zhu <junzhu@nxp.com>

MACHINEOVERRIDES =. "mx93w:"

require conf/machine/include/imx93-evk.inc

MACHINE_FEATURES:append:use-nxp-bsp = " nxpiw610-sdio"

KERNEL_DEVICETREE_BASENAME = "imx93w-frdm"

KERNEL_DEVICETREE:append:use-nxp-bsp = " \
    freescale/${KERNEL_DEVICETREE_BASENAME}-8mic-reve.dtb \
    freescale/${KERNEL_DEVICETREE_BASENAME}-waveshare-7inch-c-panel.dtb \
"

UBOOT_CONFIG_BASENAME = "imx93w_frdm"

DDR_FIRMWARE_NAME = " \
    lpddr4_dmem_1d_v202201.bin \
    lpddr4_dmem_2d_v202201.bin \
    lpddr4_imem_1d_v202201.bin \
    lpddr4_imem_2d_v202201.bin \
"

WKS_FILE_DEPENDS:append:imx-nxp-bsp = " imx-m33-demos"

IMAGE_BOOT_FILES:append:imx-nxp-bsp = " \
    mcore-demos/imx93w-14x12-evk_m33_TCM_power_mode_switch.bin \
    mcore-demos/imx93w-14x12-evk_m33_TCM_rpmsg_lite_pingpong_rtos_linux_remote.bin \
    mcore-demos/imx93w-14x12-evk_m33_TCM_rpmsg_lite_str_echo_rtos.bin \
    mcore-demos/imx93w-14x12-evk_m33_TCM_sai_low_power_audio.bin \
"

IMXBOOT_TARGETS = "flash_singleboot"
```

## conf/machine/imx95-15x15-lpddr4x-frdm.conf
```bitbake
#@TYPE: Machine
#@NAME: NXP i.MX 95 15x15 FRDM with LPDDR4x
#@SOC: i.MX95
#@DESCRIPTION: Machine configuration for NXP i.MX 95 15x15 FRDM with LPDDR4x
#@MAINTAINER: Jun Zhu <junzhu@nxp.com>

MACHINEOVERRIDES =. "mx95:"

require conf/machine/include/imx95-evk.inc

MACHINE_FEATURES:append:use-nxp-bsp = " nxpiw612-sdio"

KERNEL_DEVICETREE_BASENAME = "imx95-15x15-frdm"

KERNEL_DEVICETREE:append:use-nxp-bsp = " \
    freescale/${KERNEL_DEVICETREE_BASENAME}.dtb \
    freescale/${KERNEL_DEVICETREE_BASENAME}-8mic-reve.dtb \
    freescale/${KERNEL_DEVICETREE_BASENAME}-ap1302.dtb \
    freescale/${KERNEL_DEVICETREE_BASENAME}-aud-hat.dtb \
    freescale/${KERNEL_DEVICETREE_BASENAME}-boe-wxga-lvds-panel.dtb \
    freescale/${KERNEL_DEVICETREE_BASENAME}-dual-os08a20-isp.dtb \
    freescale/${KERNEL_DEVICETREE_BASENAME}-neutron.dtb \
    freescale/${KERNEL_DEVICETREE_BASENAME}-os08a20-combo-isp.dtb \
    freescale/${KERNEL_DEVICETREE_BASENAME}-os08a20-isp.dtb \
    freescale/${KERNEL_DEVICETREE_BASENAME}-root.dtb \
    freescale/${KERNEL_DEVICETREE_BASENAME}-rpmsg.dtb \
    freescale/${KERNEL_DEVICETREE_BASENAME}-waveshare-7inch-c-panel.dtb \
"

UBOOT_CONFIG_BASENAME = "imx95_15x15_frdm"

IMXBOOT_TARGETS_BASENAME = "flash"

OEI_BOARD  = "mx95lp4x-15"
DDR_TYPE   = "lpddr4x"
DDR_FIRMWARE_NAME = " \
    lpddr4x_dmem_v202409.bin \
    lpddr4x_dmem_qb_v202409.bin \
    lpddr4x_imem_v202409.bin \
    lpddr4x_imem_qb_v202409.bin \
"
OEI_DDR_CONFIG     = "MIMX95_LPDDR4X_EVK_15X15_4000MTS_FW2024.09_timing"
OEI_DDR_CONFIG_ECC = "MIMX95_LPDDR4X_EVK_15X15_4000MTS_FW2024.09_ECC_enabled_timing"

M4_DEFAULT_IMAGE = "imx95-15x15-frdm_m7_TCM_power_mode_switch.bin"

IMAGE_BOOT_FILES:append = " \
    mcore-demos/imx95-15x15-frdm_m7_TCM_hello_world.bin \
    mcore-demos/imx95-15x15-frdm_m7_TCM_power_mode_switch.bin \
    mcore-demos/imx95-15x15-frdm_m7_TCM_rpmsg_lite_pingpong_rtos_linux_remote.bin \
    mcore-demos/imx95-15x15-frdm_m7_TCM_rpmsg_lite_str_echo_rtos.bin \
"
```
