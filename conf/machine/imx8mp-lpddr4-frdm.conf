## conf/machine/imx95-15x15-lpddr5-frdm.conf
```bitbake
#@TYPE: Machine
#@NAME: NXP i.MX 95 15x15 FRDM with LPDDR5
#@SOC: i.MX95
#@DESCRIPTION: Machine configuration for NXP i.MX 95 15x15 FRDM with LPDDR5
#@MAINTAINER: Jun Zhu <junzhu@nxp.com>

MACHINEOVERRIDES =. "mx95:"

require conf/machine/include/imx95-evk.inc

MACHINE_FEATURES:append:use-nxp-bsp = " nxpiw612-sdio"

KERNEL_DEVICETREE_BASENAME = "imx95-15x15-frdm"

KERNEL_DEVICETREE:append:use-nxp-bsp = " \
    freescale/${KERNEL_DEVICETREE_BASENAME}.dtb \
    freescale/${KERNEL_DEVICETREE_BASENAME}-8mic-reve.dtb \
    freescale/${KERNEL_DEVICETREE_BASENAME}-ap1302.dtb \
    freescale/${KERNEL_DEVICETREE_BASENAME}-aud-hat.dtb \
    freescale/${KERNEL_DEVICETREE_BASENAME}-boe-wxga-lvds-panel.dtb \
    freescale/${KERNEL_DEVICETREE_BASENAME}-dual-os08a20-isp.dtb \
    freescale/${KERNEL_DEVICETREE_BASENAME}-neutron.dtb \
    freescale/${KERNEL_DEVICETREE_BASENAME}-os08a20-combo-isp.dtb \
    freescale/${KERNEL_DEVICETREE_BASENAME}-os08a20-isp.dtb \
    freescale/${KERNEL_DEVICETREE_BASENAME}-root.dtb \
    freescale/${KERNEL_DEVICETREE_BASENAME}-rpmsg.dtb \
    freescale/${KERNEL_DEVICETREE_BASENAME}-waveshare-7inch-c-panel.dtb \
"

UBOOT_CONFIG_BASENAME = "imx95_15x15_frdm"

IMXBOOT_TARGETS_BASENAME = "flash"

OEI_BOARD  = "mx95lp5-15-frdm"
DDR_TYPE   = "lpddr5"
DDR_FIRMWARE_NAME = " \
    lpddr5_dmem_v202409.bin \
    lpddr5_dmem_qb_v202409.bin \
    lpddr5_imem_v202409.bin \
    lpddr5_imem_qb_v202409.bin \
"
OEI_DDR_CONFIG     = "MIMX95_LPDDR5_FRDM_15X15_4266MTS_FW2024.09_timing"
OEI_DDR_CONFIG_ECC = "MIMX95_LPDDR5_FRDM_15X15_4266MTS_FW2024.09_ECC_enabled_timing"

IMXBOOT_VARIANTS = "alt jailhouse rpmsg"
# Multiple system manager configs by IMXBOOT_VARIANT
SYSTEM_MANAGER_CONFIG = "${@bb.utils.contains('IMXBOOT_VARIANT', 'alt',       'mx95alt', \
                            bb.utils.contains('IMXBOOT_VARIANT', 'jailhouse', 'mx95frdmjailhouse', \
                            bb.utils.contains('IMXBOOT_VARIANT', 'rpmsg',     'mx95frdmrpmsg', \
                                                                              'mx95frdm', d), d), d)}"

M4_DEFAULT_IMAGE = "imx95-15x15-frdm_m7_TCM_power_mode_switch.bin"

IMAGE_BOOT_FILES:append = " \
    mcore-demos/imx95-15x15-frdm_m7_TCM_hello_world.bin \
    mcore-demos/imx95-15x15-frdm_m7_TCM_power_mode_switch.bin \
    mcore-demos/imx95-15x15-frdm_m7_TCM_rpmsg_lite_pingpong_rtos_linux_remote.bin \
    mcore-demos/imx95-15x15-frdm_m7_TCM_rpmsg_lite_str_echo_rtos.bin \
"
```

## conf/machine/imx95-19x19-lpddr5-evk.conf
```bitbake
#@TYPE: Machine
#@NAME: NXP i.MX 95 19x19 Evaluation Kit with LPDDR5
#@SOC: i.MX95
#@DESCRIPTION: Machine configuration for NXP i.MX 95 19x19 EVK with LPDDR5
#@MAINTAINER: Jun Zhu <junzhu@nxp.com>

MACHINEOVERRIDES =. "mx95:"

require conf/machine/include/imx95-evk.inc

MACHINE_FEATURES:append:use-nxp-bsp = " nxp9098-pcie"

KERNEL_DEVICETREE_BASENAME = "imx95-19x19-evk"

KERNEL_DEVICETREE:append:use-nxp-bsp = " \
    freescale/imx95-jailhouse-inmate.dtb \
    freescale/${KERNEL_DEVICETREE_BASENAME}-adv7535.dtb \
    freescale/${KERNEL_DEVICETREE_BASENAME}-adv7535.dtbo \
    freescale/${KERNEL_DEVICETREE_BASENAME}-adv7535-ap1302.dtb \
    freescale/${KERNEL_DEVICETREE_BASENAME}-ap1302.dtb \
    freescale/${KERNEL_DEVICETREE_BASENAME}-ap1302.dtbo \
    freescale/${KERNEL_DEVICETREE_BASENAME}-cs42888.dtb \
    freescale/${KERNEL_DEVICETREE_BASENAME}-cs42888.dtbo \
    freescale/${KERNEL_DEVICETREE_BASENAME}-dsi-serdes.dtb \
    freescale/${KERNEL_DEVICETREE_BASENAME}-dsi-serdes.dtbo \
    freescale/${KERNEL_DEVICETREE_BASENAME}-dsi-serdes-jdi-wuxga-panel.dtb \
    freescale/${KERNEL_DEVICETREE_BASENAME}-dsi-serdes-jdi-wuxga-panel.dtbo \
    freescale/${KERNEL_DEVICETREE_BASENAME}-dual-os08a20-isp-it6263-lvds0.dtb \
    freescale/${KERNEL_DEVICETREE_BASENAME}-imx519-ak7375-isp-it6263-lvds0.dtb \
    freescale/${KERNEL_DEVICETREE_BASENAME}-imx519-ak7375.dtbo \
    freescale/${KERNEL_DEVICETREE_BASENAME}-it6263-lvds0.dtb \
    freescale/${KERNEL_DEVICETREE_BASENAME}-it6263-lvds0.dtbo \
    freescale/${KERNEL_DEVICETREE_BASENAME}-it6263-lvds1.dtb \
    freescale/${KERNEL_DEVICETREE_BASENAME}-it6263-lvds1.dtbo \
    freescale/${KERNEL_DEVICETREE_BASENAME}-it6263-lvds-dual.dtb \
    freescale/${KERNEL_DEVICETREE_BASENAME}-it6263-lvds-dual.dtbo \
    freescale/${KERNEL_DEVICETREE_BASENAME}-it6263-lvds-two-disp.dtb \
    freescale/${KERNEL_DEVICETREE_BASENAME}-jdi-wuxga-lvds-panel.dtb \
    freescale/${KERNEL_DEVICETREE_BASENAME}-jdi-wuxga-lvds-panel.dtbo \
    freescale/${KERNEL_DEVICETREE_BASENAME}-jtag.dtb \
    freescale/${KERNEL_DEVICETREE_BASENAME}-jtag.dtbo \
    freescale/${KERNEL_DEVICETREE_BASENAME}-lpspi-slave.dtb \
    freescale/${KERNEL_DEVICETREE_BASENAME}-lt9611uxc.dtb \
    freescale/${KERNEL_DEVICETREE_BASENAME}-lt9611uxc.dtbo \
    freescale/${KERNEL_DEVICETREE_BASENAME}-lt9611uxc-ap1302.dtb \
    freescale/${KERNEL_DEVICETREE_BASENAME}-netc-rpmsg.dtb \
    freescale/${KERNEL_DEVICETREE_BASENAME}-neutron.dtb \
    freescale/${KERNEL_DEVICETREE_BASENAME}-os08a20.dtb \
    freescale/${KERNEL_DEVICETREE_BASENAME}-os08a20.dtbo \
    freescale/${KERNEL_DEVICETREE_BASENAME}-os08a20-combo.dtb \
    freescale/${KERNEL_DEVICETREE_BASENAME}-os08a20-combo.dtbo \
    freescale/${KERNEL_DEVICETREE_BASENAME}-os08a20-dual.dtb \
    freescale/${KERNEL_DEVICETREE_BASENAME}-os08a20-isp-it6263-lvds0.dtb \
    freescale/${KERNEL_DEVICETREE_BASENAME}-os08a20-isp-lvds-two-disp.dtb \
    freescale/${KERNEL_DEVICETREE_BASENAME}-ox03c10.dtb \
    freescale/${KERNEL_DEVICETREE_BASENAME}-ox03c10.dtbo \
    freescale/${KERNEL_DEVICETREE_BASENAME}-ox03c10-all.dtb \
    freescale/${KERNEL_DEVICETREE_BASENAME}-ox03c10-combo.dtb \
    freescale/${KERNEL_DEVICETREE_BASENAME}-ox03c10-combo.dtbo \
    freescale/${KERNEL_DEVICETREE_BASENAME}-ox03c10-isp-it6263-lvds0.dtb \
    freescale/${KERNEL_DEVICETREE_BASENAME}-ox05b1s.dtb \
    freescale/${KERNEL_DEVICETREE_BASENAME}-ox05b1s.dtbo \
    freescale/${KERNEL_DEVICETREE_BASENAME}-ox05b1s-combo.dtb \
    freescale/${KERNEL_DEVICETREE_BASENAME}-ox05b1s-combo.dtbo \
    freescale/${KERNEL_DEVICETREE_BASENAME}-ox05b1s-isp-it6263-lvds0.dtb \
    freescale/${KERNEL_DEVICETREE_BASENAME}-ox05b1s-isp-lvds-two-disp.dtb \
    freescale/${KERNEL_DEVICETREE_BASENAME}-pcie1-ep.dtb \
    freescale/${KERNEL_DEVICETREE_BASENAME}-pcie1-ep.dtbo \
    freescale/${KERNEL_DEVICETREE_BASENAME}-rm692c9.dtb \
    freescale/${KERNEL_DEVICETREE_BASENAME}-rm692c9.dtbo \
    freescale/${KERNEL_DEVICETREE_BASENAME}-root.dtb \
    freescale/${KERNEL_DEVICETREE_BASENAME}-rpmsg.dtb \
    freescale/${KERNEL_DEVICETREE_BASENAME}-sof.dtb \
    freescale/${KERNEL_DEVICETREE_BASENAME}-ti-serdes.dtb \
    freescale/${KERNEL_DEVICETREE_BASENAME}-ti-serdes.dtbo \
    freescale/${KERNEL_DEVICETREE_BASENAME}-ti-serdes-combo.dtb \
    freescale/${KERNEL_DEVICETREE_BASENAME}-ti-serdes-combo.dtbo \
    freescale/${KERNEL_DEVICETREE_BASENAME}-tja1104-rgmii.dtb \
    freescale/${KERNEL_DEVICETREE_BASENAME}-tja1104-rmii.dtb \
"

UBOOT_CONFIG_BASENAME = "imx95_19x19_evk"

IMXBOOT_TARGETS_BASENAME = "flash"

OEI_BOARD  = "mx95lp5"
DDR_TYPE   = "lpddr5"
DDR_FIRMWARE_NAME = " \
    lpddr5_dmem_v202409.bin \
    lpddr5_dmem_qb_v202409.bin \
    lpddr5_imem_v202409.bin \
    lpddr5_imem_qb_v202409.bin \
"
OEI_DDR_CONFIG     = "MIMX95_LPDDR5_EVK_19X19_6400MTS_FW2024.09_timing"
OEI_DDR_CONFIG_ECC = "MIMX95_LPDDR5_EVK_19X19_6400MTS_FW2024.09_ECC_enabled_timing"

M4_DEFAULT_IMAGE = "${@bb.utils.contains('SYSTEM_MANAGER_CONFIG', 'mx95netc', 'imx95-19x19-evk_m7_TCM_netc_share.bin', \
                                                                              'imx95-19x19-evk_m7_TCM_power_mode_switch.bin', d)}"

IMAGE_BOOT_FILES:append = " \
    mcore-demos/imx95-19x19-evk_m7_TCM_flexcan_linux.bin \
    mcore-demos/imx95-19x19-evk_m7_TCM_hello_world.bin \
    mcore-demos/imx95-19x19-evk_m7_TCM_netc_share.bin \
    mcore-demos/imx95-19x19-evk_m7_TCM_power_mode_switch.bin \
    mcore-demos/imx95-19x19-evk_m7_TCM_rpmsg_lite_pingpong_rtos_linux_remote.bin \
    mcore-demos/imx95-19x19-evk_m7_TCM_rpmsg_lite_str_echo_rtos.bin \
    mcore-demos/imx95-19x19-evk_m7_TCM_sai_low_power_audio.bin \
    ${@bb.utils.contains('COMBINED_FEATURES', 'xen', 'xen', '', d)} \
"
```

## conf/machine/imx95-19x19-lpddr5-frdm-pro.conf
```bitbake
#@TYPE: Machine
#@NAME: NXP i.MX 95 19x19 FRDM Pro with LPDDR5
#@SOC: i.MX95
#@DESCRIPTION: Machine configuration for NXP i.MX 95 19x19 FRDM Pro with LPDDR5
#@MAINTAINER: Jun Zhu <junzhu@nxp.com>

MACHINEOVERRIDES =. "mx95:"

require conf/machine/include/imx95-evk.inc

MACHINE_FEATURES:append:use-nxp-bsp = " nxp9098-pcie"

KERNEL_DEVICETREE_BASENAME = "imx95-19x19-frdm-pro"

KERNEL_DEVICETREE:append:use-nxp-bsp = " \
    freescale/${KERNEL_DEVICETREE_BASENAME}.dtb \
    freescale/${KERNEL_DEVICETREE_BASENAME}-aqr113c.dtb \
    freescale/${KERNEL_DEVICETREE_BASENAME}-aud-hat.dtb \
    freescale/${KERNEL_DEVICETREE_BASENAME}-dual-os08a20-isp.dtb \
    freescale/${KERNEL_DEVICETREE_BASENAME}-inmate.dtb \
    freescale/${KERNEL_DEVICETREE_BASENAME}-neutron.dtb \
    freescale/${KERNEL_DEVICETREE_BASENAME}-os08a20-isp.dtb \
    freescale/${KERNEL_DEVICETREE_BASENAME}-os08a20-combo-isp.dtb \
    freescale/${KERNEL_DEVICETREE_BASENAME}-root.dtb \
    freescale/${KERNEL_DEVICETREE_BASENAME}-waveshare-7inch-c-panel.dtb \
"

UBOOT_CONFIG_BASENAME = "imx95_19x19_frdm_pro"
SYSTEM_MANAGER_CONFIG = "mx95frdm-pro"
IMXBOOT_TARGETS_BASENAME = "flash"

IMXBOOT_TARGETS = " \
    ${@bb.utils.contains('UBOOT_CONFIG', 'fspi',   '${IMXBOOT_TARGETS_BASENAME}_a55_flexspi', \
                                                   '${IMXBOOT_TARGETS_SD}',d)} \
"

OEI_BOARD  = "mx95lp5"
DDR_TYPE   = "lpddr5"
DDR_FIRMWARE_NAME = " \
    lpddr5_dmem_v202409.bin \
    lpddr5_dmem_qb_v202409.bin \
    lpddr5_imem_v202409.bin \
    lpddr5_imem_qb_v202409.bin \
"
OEI_DDR_CONFIG     = "MIMX95_LPDDR5_EVK_19X19_6400MTS_FW2024.09_timing"
OEI_DDR_CONFIG_ECC = "MIMX95_LPDDR5_EVK_19X19_6400MTS_FW2024.09_ECC_enabled_timing"

M4_DEFAULT_IMAGE = "imx95-19x19-frdm_m7_TCM_power_mode_switch.bin"

IMAGE_BOOT_FILES:append = " \
    mcore-demos/imx95-19x19-frdm_m7_TCM_hello_world.bin \
    mcore-demos/imx95-19x19-frdm_m7_TCM_power_mode_switch.bin \
    mcore-demos/imx95-19x19-frdm_m7_TCM_rpmsg_lite_pingpong_rtos_linux_remote.bin \
    mcore-demos/imx95-19x19-frdm_m7_TCM_rpmsg_lite_str_echo_rtos.bin \
    ${@bb.utils.contains('COMBINED_FEATURES', 'xen', 'xen', '', d)} \
"
```

## conf/machine/imx952-15x15-lpddr5-frdm.conf
```bitbake
#@TYPE: Machine
#@NAME: NXP i.MX 952 15x15 FRDM with LPDDR5
#@SOC: i.MX952
#@DESCRIPTION: Machine configuration for NXP i.MX 952 FRDM with LPDDR5
#@MAINTAINER: Flora Hu <flora.hu@nxp.com>

require conf/machine/include/imx952-evk.inc

KERNEL_DEVICETREE_BASENAME = "imx952-frdm"

MACHINE_FEATURES:append:use-nxp-bsp = " nxpiw612-sdio"

KERNEL_DEVICETREE:append:use-nxp-bsp = " \
    freescale/imx952-jailhouse-inmate.dtb \
    freescale/${KERNEL_DEVICETREE_BASENAME}-ap1302-csi0-2lanes.dtb \
    freescale/${KERNEL_DEVICETREE_BASENAME}-ap1302-csi1-2lanes.dtb \
    freescale/${KERNEL_DEVICETREE_BASENAME}-aud-hat.dtb \
    freescale/${KERNEL_DEVICETREE_BASENAME}-aud-hat.dtbo \
    freescale/${KERNEL_DEVICETREE_BASENAME}-boe-wxga-lvds-panel.dtb \
    freescale/${KERNEL_DEVICETREE_BASENAME}-boe-wxga-lvds-panel.dtbo \
    freescale/${KERNEL_DEVICETREE_BASENAME}-dual-ap1302.dtb \
    freescale/${KERNEL_DEVICETREE_BASENAME}-os08a20-csi0-2lanes.dtb \
    freescale/${KERNEL_DEVICETREE_BASENAME}-os08a20-csi0-2lanes.dtbo \
    freescale/${KERNEL_DEVICETREE_BASENAME}-os08a20-csi1-2lanes.dtb \
    freescale/${KERNEL_DEVICETREE_BASENAME}-os08a20-csi1-2lanes.dtbo \
    freescale/${KERNEL_DEVICETREE_BASENAME}-os08a20-dual.dtb \
    freescale/${KERNEL_DEVICETREE_BASENAME}-pcie-ep.dtb \
    freescale/${KERNEL_DEVICETREE_BASENAME}-root.dtb \
    freescale/${KERNEL_DEVICETREE_BASENAME}-v2x-she0.dtb \
    freescale/${KERNEL_DEVICETREE_BASENAME}-waveshare-7inch-c-panel.dtb \
    freescale/${KERNEL_DEVICETREE_BASENAME}-waveshare-7inch-c-panel.dtbo \
"

UBOOT_CONFIG_BASENAME = "imx952_frdm"

IMXBOOT_TARGETS_BASENAME = "flash"

OEI_BOARD  = "mx952lp5-15-frdm"
DDR_TYPE   = "lpddr5"
OEI_DDR_CONFIG  = "MIMX952_LPDDR5_FRDM_15X15_4266MTS_FW2024.09-SP2_timing"
OEI_DDR_CONFIG_ECC = "MIMX952_LPDDR5_FRDM_15X15_4266MTS_FW2024.09-SP2_ECC_enabled_timing"

# Multiple system manager configs by IMXBOOT_VARIANT
SYSTEM_MANAGER_CONFIG = \
    "${@bb.utils.contains('IMXBOOT_VARIANT', 'alt',       'mx952alt', \
        bb.utils.contains('IMXBOOT_VARIANT', 'jailhouse', 'mx952evkjailhouse', \
        bb.utils.contains('IMXBOOT_VARIANT', 'netc',      'mx952evknetc', \
        bb.utils.contains('IMXBOOT_VARIANT', 'rpmsg',     'mx952frdmrpmsg', \
                                                          'mx952evk', d), d), d), d)}"

M4_DEFAULT_IMAGE_MX952 = "imx952-15x15-frdm_m7_TCM_power_mode_switch.bin"

DDR_FIRMWARE_NAME = " \
    lpddr5_dmem_v202409.bin \
    lpddr5_dmem_qb_v202409.bin \
    lpddr5_imem_v202409.bin \
    lpddr5_imem_qb_v202409.bin \
"

IMAGE_BOOT_FILES:append = " \
    mcore-demos/imx952-15x15-frdm_m7_TCM_hello_world.bin \
    mcore-demos/imx952-15x15-frdm_m7_TCM_power_mode_switch.bin \
    mcore-demos/imx952-15x15-frdm_m7_TCM_rpmsg_lite_pingpong_rtos_linux_remote.bin \
    mcore-demos/imx952-15x15-frdm_m7_TCM_rpmsg_lite_str_echo_rtos.bin \
"
```
