## conf/machine/imx952-19x19-lpddr5-evk.conf
```bitbake
#@TYPE: Machine
#@NAME: NXP i.MX 952 19x19 Evaluation Kit with LPDDR5
#@SOC: i.MX952
#@DESCRIPTION: Machine configuration for NXP i.MX 952 19x19 EVK with LPDDR5
#@MAINTAINER: Jun Zhu <junzhu@nxp.com>

require conf/machine/include/imx952-evk.inc

KERNEL_DEVICETREE_BASENAME = "imx952-evk"
MACHINE_FEATURES:append:use-nxp-bsp = " nxpaw693-pcie"

KERNEL_DEVICETREE:append:use-nxp-bsp = " \
    freescale/imx952-jailhouse-inmate.dtb \
    freescale/${KERNEL_DEVICETREE_BASENAME}-adv7535.dtb \
    freescale/${KERNEL_DEVICETREE_BASENAME}-adv7535.dtbo \
    freescale/${KERNEL_DEVICETREE_BASENAME}-adv7535-ap1302-csi0-2lanes.dtb \
    freescale/${KERNEL_DEVICETREE_BASENAME}-adv7535-ap1302-csi0-4lanes.dtb \
    freescale/${KERNEL_DEVICETREE_BASENAME}-ap1302-csi0-2lanes.dtb \
    freescale/${KERNEL_DEVICETREE_BASENAME}-ap1302-csi0-2lanes.dtbo \
    freescale/${KERNEL_DEVICETREE_BASENAME}-ap1302-csi0-4lanes.dtb \
    freescale/${KERNEL_DEVICETREE_BASENAME}-ap1302-csi0-4lanes.dtbo \
    freescale/${KERNEL_DEVICETREE_BASENAME}-audmix.dtb \
    freescale/${KERNEL_DEVICETREE_BASENAME}-crrm.dtb \
    freescale/${KERNEL_DEVICETREE_BASENAME}-cs42888.dtb \
    freescale/${KERNEL_DEVICETREE_BASENAME}-dsi-serdes.dtb \
    freescale/${KERNEL_DEVICETREE_BASENAME}-i3c.dtb \
    freescale/${KERNEL_DEVICETREE_BASENAME}-it6263-lvds0.dtb \
    freescale/${KERNEL_DEVICETREE_BASENAME}-it6263-lvds0.dtbo \
    freescale/${KERNEL_DEVICETREE_BASENAME}-it6263-lvds0-ox03c10-csi0.dtb \
    freescale/${KERNEL_DEVICETREE_BASENAME}-it6263-lvds0-os08a20-csi0-2lanes.dtb \
    freescale/${KERNEL_DEVICETREE_BASENAME}-it6263-lvds0-os08a20-csi0-4lanes.dtb \
    freescale/${KERNEL_DEVICETREE_BASENAME}-it6263-lvds0-ox05b1s-csi0-4lanes.dtb \
    freescale/${KERNEL_DEVICETREE_BASENAME}-it6263-lvds0-os08a20-csi1-2lanes.dtb \
    freescale/${KERNEL_DEVICETREE_BASENAME}-it6263-lvds0-os08a20-dual.dtb \
    freescale/${KERNEL_DEVICETREE_BASENAME}-it6263-lvds1.dtb \
    freescale/${KERNEL_DEVICETREE_BASENAME}-it6263-lvds1.dtbo \
    freescale/${KERNEL_DEVICETREE_BASENAME}-it6263-lvds-two-disp.dtb \
    freescale/${KERNEL_DEVICETREE_BASENAME}-it6263-lvds-dual.dtb \
    freescale/${KERNEL_DEVICETREE_BASENAME}-it6263-lvds-dual.dtbo \
    freescale/${KERNEL_DEVICETREE_BASENAME}-jdi-wuxga-lvds-panel.dtb \
    freescale/${KERNEL_DEVICETREE_BASENAME}-jdi-wuxga-lvds-panel.dtbo \
    freescale/${KERNEL_DEVICETREE_BASENAME}-kd123c02.dtb \
    freescale/${KERNEL_DEVICETREE_BASENAME}-kd123c02.dtbo \
    freescale/${KERNEL_DEVICETREE_BASENAME}-lt9611uxc.dtb \
    freescale/${KERNEL_DEVICETREE_BASENAME}-lt9611uxc.dtbo \
    freescale/${KERNEL_DEVICETREE_BASENAME}-mqs.dtb \
    freescale/${KERNEL_DEVICETREE_BASENAME}-mqs.dtbo \
    freescale/${KERNEL_DEVICETREE_BASENAME}-netc-rpmsg.dtb \
    freescale/${KERNEL_DEVICETREE_BASENAME}-os08a20-csi0-2lanes.dtb \
    freescale/${KERNEL_DEVICETREE_BASENAME}-os08a20-csi0-2lanes.dtbo \
    freescale/${KERNEL_DEVICETREE_BASENAME}-os08a20-csi0-4lanes.dtb \
    freescale/${KERNEL_DEVICETREE_BASENAME}-os08a20-csi0-4lanes.dtbo \
    freescale/${KERNEL_DEVICETREE_BASENAME}-os08a20-csi1-2lanes.dtbo \
    freescale/${KERNEL_DEVICETREE_BASENAME}-ox03c10-csi0.dtb \
    freescale/${KERNEL_DEVICETREE_BASENAME}-ox03c10-csi0.dtbo \
    freescale/${KERNEL_DEVICETREE_BASENAME}-ox05b1s-csi0-4lanes.dtb \
    freescale/${KERNEL_DEVICETREE_BASENAME}-ox05b1s-csi0-4lanes.dtbo \
    freescale/${KERNEL_DEVICETREE_BASENAME}-pcie-ep.dtb \
    freescale/${KERNEL_DEVICETREE_BASENAME}-pcie-keym.dtb \
    freescale/${KERNEL_DEVICETREE_BASENAME}-pcie-keym.dtbo \
    freescale/${KERNEL_DEVICETREE_BASENAME}-rm692c9.dtb \
    freescale/${KERNEL_DEVICETREE_BASENAME}-rm692c9.dtbo \
    freescale/${KERNEL_DEVICETREE_BASENAME}-root.dtb \
    freescale/${KERNEL_DEVICETREE_BASENAME}-rpmsg.dtb \
    freescale/${KERNEL_DEVICETREE_BASENAME}-sgmii.dtb \
    freescale/${KERNEL_DEVICETREE_BASENAME}-tja1104-rgmii.dtb \
    freescale/${KERNEL_DEVICETREE_BASENAME}-tja1104-rmii.dtb \
    freescale/${KERNEL_DEVICETREE_BASENAME}-v2x-she0.dtb \
"

UBOOT_CONFIG_BASENAME = "imx952_evk"

IMXBOOT_TARGETS_BASENAME = "flash"

OEI_BOARD  = "mx952lp5-19"
DDR_TYPE   = "lpddr5"
DDR_FIRMWARE_NAME = " \
    lpddr5_dmem_v202409.bin \
    lpddr5_dmem_qb_v202409.bin \
    lpddr5_imem_v202409.bin \
    lpddr5_imem_qb_v202409.bin \
"
OEI_DDR_CONFIG     = "MIMX952_LPDDR5_EVK_19X19_6000MTS_FW2024.09-SP2_timing"
OEI_DDR_CONFIG_ECC = "MIMX952_LPDDR5_EVK_19X19_6000MTS_FW2024.09-SP2_ECC_enabled_timing"

IMAGE_BOOT_FILES:append:imx-nxp-bsp = " \
    mcore-demos/imx952evk_m7_TCM_hello_world.bin \
    mcore-demos/imx952evk_m7_TCM_netc_share.bin \
    mcore-demos/imx952evk_m7_TCM_power_mode_switch.bin \
    mcore-demos/imx952evk_m7_TCM_rpmsg_lite_pingpong_rtos_linux_remote.bin \
    mcore-demos/imx952evk_m7_TCM_rpmsg_lite_str_echo_rtos.bin \
    mcore-demos/imx952evk_m7_TCM_sai_low_power_audio.bin \
"
```

## conf/machine/include/e6500.inc
```bitbake
TARGET_FPU = "hard"

require conf/machine/include/powerpc/tune-ppce6500.inc
require conf/machine/include/qoriq-ppc.inc

MACHINEOVERRIDES =. "e6500:"

BUILD_64BIT_KERNEL = "1"
```

## conf/machine/include/imx91-evk.inc
```bitbake
require conf/machine/include/imx-base.inc
require conf/machine/include/arm/armv8-2a/tune-cortexa55.inc

MACHINE_FEATURES += "pci wifi bluetooth"
MACHINE_FEATURES:append:use-nxp-bsp = " dpdk optee nxpiw610-sdio nxpwifi-all-sdio nxpwifi-all-usb"

KERNEL_DEVICETREE = " \
    freescale/${KERNEL_DEVICETREE_BASENAME}.dtb \
"
UBOOT_DTB_NAME = "${KERNEL_DEVICETREE_BASENAME}.dtb"

IMX_DEFAULT_BOOTLOADER:use-nxp-bsp = "u-boot-imx"
IMX_DEFAULT_BOOTLOADER:use-mainline-bsp = "u-boot-fslc"

LOADADDR = ""
UBOOT_SUFFIX = "bin"
UBOOT_MAKE_TARGET = ""

SPL_BINARY = "spl/u-boot-spl.bin"

UBOOT_CONFIG ??= "sd"
UBOOT_CONFIG[sd]   = "${UBOOT_CONFIG_BASENAME}_defconfig"
UBOOT_CONFIG[ecc] = "${UBOOT_CONFIG_BASENAME}_inline_ecc_defconfig"

# Set ATF platform name
ATF_PLATFORM = "imx91"

IMXBOOT_TARGETS_SD   = "flash_singleboot flash_singleboot_gdet flash_singleboot_gdet_auto"
IMXBOOT_TARGETS_ECC  = "flash_singleboot"
IMXBOOT_TARGETS_NAND = "flash_singleboot_spinand flash_singleboot_spinand_fw"
IMXBOOT_TARGETS_FSPI = "flash_singleboot_flexspi"

IMXBOOT_TARGETS = "${@bb.utils.contains('UBOOT_CONFIG', 'nand', '${IMXBOOT_TARGETS_NAND}', \
                      bb.utils.contains('UBOOT_CONFIG', 'fspi', '${IMXBOOT_TARGETS_FSPI}', \
                      bb.utils.contains('UBOOT_CONFIG', 'ecc',  '${IMXBOOT_TARGETS_ECC}', \
                                                                '${IMXBOOT_TARGETS_SD}', d), d), d)}"

IMX_BOOT_SOC_TARGET = "iMX91"
IMX_BOOT_SEEK = "32"

# We have to disable SERIAL_CONSOLE due to auto-serial-console
SERIAL_CONSOLES = "115200;ttyLP0"

IMX_DEFAULT_BSP = "nxp"
```

## conf/machine/include/imx937-evk.inc
```bitbake
MACHINEOVERRIDES =. "mx937:"

require conf/machine/include/imx-base.inc
require conf/machine/include/arm/armv8-2a/tune-cortexa55.inc

MACHINE_FEATURES += "pci wifi bluetooth"
MACHINE_FEATURES:append:use-nxp-bsp = " optee nxpiw612-sdio jailhouse"

KERNEL_DEVICETREE = " \
    freescale/${KERNEL_DEVICETREE_BASENAME}.dtb \
"
UBOOT_DTB_NAME = "${KERNEL_DEVICETREE_BASENAME}.dtb"

IMX_DEFAULT_BOOTLOADER:use-nxp-bsp = "u-boot-imx"
IMX_DEFAULT_BOOTLOADER:use-mainline-bsp = "u-boot-fslc"

LOADADDR = ""
UBOOT_SUFFIX = "bin"
UBOOT_MAKE_TARGET = ""

SPL_BINARY = "spl/u-boot-spl.bin"

UBOOT_CONFIG ??= "sd"
UBOOT_CONFIG[sd] = "${UBOOT_CONFIG_BASENAME}_defconfig"
UBOOT_CONFIG[sd-ecc] = "${UBOOT_CONFIG_BASENAME}_defconfig"

ATF_PLATFORM = "imx937"

OEI_CORE   = "m33"
OEI_SOC    = "mx937"
OEI_BOARD  ?= "mx937lp5"

DDR_TYPE   ?= "lpddr5"

SYSTEM_MANAGER_FIRMWARE_BASENAME = "m33_image"

IMXBOOT_VARIANTS = "alt jailhouse rpmsg"

# Multiple system manager configs by IMXBOOT_VARIANT
SYSTEM_MANAGER_CONFIG = \
    "${@bb.utils.contains('IMXBOOT_VARIANT', 'alt',       'mx937alt', \
        bb.utils.contains('IMXBOOT_VARIANT', 'jailhouse', 'mx937frdmjailhouse', \
        bb.utils.contains('IMXBOOT_VARIANT', 'rpmsg',     'mx937frdmrpmsg', \
                                                          '${SYSTEM_MANAGER_CONFIG_DEFAULT}', d), d), d)}"

# imx-boot (flash.bin) targets based on UBOOT_CONFIG and IMXBOOT_VARIANT
IMXBOOT_TARGETS_SD = " \
    ${@bb.utils.contains('IMXBOOT_VARIANT', 'alt',       '${IMXBOOT_TARGETS_BASENAME}_all', \
       bb.utils.contains('IMXBOOT_VARIANT', 'jailhouse', '${IMXBOOT_TARGETS_BASENAME}_jailhouse', \
       bb.utils.contains('IMXBOOT_VARIANT', 'rpmsg',     '${IMXBOOT_TARGETS_BASENAME}_lpboot_sm_a55', \
                                                         '${IMXBOOT_TARGETS_BASENAME}_all ${IMXBOOT_TARGETS_BASENAME}_a55', d), d), d)} \
"
IMXBOOT_TARGETS = " \
    ${@bb.utils.contains('UBOOT_CONFIG', 'sd-ecc', '${IMXBOOT_TARGETS_BASENAME}_all', \
                                                   '${IMXBOOT_TARGETS_SD}', d)} \
"

IMX_BOOT_SOC_TARGET = "iMX937"
IMX_BOOT_SEEK = "32"

# We have to disable SERIAL_CONSOLE due to auto-serial-console
SERIAL_CONSOLES = "115200;ttyLP0"

IMX_DEFAULT_BSP = "nxp"
```

## conf/machine/include/imx952-evk.inc
```bitbake
MACHINEOVERRIDES =. "mx952:"

require conf/machine/include/imx-base.inc
require conf/machine/include/arm/armv8-2a/tune-cortexa55.inc

MACHINE_FEATURES += "pci wifi bluetooth"
MACHINE_FEATURES:append:use-nxp-bsp = " crrm jailhouse optee xen"

KERNEL_DEVICETREE = " \
    freescale/${KERNEL_DEVICETREE_BASENAME}.dtb \
"
UBOOT_DTB_NAME = "${KERNEL_DEVICETREE_BASENAME}.dtb"

IMX_DEFAULT_BOOTLOADER:use-nxp-bsp = "u-boot-imx"
IMX_DEFAULT_BOOTLOADER:use-mainline-bsp = "u-boot-fslc"

LOADADDR = ""
UBOOT_SUFFIX = "bin"
UBOOT_MAKE_TARGET = ""

SPL_BINARY = "spl/u-boot-spl.bin"

UBOOT_CONFIG ??= "${@bb.utils.contains('COMBINED_FEATURES', 'crrm', 'crrm', 'sd', d)}"
UBOOT_CONFIG[sd] = "${UBOOT_CONFIG_BASENAME}_defconfig"
UBOOT_CONFIG[sd-ecc] = "${UBOOT_CONFIG_BASENAME}_defconfig"
UBOOT_CONFIG[crrm] = "${UBOOT_CONFIG_BASENAME}_xspi_crrm_defconfig"
UBOOT_CONFIG[xspi] = "${UBOOT_CONFIG_BASENAME}_xspi_defconfig"

ATF_PLATFORM = "imx952"

OEI_CORE   = "m33"
OEI_SOC    = "mx952"
OEI_BOARD  ?= "mx95lp5"

DDR_TYPE   ?= "lpddr5"

IMXBOOT_VARIANTS = "alt jailhouse netc rpmsg"

# Multiple system manager configs by IMXBOOT_VARIANT
SYSTEM_MANAGER_CONFIG = \
    "${@bb.utils.contains('IMXBOOT_VARIANT', 'alt',       'mx952alt', \
        bb.utils.contains('IMXBOOT_VARIANT', 'jailhouse', 'mx952evkjailhouse', \
        bb.utils.contains('IMXBOOT_VARIANT', 'netc',      'mx952evknetc', \
        bb.utils.contains('IMXBOOT_VARIANT', 'rpmsg',     'mx952evkrpmsg', \
                                                          'mx952evk', d), d), d), d)}"

# imx-boot (flash.bin) targets based on UBOOT_CONFIG and IMXBOOT_VARIANT
IMXBOOT_TARGETS_SD = " \
    ${@bb.utils.contains('IMXBOOT_VARIANT', 'alt',       '${IMXBOOT_TARGETS_BASENAME}_all', \
       bb.utils.contains('IMXBOOT_VARIANT', 'jailhouse', '${IMXBOOT_TARGETS_BASENAME}_jailhouse', \
       bb.utils.contains('IMXBOOT_VARIANT', 'netc',      '${IMXBOOT_TARGETS_BASENAME}_all', \
       bb.utils.contains('IMXBOOT_VARIANT', 'rpmsg',     '${IMXBOOT_TARGETS_BASENAME}_lpboot_sm_a55', \
                                                         '${IMXBOOT_TARGETS_BASENAME}_all ${IMXBOOT_TARGETS_BASENAME}_a55', d), d), d), d)} \
"
IMXBOOT_TARGETS = " \
    ${@bb.utils.contains('UBOOT_CONFIG', 'crrm',   '${IMXBOOT_TARGETS_BASENAME}_a55_xspi_crrm', \
       bb.utils.contains('UBOOT_CONFIG', 'sd-ecc', '${IMXBOOT_TARGETS_BASENAME}_all', \
       bb.utils.contains('UBOOT_CONFIG', 'xspi',   '${IMXBOOT_TARGETS_BASENAME}_a55_xspi', \
                                                   '${IMXBOOT_TARGETS_SD}', d), d), d)} \
"

M4_DEFAULT_IMAGE_MX952 = "${@bb.utils.contains('IMXBOOT_VARIANT', 'netc', 'imx952evk_m7_TCM_netc_share.bin', \
                                                                          'imx952evk_m7_TCM_power_mode_switch.bin', d)}"

IMX_BOOT_SOC_TARGET = "iMX952"
IMX_BOOT_SEEK = "32"

# We have to disable SERIAL_CONSOLE due to auto-serial-console
SERIAL_CONSOLES = "115200;ttyLP0"

IMX_DEFAULT_BSP = "nxp"

IMAGE_BOOT_FILES:append:imx-nxp-bsp = " \
    ${@bb.utils.contains('COMBINED_FEATURES', 'xen', 'xen', '', d)} \
"
```
