## conf/machine/ls1046ardb-32b.conf
```bitbake
#@TYPE: Machine
#@NAME: NXP LS1046ARDB
#@SOC: LSCH2
#@DESCRIPTION: Machine configuration for running LS1046A in 32-bit mode
#@MAINTAINER: Zhenhua Luo <zhenhua.luo@nxp.com>

MACHINEOVERRIDES =. "fsl-lsch2:fsl-lsch2-32b:ls1046a:"

require conf/machine/include/qoriq-arm.inc
require conf/machine/include/arm/arch-arm64.inc

DEFAULTTUNE = "armv7ahf-neon"

UBOOT_CONFIG ??= "emmc sdcard qspi"
UBOOT_CONFIG[emmc] = "ls1046ardb_aarch32_emmc_defconfig,,u-boot-with-spl-pbl.bin"
UBOOT_CONFIG[sdcard] = "ls1046ardb_aarch32_sdcard_defconfig,,u-boot-with-spl-pbl.bin"
UBOOT_CONFIG[qspi] = "ls1046ardb_aarch32_qspi_config,,u-boot-dtb.bin"

KERNEL_DEVICETREE ?= "\
    freescale/fsl-ls1046a-rdb.dtb \
    freescale/fsl-ls1046a-rdb-usdpaa.dtb \
"
KERNEL_DEFCONFIG ?= "${S}/arch/arm/configs/ls_aarch32_defconfig"

SERIAL_CONSOLES ?= "115200;ttyS0 115200;ttyAMA0 115200;ttyLP0"
SERIAL_CONSOLES_CHECK ?= "${SERIAL_CONSOLES}"

EXTRA_IMAGEDEPENDS += "fm-ucode rcw"
USE_VT = "0"

require conf/multilib.conf
MULTILIBS ?= "multilib:lib64"
DEFAULTTUNE_virtclass-multilib-lib64 ?= "aarch64"
```

## conf/machine/ls1046ardb.conf
```bitbake
#@TYPE: Machine
#@NAME: NXP LS1046ARDB
#@SOC: LSCH2
#@DESCRIPTION: Machine configuration for running LS1046A in 64-bit mode
#@MAINTAINER: Zhenhua Luo <zhenhua.luo@nxp.com>

MACHINEOVERRIDES =. "fsl-lsch2:ls1046a:"

require conf/machine/include/qoriq-arm64.inc
require conf/machine/include/arm/arch-arm64.inc

MACHINE_FEATURES += "optee"

KERNEL_CLASSES  = " kernel-fitimage "
KERNEL_IMAGETYPES = "fitImage"

UBOOT_DTB_LOADADDRESS = "0x90000000"
UBOOT_ENTRYPOINT = "0x80080000"

UBOOT_CONFIG ??= "tfa-secure-boot tfa"
UBOOT_CONFIG[tfa] = "ls1046ardb_tfa_defconfig"
UBOOT_CONFIG[tfa-secure-boot] = "ls1046ardb_tfa_SECURE_BOOT_defconfig"

KERNEL_DEVICETREE ?= "\
    freescale/fsl-ls1046a-rdb.dtb \
    freescale/fsl-ls1046a-qds.dtb \
"
# usdpaa dtb is used for dpdk. TODO: rename in kernel
KERNEL_DEVICETREE:prepend:use-nxp-bsp = "\
    freescale/fsl-ls1046a-rdb-sdk.dtb \
    freescale/fsl-ls1046a-rdb-usdpaa.dtb \
    freescale/fsl-ls1046a-rdb-usdpaa-shared.dtb \
    freescale/fsl-ls1046a-qds-sdk.dtb \
"
KERNEL_DEFCONFIG ?= "defconfig"

SERIAL_CONSOLES ?= "115200;ttyS0 115200;ttyAMA0 115200;ttyLP0"
SERIAL_CONSOLES_CHECK ?= "${SERIAL_CONSOLES}"

UEFI_QSPIBOOT ?= "LS1046ARDB_EFI_QSPIBOOT.fd"
RCWQSPI ?= "RR_FFSSPPPH_1133_5559/rcw_1800_qspiboot"
RCWSD ?= "RR_FFSSPPPH_1133_5559/rcw_1800_sdboot"

FMAN_UCODE ?= "fsl_fman_ucode_ls1046_r1.0_106_4_18.bin"

EXTRA_IMAGEDEPENDS += "fm-ucode rcw uefi qoriq-atf qe-ucode ls2-phy"
USE_VT = "0"
```

## conf/machine/ls1088ardb-pb.conf
```bitbake
#@TYPE: Machine
#@NAME: NXP LS1088ARDB
#@SOC: LSCH3
#@DESCRIPTION: Machine configuration for running LS1088ARDB in 64-bit mode
#@MAINTAINER: Chunrong Guo <Chunrong.Guo@nxp.com>

MACHINEOVERRIDES =. "fsl-lsch3:ls1088a:"

require conf/machine/include/qoriq-arm64.inc
require conf/machine/include/arm/arch-arm64.inc

MACHINE_FEATURES += "optee"

KERNEL_CLASSES  = " kernel-fitimage "
KERNEL_IMAGETYPES = "fitImage"

UBOOT_DTB_LOADADDRESS = "0x90000000"
UBOOT_ENTRYPOINT = "0x80080000"

UBOOT_CONFIG ??= "tfa-secure-boot tfa"
UBOOT_CONFIG[tfa] = "ls1088ardb_tfa_defconfig"
UBOOT_CONFIG[tfa-secure-boot] = "ls1088ardb_tfa_SECURE_BOOT_defconfig"

KERNEL_DEVICETREE ?= "freescale/fsl-ls1088a-rdb.dtb"
KERNEL_DEFCONFIG ?= "defconfig"

SERIAL_CONSOLES ?= "115200;ttyS0 115200;ttyS1 115200;ttyAMA0"
SERIAL_CONSOLES_CHECK ?= "${SERIAL_CONSOLES}"

RCWSD ?= "FCSSRR_PPPP_0x1d_0x13/rcw_1600_sd"
RCWQSPI ?= "FCSSRR_PPPP_0x1d_0x13/rcw_1600_qspi"


EXTRA_IMAGEDEPENDS += "mc-utils rcw management-complex qoriq-atf"
USE_VT = "0"
```

## conf/machine/ls1088ardb.conf
```bitbake
#@TYPE: Machine
#@NAME: NXP LS1088ARDB
#@SOC: LSCH3
#@DESCRIPTION: Machine configuration for running LS1088ARDB in 64-bit mode
#@MAINTAINER: Zongchun Yu <Zongchun.Yu@nxp.com>

require conf/machine/include/qoriq-arm64.inc
require conf/machine/include/arm/arch-arm64.inc

MACHINEOVERRIDES =. "fsl-lsch3:ls1088a:"

MACHINE_FEATURES += "optee"

KERNEL_CLASSES  = " kernel-fitimage "
KERNEL_IMAGETYPES = "fitImage"

UBOOT_DTB_LOADADDRESS = "0x90000000"
UBOOT_ENTRYPOINT = "0x80080000"

UBOOT_CONFIG ??= "tfa-secure-boot tfa"
UBOOT_CONFIG[tfa-secure-boot] = "ls1088ardb_tfa_SECURE_BOOT_defconfig,,u-boot-dtb.bin"
UBOOT_CONFIG[tfa] = "ls1088ardb_tfa_defconfig,,u-boot-dtb.bin"

KERNEL_DEVICETREE ?= "freescale/fsl-ls1088a-rdb.dtb"
KERNEL_DEFCONFIG ?= "defconfig"

SERIAL_CONSOLES ?= "115200;ttyS0 115200;ttyS1 115200;ttyAMA0"
SERIAL_CONSOLES_CHECK ?= "${SERIAL_CONSOLES}"

RCWSD ?= "FCQQQQQQQQ_PPP_H_0x1d_0x0d/rcw_1600_sd"
RCWQSPI ?= "FCQQQQQQQQ_PPP_H_0x1d_0x0d/rcw_1600_qspi"

EXTRA_IMAGEDEPENDS += "mc-utils rcw management-complex atf"
USE_VT = "0"
```

## conf/machine/ls2080ardb.conf
```bitbake
#@TYPE: Machine
#@NAME: NXP LS2080ARDB board
#@SOC: LSCH3
#@DESCRIPTION: Machine configuration for NXP QorIQ LS2080ARDB
#              with ARM Cortext-A57 core
#@MAINTAINER: Zongchun Yu <Zongchun.Yu@nxp.com>

MACHINEOVERRIDES =. "fsl-lsch3:ls2080a:"

require conf/machine/include/qoriq-arm64.inc
require conf/machine/include/arm/arch-arm64.inc

UBOOT_CONFIG ??= "nor"
UBOOT_CONFIG[nor] = "ls2080ardb_defconfig,,u-boot-dtb.bin"

KERNEL_DEVICETREE ?= "freescale/fsl-ls2080a-rdb.dtb"
KERNEL_DEFCONFIG ?= "${S}/arch/arm64/configs/defconfig"

EXTRA_IMAGEDEPENDS += "dpl-examples ls2-phy ls2-rcw management-complex"
USE_VT = "0"
```

## conf/machine/ls2088ardb.conf
```bitbake
#@TYPE: Machine
#@NAME: NXP LS2088ARDB
#@SOC: LSCH3
#@DESCRIPTION: Machine configuration for running LS2088ARDB in 64-bit mode
#@MAINTAINER: Zongchun Yu <Zongchun.Yu@nxp.com>

require conf/machine/include/qoriq-arm64.inc
require conf/machine/include/arm/arch-arm64.inc

MACHINEOVERRIDES =. "fsl-lsch3:ls2088a:"

MACHINE_FEATURES += "optee"

KERNEL_CLASSES  = " kernel-fitimage "
KERNEL_IMAGETYPES = "fitImage"

UBOOT_DTB_LOADADDRESS = "0x90000000"
UBOOT_ENTRYPOINT = "0x80080000"

UBOOT_CONFIG ??= "tfa-secure-boot tfa"
UBOOT_CONFIG[tfa] = "ls2088ardb_tfa_defconfig,,u-boot-dtb.bin"
UBOOT_CONFIG[tfa-secure-boot] = "ls2088ardb_tfa_SECURE_BOOT_defconfig,,u-boot-dtb.bin"

RCWNOR ?= "FFFFFFFF_PP_HH_0x2a_0x41/rcw_1800"
RCWQSPI?= "FFFFFFFF_PP_HH_0x2a_0x41/rcw_2000_qspi"
UEFI_NORBOOT ?= "LS2088ARDB_EFI_NORBOOT.fd"

KERNEL_DEVICETREE ?= "freescale/fsl-ls2088a-rdb.dtb freescale/fsl-ls2088a-qds.dtb"
KERNEL_DEFCONFIG ?= "defconfig"

SERIAL_CONSOLES ?= "115200;ttyS0 115200;ttyS1 115200;ttyAMA0"
SERIAL_CONSOLES_CHECK ?= "${SERIAL_CONSOLES}"

EXTRA_IMAGEDEPENDS += "mc-utils ls2-phy rcw management-complex uefi atf"
USE_VT = "0"
```

## conf/machine/lx2160ardb.conf
```bitbake
#@TYPE: Machine
#@NAME: NXP LX2160ARDB
#@SOC: LSCH3
#@DESCRIPTION: Machine configuration for running LX2160ARDB in 64-bit mode
#@MAINTAINER: Zongchun Yu <Zongchun.Yu@nxp.com>

require conf/machine/include/qoriq-arm64.inc
require conf/machine/include/arm/arch-arm64.inc

MACHINEOVERRIDES =. "fsl-lsch3:lx2160a:"

MACHINE_FEATURES += "optee"

KERNEL_CLASSES  = " kernel-fitimage "
KERNEL_IMAGETYPES = "fitImage"

DTB_LOAD = "0x90000000"
UBOOT_ENTRYPOINT = "0x80080000"

UBOOT_CONFIG ??= "tfa-secure-boot tfa"
UBOOT_CONFIG[tfa] = "lx2160ardb_tfa_defconfig"
UBOOT_CONFIG[tfa-secure-boot] = "lx2160ardb_tfa_SECURE_BOOT_defconfig"

KERNEL_DEVICETREE ?= "freescale/fsl-lx2160a-rdb.dtb freescale/fsl-lx2160a-qds.dtb"
KERNEL_DEFCONFIG ?= "defconfig"

SERIAL_CONSOLES ?= "115200;ttyS0 115200;ttyS1 115200;ttyAMA0"
SERIAL_CONSOLES_CHECK ?= "${SERIAL_CONSOLES}"

UEFI_XSPIBOOT ?= "LX2160ARDB_EFI_NORBOOT.fd"
RCWXSPI ?= "XGGFF_PP_HHHH_RR_19_5_2/rcw_2200_750_3200_19_5_2"
RCWSD ?= "XGGFF_PP_HHHH_RR_19_5_2/rcw_2200_750_3200_19_5_2"
RCWEMMC ?= "XGGFF_PP_HHHH_RR_19_5_2/rcw_2200_750_3200_19_5_2"

EXTRA_IMAGEDEPENDS += "management-complex mc-utils rcw ls2-phy ddr-phy uefi qoriq-atf inphi"
USE_VT = "0"
```

## conf/machine/lx2162aqds.conf
```bitbake
#@TYPE: Machine
#@NAME: NXP LX2162AQDS
#@SOC: LSCH3
#@DESCRIPTION: Machine configuration for running LX2162AQDS in 64-bit mode
#@MAINTAINER: Zongchun Yu <Zongchun.Yu@nxp.com>

require conf/machine/include/qoriq-arm64.inc
require conf/machine/include/arm/arch-arm64.inc

MACHINEOVERRIDES =. "fsl-lsch3:lx2162a:"

MACHINE_FEATURES += "optee"

KERNEL_CLASSES  = " kernel-fitimage "
KERNEL_IMAGETYPES = "fitImage"

DTB_LOAD = "0x90000000"
UBOOT_ENTRYPOINT = "0x80080000"

UBOOT_CONFIG ??= "tfa-verified-boot tfa-secure-boot tfa"
UBOOT_CONFIG[tfa] = "lx2162aqds_tfa_defconfig"
UBOOT_CONFIG[tfa-secure-boot] = "lx2162aqds_tfa_SECURE_BOOT_defconfig"
UBOOT_CONFIG[tfa-verified-boot] = "lx2162aqds_tfa_verified_boot_defconfig,,u-boot-nodtb.bin"

KERNEL_DEVICETREE ?= "freescale/fsl-lx2162a-qds.dtb"
KERNEL_DEFCONFIG ?= "defconfig"

SERIAL_CONSOLES ?= "115200;ttyS0 115200;ttyS1 115200;ttyAMA0"
SERIAL_CONSOLES_CHECK ?= "${SERIAL_CONSOLES}"

RCWXSPI ?= "GGGG_NNNN_PPPP_PPPP_RR_17_2/rcw_2000_650_2900_17_2"
RCWSD ?= "GGGG_NNNN_PPPP_PPPP_RR_17_2/rcw_2000_650_2900_17_2"
RCWEMMC ?= "GGGG_NNNN_PPPP_PPPP_RR_17_2/rcw_2000_650_2900_17_2"

EXTRA_IMAGEDEPENDS += "management-complex mc-utils rcw ls2-phy ddr-phy qoriq-atf inphi"
USE_VT = "0"
```

## conf/machine/mpc8548cds.conf
```bitbake
#@TYPE: Machine
#@Name: NXP MPC8548CDS
#@DESCRIPTION: Machine configuration for the NXP MPC8548CDS
#@MAINTAINER: Chunrong Guo <chunrong.guo@nxp.com>

require conf/machine/include/e500v2.inc

UBOOT_CONFIG ??= "nor"
UBOOT_CONFIG[nor] = "MPC8548CDS_defconfig,,u-boot-with-dtb.bin"

KERNEL_DEVICETREE = "mpc8548cds_32b.dtb"
KERNEL_DEFCONFIG = "mpc85xx_defconfig"

USE_VT ?= "0"
```

## conf/machine/p1010rdb.conf
```bitbake
#@TYPE: Machine
#@Name: Freescale P1010RDB
#@SOC: p1010
#@DESCRIPTION: Machine configuration for Freescale QorIQ P1010 Reference
#              Design Board with ppce500v2 core
#@MAINTAINER: Chunrong Guo <B40290@freescale.com>

require conf/machine/include/e500v2.inc

SOC_FAMILY = "p1010"
BOOTFORMAT_CONFIG = "config_sram_p1010rdb.dat"

UBOOT_CONFIG ??= "nor nand spi 36bit-nor 36bit-nand 36bit-spi \
36bit-nand-secboot 36bit-nor-secboot 36bit-spi-secboot nand-secboot \
nor-secboot spi-secboot"
UBOOT_CONFIG[nor] = "P1010RDB-PB_NOR_config"
UBOOT_CONFIG[nand] = "P1010RDB-PB_NAND_config"
UBOOT_CONFIG[spi] = "P1010RDB-PB_SPIFLASH_config"
UBOOT_CONFIG[36bit-nor] = "P1010RDB-PB_36BIT_NOR_config"
UBOOT_CONFIG[36bit-nand] = "P1010RDB-PB_36BIT_NAND_config"
UBOOT_CONFIG[36bit-spi] = "P1010RDB-PB_36BIT_SPIFLASH_config"
UBOOT_CONFIG[36bit-nand-secboot] = "P1010RDB-PB_36BIT_NAND_SECBOOT_config"
UBOOT_CONFIG[36bit-nor-secboot] = "P1010RDB-PB_36BIT_NOR_SECBOOT_config"
UBOOT_CONFIG[36bit-spi-secboot] = "P1010RDB-PB_36BIT_SPIFLASH_SECBOOT_config"
UBOOT_CONFIG[nand-secboot] = "P1010RDB-PB_NAND_SECBOOT_config"
UBOOT_CONFIG[nor-secboot] = "P1010RDB-PB_NOR_SECBOOT_config"
UBOOT_CONFIG[spi-secboot] = "P1010RDB-PB_SPIFLASH_SECBOOT_config"

KERNEL_DEVICETREE ?= "p1010rdb-pa.dtb p1010rdb-pb.dtb"
KERNEL_DEFCONFIG ?= "${S}/arch/powerpc/configs/mpc85xx_defconfig"

JFFS2_ERASEBLOCK = "0x20000"
```

## conf/machine/p1020rdb.conf
```bitbake
#@TYPE: Machine
#@NAME: NXP P1020RDB
#@SOC: p1020
#@DESCRIPTION: Machine configuration for NXP QorIQ P1020 Reference
#              Design Board, revD with ppce500v2 core
#@MAINTAINER: Chunrong Guo <chunrong.guo@nxp.com>

require conf/machine/include/e500v2.inc

MACHINEOVERRIDES =. "p1020:"
BOOTFORMAT_CONFIG = "config_sram_p1022ds.dat"

UBOOT_CONFIG ??= "nand sdcard spi nor"
UBOOT_CONFIG[nor] = "P1020RDB-PD_config,,u-boot-with-dtb.bin"
UBOOT_CONFIG[nand] = "P1020RDB-PD_NAND_config,,u-boot-with-spl.bin"
UBOOT_CONFIG[sdcard] = "P1020RDB-PD_SDCARD_config,,u-boot-with-spl.bin"
UBOOT_CONFIG[spi] = "P1020RDB-PD_SPIFLASH_config,,u-boot-with-spl.bin"

UBOOT_SOURCE_NAND = "u-boot-with-spl.bin"
UBOOT_SOURCE_SPI = "u-boot-with-spl.bin"
UBOOT_SOURCE_SD = "u-boot-with-spl.bin"

KERNEL_DEVICETREE ?= "p1020rdb-pd.dtb"
KERNEL_DEFCONFIG ?= "mpc85xx_smp_defconfig"

JFFS2_ERASEBLOCK = "0x20000"

USE_VT ?= "0"
```

## conf/machine/p1021rdb.conf
```bitbake
#@TYPE: Machine
#@Name: Freescale P1021RDB
#@SOC: p1021
#@DESCRIPTION: Machine configuration for Freescale QorIQ P1021 Reference
#              Design Board, revC with ppce500v2 core
#@MAINTAINER: Chunrong Guo <B40290@freescale.com>

require conf/machine/include/e500v2.inc

SOC_FAMILY = "p1021"
BOOTFORMAT_CONFIG = "config_sram_p1022ds.dat"

UBOOT_CONFIG ??= "nor nand sdcard spi 36bit-nor 36bit-spi 36bit-nand 36bit-sdcard"
UBOOT_CONFIG[nor] = "P1021RDB-PC_config"
UBOOT_CONFIG[nand] = "P1021RDB-PC_NAND_config"
UBOOT_CONFIG[sdcard] = "P1021RDB-PC_SDCARD_config"
UBOOT_CONFIG[spi] = "P1021RDB-PC_SPIFLASH_config"
UBOOT_CONFIG[36bit-nor] = "P1021RDB-PC_36BIT_config"
UBOOT_CONFIG[36bit-spi] = "P1021RDB-PC_36BIT_SPIFLASH_config"
UBOOT_CONFIG[36bit-nand] = "P1021RDB-PC_36BIT_NAND_config"
UBOOT_CONFIG[36bit-sdcard] = "P1021RDB-PC_36BIT_SDCARD_config"

KERNEL_DEVICETREE ?= "p1021rdb-pc_32b.dtb"
KERNEL_DEFCONFIG ?= "${S}/arch/powerpc/configs/mpc85xx_smp_defconfig"

JFFS2_ERASEBLOCK = "0x20000"
QE_UCODE ?= "fsl_qe_ucode_1021_10_A.bin"

EXTRA_IMAGEDEPENDS += "qe-ucode"
```

## conf/machine/p1022ds.conf
```bitbake
#@TYPE: Machine
#@NAME: Freescale P1022DS 
#@SOC: p1022
#@DESCRIPTION: Machine configuration for Freescale QorIQ P1022 Development
#              System, revB with ppce500v2 core
#@MAINTAINER: Chunrong Guo <B40290@freescale.com>

require conf/machine/include/e500v2.inc

SOC_FAMILY = "p1022"
BOOTFORMAT_CONFIG = "config_sram_p1022ds.dat"

UBOOT_CONFIG ??= "nor nand spi sdcard 36bit-nor 36bit-spi 36bit-nand 36bit-sdcard"
UBOOT_CONFIG[nor] = "P1022DS_config"
UBOOT_CONFIG[nand] = "P1022DS_NAND_config"
UBOOT_CONFIG[spi] = "P1022DS_SPIFLASH_config"
UBOOT_CONFIG[sdcard] = "P1022DS_SDCARD_config"
UBOOT_CONFIG[36bit-nor] = "P1022DS_36BIT_config"
UBOOT_CONFIG[36bit-spi] = "P1022DS_36BIT_SPIFLASH_config"
UBOOT_CONFIG[36bit-nand] = "P1022DS_36BIT_NAND_config"
UBOOT_CONFIG[36bit-sdcard] = "P1022DS_36BIT_SDCARD_config"

KERNEL_DEVICETREE ?= "p1022ds_32b.dtb"
KERNEL_DEFCONFIG ?= "${S}/arch/powerpc/configs/mpc85xx_smp_defconfig"

PREFERRED_PROVIDER_virtual/xserver ?= "xserver-xorg"

XSERVER = " \
	xserver-xorg \
	xf86-input-evdev \
	xf86-input-mouse \
	xf86-input-keyboard \
	xf86-video-fbdev \
"

JFFS2_ERASEBLOCK = "0x20000"
```

## conf/machine/p1023rdb.conf
```bitbake
#@TYPE: Machine
#@NAME: Freescale P1023RDB
#@SOC: p1023
#@DESCRIPTION: Machine configuration for Freescale QorIQ P1023 Reference
#              Design Board, revA with ppce500v2 core
#@MAINTAINER: Chunrong Guo <B40290@freescale.com>

require conf/machine/include/e500v2.inc

SOC_FAMILY = "p1023"

UBOOT_CONFIG ??= "nor"
UBOOT_CONFIG[nor] = "P1023RDB_config"

KERNEL_DEVICETREE ?= "p1023rdb.dtb"
KERNEL_DEFCONFIG ?= "${S}/arch/powerpc/configs/85xx/p1023_defconfig"

JFFS2_ERASEBLOCK = "0x10000"

EXTRA_IMAGEDEPENDS += "fm-ucode"
```

## conf/machine/p1025twr.conf
```bitbake
#@TYPE: Machine
#@Name: Freescale P1025TWR
#@SOC: p1025
#@DESCRIPTION: Machine configuration for Freescale QorIQ P1025 MPU Tower
#              System Module with ppce500v2 core
#@MAINTAINER: Chunrong Guo <B40290@freescale.com>

require conf/machine/include/e500v2.inc

SOC_FAMILY = "p1025"
BOOTFORMAT_CONFIG = "config_ddr3_1gb_p1_p2_rdb_pc_667M.dat"

UBOOT_CONFIG ??= "nor"
UBOOT_CONFIG[nor] = "TWR-P1025_config"

KERNEL_DEVICETREE ?= "p1025twr_32b.dtb"
KERNEL_DEFCONFIG ?= "${S}/arch/powerpc/configs/mpc85xx_smp_defconfig"

JFFS2_ERASEBLOCK = "0x20000"
QE_UCODE ?= "fsl_qe_ucode_1021_10_A.bin"

EXTRA_IMAGEDEPENDS += "qe-ucode"
```
