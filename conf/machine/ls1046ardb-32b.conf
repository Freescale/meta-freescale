## conf/machine/p2020rdb.conf
```bitbake
#@TYPE: Machine
#@Name: NXP P2020RDB
#@SOC: p2020
#@DESCRIPTION: Machine configuration for NXP QorIQ P2020 Reference
#              Design Board with ppce500v2 core
#@MAINTAINER: Chunrong Guo <chunrong.guo@nxp.com>

require conf/machine/include/e500v2.inc

MACHINEOVERRIDES =. "p2020:"
BOOTFORMAT_CONFIG = "config_sram_p1022ds.dat"

UBOOT_CONFIG ??= "nand sdcard spi 36bit-nor 36bit-spi 36bit-nand 36bit-sdcard nor"
UBOOT_CONFIG[nor] = "P2020RDB-PC_config,,u-boot-with-dtb.bin"
UBOOT_CONFIG[nand] = "P2020RDB-PC_NAND_config,,u-boot-with-spl.bin"
UBOOT_CONFIG[sdcard] = "P2020RDB-PC_SDCARD_config,,u-boot-with-spl.bin"
UBOOT_CONFIG[spi] = "P2020RDB-PC_SPIFLASH_config,,u-boot-with-spl.bin"
UBOOT_CONFIG[36bit-nor] = "P2020RDB-PC_36BIT_config,,u-boot-with-dtb.bin"
UBOOT_CONFIG[36bit-spi] = "P2020RDB-PC_36BIT_SPIFLASH_config,,u-boot-with-spl.bin"
UBOOT_CONFIG[36bit-nand] = "P2020RDB-PC_36BIT_NAND_config,,u-boot-with-spl.bin"
UBOOT_CONFIG[36bit-sdcard] = "P2020RDB-PC_36BIT_SDCARD_config,,u-boot-with-spl.bin"

KERNEL_DEVICETREE ?= "p2020rdb-pc_32b.dtb"
KERNEL_DEFCONFIG ?= "mpc85xx_smp_defconfig"

JFFS2_ERASEBLOCK = "0x20000"

USE_VT ?= "0"
```

## conf/machine/p2041rdb.conf
```bitbake
#@TYPE: Machine
#@NAME: NXP P2041RDB
#@SOC: p2041
#@DESCRIPTION: Machine configuration for NXP QorIQ P2041 Reference
#              Design Board, rev2 silicon with ppce500mc core
#@MAINTAINER: Chunrong Guo <chunrong.guo@nxp.com>

require conf/machine/include/e500mc.inc

MACHINEOVERRIDES =. "p2041:"

UBOOT_CONFIG ??= "nand sdcard spi nor"
UBOOT_CONFIG[nor] = "P2041RDB_config,,u-boot-with-dtb.bin"
UBOOT_CONFIG[nand] = "P2041RDB_NAND_config,,u-boot.pbl"
UBOOT_CONFIG[sdcard] = "P2041RDB_SDCARD_config,,u-boot.pbl"
UBOOT_CONFIG[spi] = "P2041RDB_SPIFLASH_config,,u-boot.pbl"

HV_CFG_M = "p2041rdb"

KERNEL_DEVICETREE ?= "fsl/p2041rdb.dtb"
KERNEL_DEFCONFIG ?= "corenet32_smp_defconfig"

JFFS2_ERASEBLOCK = "0x10000"

EXTRA_IMAGEDEPENDS += "fm-ucode rcw"

USE_VT ?= "0"
```

## conf/machine/p3041ds.conf
```bitbake
#@TYPE: Machine
#@NAME: NXP P3041DS
#@SOC: p3041
#@DESCRIPTION: Machine configuration for NXP QorIQ P3041 Development
#              System with ppce500mc core
#@MAINTAINER: Chunrong Guo <chunrong.guo@nxp.com>

require conf/machine/include/e500mc.inc

MACHINEOVERRIDES =. "p3041:"

UBOOT_CONFIG ??= "nand sdcard spi nor"
UBOOT_CONFIG[nor] = "P3041DS_config,,u-boot-with-dtb.bin"
UBOOT_CONFIG[nand] = "P3041DS_NAND_config,,u-boot.pbl"
UBOOT_CONFIG[sdcard] = "P3041DS_SDCARD_config,,u-boot.pbl"
UBOOT_CONFIG[spi] = "P3041DS_SPIFLASH_config,,u-boot.pbl"

HV_CFG_M = "p3041ds"

KERNEL_DEVICETREE ?= "fsl/p3041ds.dtb"
KERNEL_DEFCONFIG ?= "corenet32_smp_defconfig"

JFFS2_ERASEBLOCK = "0x10000"

EXTRA_IMAGEDEPENDS += "fm-ucode rcw"

USE_VT ?= "0"
```

## conf/machine/p4080ds.conf
```bitbake
#@TYPE: Machine
#@NAME: NXP P4080DS
#@SOC: p4080
#@DESCRIPTION: Machine configuration for NXP QorIQ P4080 Development
#              System with ppce500mc core
#@MAINTAINER: Chunrong Guo <chunrong.guo@nxp.com>

require conf/machine/include/e500mc.inc

MACHINEOVERRIDES =. "p4080:"

UBOOT_CONFIG ??= "secure-boot sdcard spi nor"
UBOOT_CONFIG[nor] = "P4080DS_config,,u-boot-with-dtb.bin"
UBOOT_CONFIG[secure-boot] = "P4080DS_SECURE_BOOT_config"
UBOOT_CONFIG[sdcard] = "P4080DS_SDCARD_config,,u-boot.pbl"
UBOOT_CONFIG[spi] = "P4080DS_SPIFLASH_config,,u-boot.pbl"

HV_CFG_M = "p4080ds"

KERNEL_DEVICETREE ?= "p4080ds.dtb"
KERNEL_DEFCONFIG ?= "corenet32_smp_defconfig"

JFFS2_ERASEBLOCK = "0x10000"

EXTRA_IMAGEDEPENDS += "fm-ucode rcw"

USE_VT ?= "0"
```

## conf/machine/p5020ds-64b.conf
```bitbake
#@TYPE: Machine
#@NAME: NXP P5020DS-64B
#@SOC: p5020
#@DESCRIPTION: Machine configuration for NXP QorIQ P5020 Development
#              System with ppce5500 core in 64b mode
#@MAINTAINER: Chunrong Guo <B40290@freescale.com>

MACHINEOVERRIDES =. "p5020:"

require conf/machine/include/e5500-64b.inc

UBOOT_CONFIG ??= "nand secure-boot sdcard spi nor"
UBOOT_CONFIG[nor] = "P5020DS_config"
UBOOT_CONFIG[nand] = "P5020DS_NAND_config,,u-boot.pbl"
UBOOT_CONFIG[secure-boot] = "P5020DS_SECURE_BOOT_config"
UBOOT_CONFIG[sdcard] = "P5020DS_SDCARD_config,,u-boot.pbl"
UBOOT_CONFIG[spi] = "P5020DS_SPIFLASH_config,,u-boot.pbl"

KERNEL_DEVICETREE ?= "p5020ds.dtb p5020ds-usdpaa.dtb \
    p5020ds-usdpaa-shared-interfaces.dtb \
"
KERNEL_DEFCONFIG ?= "${S}/arch/powerpc/configs/corenet64_smp_defconfig"

JFFS2_ERASEBLOCK = "0x10000"
EXTRA_IMAGEDEPENDS += "fm-ucode rcw hypervisor hv-cfg"
USE_VT ?= "0"
```

## conf/machine/p5040ds-64b.conf
```bitbake
#@TYPE: Machine
#@NAME: NXP P5040DS-64B
#@SOC: p5040
#@DESCRIPTION: Machine configuration for Freescale QorIQ P5040 Development
#              System with ppce5500 core in 64b mode
#@MAINTAINER: Chunrong Guo <chunrong.guo@nxp.com>

require conf/machine/include/e5500-64b.inc

MACHINEOVERRIDES =. "p5040:"

UBOOT_CONFIG ??= "nand secure-boot sdcard spi nor"
UBOOT_CONFIG[nor] = "P5040DS_config,,u-boot-with-dtb.bin"
UBOOT_CONFIG[nand] = "P5040DS_NAND_config,,u-boot.pbl"
UBOOT_CONFIG[secure-boot] = "P5040DS_SECURE_BOOT_config"
UBOOT_CONFIG[sdcard] = "P5040DS_SDCARD_config,,u-boot.pbl"
UBOOT_CONFIG[spi] = "P5040DS_SPIFLASH_config,,u-boot.pbl"

HV_CFG_M = "p5040ds"

KERNEL_DEVICETREE ?= "p5040ds.dtb"
KERNEL_DEFCONFIG ?= "corenet64_smp_defconfig"

JFFS2_ERASEBLOCK = "0x10000"

EXTRA_IMAGEDEPENDS += "fm-ucode rcw"

USE_VT ?= "0"
```

## conf/machine/p5040ds.conf
```bitbake
#@TYPE: Machine
#@NAME: NXP P5040DS
#@SOC: p5040
#@DESCRIPTION: Machine configuration for NXP QorIQ P5040 Development
#              System with ppce5500 core in 32b mode
#@MAINTAINER: Chunrong Guo <chunrong.guo@nxp.com>

require conf/machine/include/e5500.inc

MACHINEOVERRIDES =. "p5040:"

UBOOT_CONFIG ??= "nand sdcard spi nor"
UBOOT_CONFIG[nor] = "P5040DS_config,,u-boot-with-dtb.bin"
UBOOT_CONFIG[nand] = "P5040DS_NAND_config,,u-boot.pbl"
UBOOT_CONFIG[sdcard] = "P5040DS_SDCARD_config,,u-boot.pbl"
UBOOT_CONFIG[spi] = "P5040DS_SPIFLASH_config,,u-boot.pbl"

HV_CFG_M = "p5040ds"

KERNEL_DEVICETREE ?= "fsl/p5040ds.dtb"
KERNEL_DEFCONFIG ?= "corenet32_smp_defconfig"

JFFS2_ERASEBLOCK = "0x10000"

EXTRA_IMAGEDEPENDS += "fm-ucode rcw"

USE_VT ?= "0"
```

## conf/machine/t1023rdb-64b.conf
```bitbake
#@TYPE: Machine
#@NAME: Freescale T1023RDB
#@SOC: t1023
#@DESCRIPTION: Machine configuration for Freescale QorIQ T1023 Reference
#              Design Board with ppce5500 core in 64b mode
#@MAINTAINER: Chunrong Guo <B40290@freescale.com>

require conf/machine/include/e5500-64b.inc

SOC_FAMILY = "t1:t1023"

UBOOT_CONFIG ??= "nand sdcard spi"
UBOOT_CONFIG[nand] = "T1024RDB_NAND_config"
UBOOT_CONFIG[sdcard] = "T1024RDB_SDCARD_config"
UBOOT_CONFIG[spi] = "T1023RDB_SPIFLASH_config"

KERNEL_DEVICETREE ?= "t1023rdb.dtb t1023rdb-usdpaa.dtb t1023rdb-usdpaa-shared-interfaces.dtb"
KERNEL_DEFCONFIG ?= "${S}/arch/powerpc/configs/corenet64_fmanv3l_smp_defconfig"

JFFS2_ERASEBLOCK = "0x10000"

EXTRA_IMAGEDEPENDS += "fm-ucode rcw"
```

## conf/machine/t1023rdb.conf
```bitbake
#@TYPE: Machine
#@NAME: NXP T1023RDB
#@SOC: t1023
#@DESCRIPTION: Machine configuration for NXP QorIQ T1023 Reference
#              Design Board with ppce5500 core in 32b mode
#@MAINTAINER: Chunrong Guo <B40290@freescale.com>

MACHINEOVERRIDES =. "t1:t1023:"

require conf/machine/include/e5500.inc

UBOOT_CONFIG ??= "nand sdcard spi secure-boot nor"
UBOOT_CONFIG[nor] = "T1023RDB_config"
UBOOT_CONFIG[nand] = "T1023RDB_NAND_config,,u-boot-with-spl-pbl.bin"
UBOOT_CONFIG[sdcard] = "T1023RDB_SDCARD_config,,u-boot-with-spl-pbl.bin"
UBOOT_CONFIG[spi] = "T1023RDB_SPIFLASH_config,,u-boot-with-spl-pbl.bin"
UBOOT_CONFIG[secure-boot] = "T1023RDB_SECURE_BOOT_config"

KERNEL_DEVICETREE ?= "t1023rdb.dtb t1023rdb-usdpaa.dtb t1023rdb-usdpaa-shared-interfaces.dtb"
KERNEL_DEFCONFIG ?= "${S}/arch/powerpc/configs/corenet32_fmanv3l_smp_defconfig"

JFFS2_ERASEBLOCK = "0x10000"
EXTRA_IMAGEDEPENDS += "fm-ucode rcw"
USE_VT ?= "0"
```

## conf/machine/t1024rdb-64b.conf
```bitbake
#@TYPE: Machine
#@NAME: NXP T1024RDB
#@SOC: t1024
#@DESCRIPTION: Machine configuration for Freescale QorIQ T1024 Reference
#              Design Board with ppce5500 core in 64b mode
#@MAINTAINER: Chunrong Guo <chunrong.guo@nxp.com>

require conf/machine/include/e5500-64b.inc

MACHINEOVERRIDES =. "t1:t1024:"

UBOOT_CONFIG ??= "nand sdcard spi secure-boot nor"
UBOOT_CONFIG[nor] = "T1024RDB_config,,u-boot-with-dtb.bin"
UBOOT_CONFIG[nand] = "T1024RDB_NAND_config,,u-boot-with-spl-pbl.bin"
UBOOT_CONFIG[sdcard] = "T1024RDB_SDCARD_config,,u-boot-with-spl-pbl.bin"
UBOOT_CONFIG[spi] = "T1024RDB_SPIFLASH_config,,u-boot-with-spl-pbl.bin"
UBOOT_CONFIG[secure-boot] = "T1024RDB_SECURE_BOOT_config"

HV_CFG_M = "t1024rdb"

KERNEL_DEVICETREE ?= "t1024rdb.dtb"
KERNEL_DEFCONFIG ?= "corenet64_smp_defconfig"

JFFS2_ERASEBLOCK = "0x10000"
QE_UCODE ?= "iram_Type_A_T1024_r1.0.bin"

EXTRA_IMAGEDEPENDS += "fm-ucode rcw qe-ucode"

USE_VT ?= "0"
```
