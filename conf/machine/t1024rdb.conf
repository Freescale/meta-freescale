## meta-fsl-arm/conf/machine/imx35pdk.conf
```bitbake
#@TYPE: Machine
#@NAME: Freescale i.MX35 Platform Development Kit
#@SOC: i.MX35
#@DESCRIPTION: Machine configuration for Freescale i.MX35 Platform Development Kit

include conf/machine/include/imx-base.inc
require conf/machine/include/tune-arm1136jf-s.inc

SOC_FAMILY = "mx3:mx35"

UBOOT_MACHINE = "mx35pdk_config"
UBOOT_SUFFIX = "bin"
UBOOT_BINARY = "u-boot.bin"
UBOOT_MAKE_TARGET = "u-boot.bin"
KERNEL_IMAGETYPE = "uImage"

GUI_MACHINE_CLASS = "bigscreen"

ROOT_FLASH_SIZE = "256"

JFFS2_ERASEBLOCK = "0x20000"

IMAGE_FSTYPES += "jffs2 tar.bz2"

MACHINE_FEATURES += "ext2 ext3 screen"
```

## meta-fsl-arm/conf/machine/imx51evk.conf
```bitbake
#@TYPE: Machine
#@NAME: Freescale i.MX51 Evaluation Kit
#@SOC: i.MX51
#@DESCRIPTION: Machine configuration for Freescale i.MX51 Evaluation Kit
#@MAINTAINER: Daiane Angolini <daiane.angolini@freescale.com>

include conf/machine/include/imx-base.inc
include conf/machine/include/tune-cortexa8.inc

SOC_FAMILY = "mx5:mx51"

# Disable perf features as 2.6.35.3 fails to build otherwise
PERF_FEATURES_ENABLE = ""

KERNEL_DEVICETREE = "imx51-babbage.dtb"

UBOOT_MACHINE = "mx51evk_config"
```

## meta-fsl-arm/conf/machine/imx53ard.conf
```bitbake
#@TYPE: Machine
#@NAME: Freescale i.MX53 SABRE Automotive Board
#@SOC: i.MX53
#@DESCRIPTION: Machine configuration for Freescale i.MX53 SABRE Automotive Board
#@MAINTAINER: Daiane Angolini <daiane.angolini@freescale.com>

include conf/machine/include/imx-base.inc
include conf/machine/include/tune-cortexa8.inc

SOC_FAMILY = "mx5:mx53"

KERNEL_DEVICETREE = "imx53-ard.dtb"

UBOOT_MACHINE = "mx53ard_config"
KERNEL_IMAGETYPE = "uImage"

MACHINE_FIRMWARE += "linux-firmware-ar3k \
                     linux-firmware-ath6k"
MACHINE_FEATURES += "wifi bluetooth"
```

## meta-fsl-arm/conf/machine/imx53qsb.conf
```bitbake
#@TYPE: Machine
#@NAME: Freescale i.MX53 Quick Start Board
#@SOC: i.MX53
#@DESCRIPTION: Machine configuration for Freescale i.MX53 Quick Start Board
#@MAINTAINER: Trevor Woerner <trevor.woerner@linaro.org>

include conf/machine/include/imx-base.inc
include conf/machine/include/tune-cortexa8.inc

SOC_FAMILY = "mx5:mx53"

KERNEL_DEVICETREE = "imx53-qsb.dtb imx53-qsrb.dtb"

UBOOT_MACHINE = "mx53loco_config"

MACHINE_FIRMWARE = "linux-firmware-ar3k \
                     linux-firmware-ath6k"
MACHINE_FEATURES += " wifi bluetooth"
```
