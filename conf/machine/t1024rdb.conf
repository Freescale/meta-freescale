## conf/machine/t1024rdb.conf
```bitbake
#@TYPE: Machine
#@NAME: NXP T1024RDB
#@SOC: t1024
#@DESCRIPTION: Machine configuration for NXP QorIQ T1024 Reference
#              Design Board with ppce5500 core in 32b mode
#@MAINTAINER: Chunrong Guo <B40290@freescale.com>

MACHINEOVERRIDES =. "t1:t1024:"

require conf/machine/include/e5500.inc

UBOOT_CONFIG ??= "nand sdcard spi secure-boot nor"
UBOOT_CONFIG[nor] = "T1024RDB_config"
UBOOT_CONFIG[nand] = "T1024RDB_NAND_config,,u-boot-with-spl-pbl.bin"
UBOOT_CONFIG[sdcard] = "T1024RDB_SDCARD_config,,u-boot-with-spl-pbl.bin"
UBOOT_CONFIG[spi] = "T1024RDB_SPIFLASH_config,,u-boot-with-spl-pbl.bin"
UBOOT_CONFIG[secure-boot] = "T1024RDB_SECURE_BOOT_config"

KERNEL_DEVICETREE ?= "t1024rdb.dtb t1024rdb-usdpaa.dtb \
    t1024rdb-usdpaa-shared-interfaces.dtb \
"
KERNEL_DEFCONFIG ?= "${S}/arch/powerpc/configs/corenet32_fmanv3l_smp_defconfig"

JFFS2_ERASEBLOCK = "0x10000"
QE_UCODE ?= "iram_Type_A_T1024_r1.0.bin"
EXTRA_IMAGEDEPENDS += "fm-ucode rcw qe-ucode"
USE_VT ?= "0"
```

## conf/machine/t1040d4rdb-64b.conf
```bitbake
#@TYPE: Machine
#@NAME: NXP T1040D4RDB
#@SOC: t1040
#@DESCRIPTION: Machine configuration for NXP QorIQ T1040D4 Reference
#              Design Board with ppce5500 core in 64b mode
#@MAINTAINER: Chunrong Guo <B40290@freescale.com>

MACHINEOVERRIDES =. "t1:t1040:"

require conf/machine/include/e5500-64b.inc

UBOOT_CONFIG ??= "nand sdcard spi secure-boot nor"
UBOOT_CONFIG[nor] = "T1040D4RDB_config"
UBOOT_CONFIG[nand] = "T1040D4RDB_NAND_config,,u-boot-with-spl-pbl.bin"
UBOOT_CONFIG[sdcard] = "T1040D4RDB_SDCARD_config,,u-boot-with-spl-pbl.bin"
UBOOT_CONFIG[spi] = "T1040D4RDB_SPIFLASH_config,,u-boot-with-spl-pbl.bin"
UBOOT_CONFIG[secure-boot] = "T1040D4RDB_SECURE_BOOT_config"

KERNEL_DEVICETREE ?= "t1040d4rdb.dtb t1040d4rdb-usdpaa.dtb \
    t1040d4rdb-dsar.dtb \
    t1040d4rdb-usdpaa-lag.dtb t1040d4rdb-usdpaa-shared-interfaces.dtb \
"
KERNEL_DEFCONFIG ?= "${S}/arch/powerpc/configs/corenet64_fmanv3l_smp_defconfig"

JFFS2_ERASEBLOCK = "0x10000"
QE_UCODE = "iram_Type_A_T1040_r1.0.bin"
EXTRA_IMAGEDEPENDS += "fm-ucode rcw hypervisor hv-cfg qe-ucode"
USE_VT ?= "0"
```

## conf/machine/t1040d4rdb.conf
```bitbake
#@TYPE: Machine
#@NAME: Freescale T1040D4RDB
#@SOC: t1040
#@DESCRIPTION: Machine configuration for Freescale QorIQ T1040D4 Reference
#              Design Board with ppce5500 core in 32b mode
#@MAINTAINER: Chunrong Guo <B40290@freescale.com>

require conf/machine/include/e5500.inc

SOC_FAMILY = "t1:t1040"

UBOOT_CONFIG ??= "nor nand sdcard spi secure-boot"
UBOOT_CONFIG[nor] = "T1040D4RDB_config"
UBOOT_CONFIG[nand] = "T1040D4RDB_NAND_config"
UBOOT_CONFIG[sdcard] = "T1040D4RDB_SDCARD_config"
UBOOT_CONFIG[spi] = "T1040D4RDB_SPIFLASH_config"
UBOOT_CONFIG[secure-boot] = "T1040D4RDB_SECURE_BOOT_config"

KERNEL_DEVICETREE ?= "t1040d4rdb.dtb t1040d4rdb-usdpaa-lag.dtb"
KERNEL_DEFCONFIG ?= "${S}/arch/powerpc/configs/corenet32_fmanv3l_smp_defconfig"

JFFS2_ERASEBLOCK = "0x10000"

QE_UCODE = "iram_Type_A_T1040_r1.0.bin"

EXTRA_IMAGEDEPENDS += "fm-ucode rcw hypervisor hv-cfg qe-ucode"
```

## conf/machine/t1042d4rdb-64b.conf
```bitbake
#@TYPE: Machine
#@NAME: NXP T1042D4RDB
#@SOC: t1042
#@DESCRIPTION: Machine configuration for NXP QorIQ T1042D4 Reference
#              Design Board with ppce5500 core in 64b mode
#@MAINTAINER: Chunrong Guo <chunrong.guo@nxp.com>

require conf/machine/include/e5500-64b.inc

MACHINEOVERRIDES =. "t1:t1042:"

UBOOT_CONFIG ??= "nand sdcard spi nor"
UBOOT_CONFIG[nor] = "T1042D4RDB_config,,u-boot-with-dtb.bin"
UBOOT_CONFIG[nand] = "T1042D4RDB_NAND_config,,u-boot-with-spl-pbl.bin"
UBOOT_CONFIG[sdcard] = "T1042D4RDB_SDCARD_config,,u-boot-with-spl-pbl.bin"
UBOOT_CONFIG[spi] = "T1042D4RDB_SPIFLASH_config,,u-boot-with-spl-pbl.bin"

HV_CFG_M = "t1040rdb"

KERNEL_DEVICETREE ?= "fsl/t1042d4rdb.dtb"
KERNEL_DEFCONFIG ?= "corenet64_smp_defconfig"

JFFS2_ERASEBLOCK = "0x10000"

QE_UCODE = "iram_Type_A_T1040_r1.0.bin"

EXTRA_IMAGEDEPENDS += "fm-ucode rcw qe-ucode"

USE_VT ?= "0"
```

## conf/machine/t2080qds-64b.conf
```bitbake
#@TYPE: Machine
#@NAME: Freescale T2080QDS-64B
#@SOC: t2080
#@DESCRIPTION: Machine configuration for Freescale QorIQ T2080 Development
#              System with ppce6500 core in 64b mode
#@MAINTAINER: Chunrong Guo <B40290@freescale.com>

require conf/machine/include/e6500-64b.inc

SOC_FAMILY = "t2:t2080"

UBOOT_CONFIG ??= "nor sdcard spi nand srio-pcie-boot secure-boot"
UBOOT_CONFIG[nor] = "T2080QDS_config"
UBOOT_CONFIG[sdcard] = "T2080QDS_SDCARD_config"
UBOOT_CONFIG[spi] = "T2080QDS_SPIFLASH_config"
UBOOT_CONFIG[nand] = "T2080QDS_NAND_config"
UBOOT_CONFIG[srio-pcie-boot] = "T2080QDS_SRIO_PCIE_BOOT_config"
UBOOT_CONFIG[secure-boot] = "T2080QDS_SECURE_BOOT_config"

KERNEL_DEVICETREE ?= "t2080qds.dtb t2080qds-usdpaa.dtb \
    t2080qds-usdpaa-shared-interfaces.dtb \
"
KERNEL_DEFCONFIG ?= "${S}/arch/powerpc/configs/corenet64_fmanv3h_smp_defconfig"

JFFS2_ERASEBLOCK = "0x10000"

EXTRA_IMAGEDEPENDS += "fm-ucode rcw hypervisor hv-cfg"
```

## conf/machine/t2080qds.conf
```bitbake
#@TYPE: Machine
#@NAME: NXP T2080QDS
#@SOC: t2080
#@DESCRIPTION: Machine configuration for NXP QorIQ T2080 Development
#              System with ppce6500 core in 32b mode
#@MAINTAINER: Chunrong Guo <B40290@freescale.com>

MACHINEOVERRIDES =. "t2:t2080:"

require conf/machine/include/e6500.inc

UBOOT_CONFIG ??= "sdcard spi nand srio-pcie-boot secure-boot nor"
UBOOT_CONFIG[nor] = "T2080QDS_config"
UBOOT_CONFIG[sdcard] = "T2080QDS_SDCARD_config,,u-boot-with-spl-pbl.bin"
UBOOT_CONFIG[spi] = "T2080QDS_SPIFLASH_config,,u-boot-with-spl-pbl.bin"
UBOOT_CONFIG[nand] = "T2080QDS_NAND_config,,u-boot-with-spl-pbl.bin"
UBOOT_CONFIG[srio-pcie-boot] = "T2080QDS_SRIO_PCIE_BOOT_config"
UBOOT_CONFIG[secure-boot] = "T2080QDS_SECURE_BOOT_config"

KERNEL_DEVICETREE ?= "t2080qds.dtb t2080qds-usdpaa.dtb \
    t2080qds-usdpaa-shared-interfaces.dtb \
"
KERNEL_DEFCONFIG ?= "${S}/arch/powerpc/configs/corenet64_fmanv3h_smp_defconfig"

JFFS2_ERASEBLOCK = "0x10000"
EXTRA_IMAGEDEPENDS += "fm-ucode rcw lib64-hypervisor hv-cfg"
USE_VT ?= "0"
```

## conf/machine/t2080rdb-64b.conf
```bitbake
#@TYPE: Machine
#@NAME: NXP T2080RDB
#@SOC: t2080
#@DESCRIPTION: Machine configuration for Freescale QorIQ T2080 Reference
#              Design Board with ppce6500 core in 64b mode
#@MAINTAINER: Chunrong Guo <chunrong.guo@nxp.com>

require conf/machine/include/e6500-64b.inc

MACHINEOVERRIDES =. "t2:t2080:"

UBOOT_CONFIG ??= "sdcard spi nand nor"
UBOOT_CONFIG[nor] = "T2080RDB_config,,u-boot-with-dtb.bin"
UBOOT_CONFIG[sdcard] = "T2080RDB_SDCARD_config,,u-boot-with-spl-pbl.bin"
UBOOT_CONFIG[spi] = "T2080RDB_SPIFLASH_config,,u-boot-with-spl-pbl.bin"
UBOOT_CONFIG[nand] = "T2080RDB_NAND_config,,u-boot-with-spl-pbl.bin"

HV_CFG_M = "t2080rdb"

KERNEL_DEVICETREE ?= "fsl/t2080rdb.dtb"
KERNEL_DEFCONFIG ?= "corenet64_smp_defconfig"

JFFS2_ERASEBLOCK = "0x10000"

EXTRA_IMAGEDEPENDS += "fm-ucode rcw ls2-phy"

USE_VT ?= "0"
```

## conf/machine/t2080rdb.conf
```bitbake
#@TYPE: Machine
#@NAME: NXP T2080RDB
#@SOC: t2080
#@DESCRIPTION: Machine configuration for NXP QorIQ T2080 Reference
#              Design Board with ppce6500 core in 32b mode
#@MAINTAINER: Chunrong Guo <B40290@freescale.com>

MACHINEOVERRIDES =. "t2:t2080:"

require conf/machine/include/e6500.inc

UBOOT_CONFIG ??= "sdcard spi nand srio-pcie-boot secure-boot nor"
UBOOT_CONFIG[nor] = "T2080RDB_config"
UBOOT_CONFIG[sdcard] = "T2080RDB_SDCARD_config,,u-boot-with-spl-pbl.bin"
UBOOT_CONFIG[spi] = "T2080RDB_SPIFLASH_config,,u-boot-with-spl-pbl.bin"
UBOOT_CONFIG[nand] = "T2080RDB_NAND_config,,u-boot-with-spl-pbl.bin"
UBOOT_CONFIG[srio-pcie-boot] = "T2080RDB_SRIO_PCIE_BOOT_config"
UBOOT_CONFIG[secure-boot] = "T2080RDB_SECURE_BOOT_config"

KERNEL_DEVICETREE ?= "t2080rdb.dtb t2080rdb-usdpaa.dtb \
    t2080rdb-usdpaa-shared-interfaces.dtb \
"
KERNEL_DEFCONFIG ?= "${S}/arch/powerpc/configs/corenet64_fmanv3h_smp_defconfig"

JFFS2_ERASEBLOCK = "0x10000"
EXTRA_IMAGEDEPENDS += "fm-ucode rcw lib64-hypervisor hv-cfg"
USE_VT ?= "0"
```

## conf/machine/t4160qds.conf
```bitbake
#@TYPE: Machine
#@NAME: NXP T4160QDS
#@SOC: t4160
#@DESCRIPTION: Machine configuration for NXP QorIQ T4160 Development
#              System with ppce6500 core in 32b mode
#@MAINTAINER: Chunrong Guo <B40290@freescale.com>

MACHINEOVERRIDES =. "t4:t4160:"

require conf/machine/include/e6500.inc

UBOOT_CONFIG ??= "secure-boot nor"
UBOOT_CONFIG[nor] = "T4160QDS_config"
UBOOT_CONFIG[secure-boot] = "T4160QDS_SECURE_BOOT_config"

KERNEL_DEVICETREE ?= "t4240qds.dtb t4240qds-usdpaa.dtb"
KERNEL_DEFCONFIG ?= "${S}/arch/powerpc/configs/corenet64_fmanv3h_smp_defconfig"

JFFS2_ERASEBLOCK = "0x10000"
EXTRA_IMAGEDEPENDS += "fm-ucode"
USE_VT ?= "0"
```

## conf/machine/t4240qds-64b.conf
```bitbake
#@TYPE: Machine
#@NAME: NXP T4240QDS-64B
#@SOC: t4240
#@DESCRIPTION: Machine configuration for NXP QorIQ T4240 Development
#              System with ppce6500 core in 64b mode
#@MAINTAINER: Chunrong Guo <B40290@freescale.com>

MACHINEOVERRIDES =. "t4:t4240:"

require conf/machine/include/e6500-64b.inc

UBOOT_CONFIG ??= "secure-boot nor"
UBOOT_CONFIG[nor] = "T4240QDS_config"
UBOOT_CONFIG[secure-boot] = "T4240QDS_SECURE_BOOT_config"

KERNEL_DEVICETREE ?= "t4240qds.dtb t4240qds-usdpaa.dtb \
    t4240qds-usdpaa-shared-interfaces.dtb \
"
KERNEL_DEFCONFIG ?= "${S}/arch/powerpc/configs/corenet64_fmanv3h_smp_defconfig"

JFFS2_ERASEBLOCK = "0x10000"
EXTRA_IMAGEDEPENDS += "fm-ucode rcw hypervisor hv-cfg"
USE_VT ?= "0"
```

## conf/machine/t4240qds.conf
```bitbake
#@TYPE: Machine
#@NAME: Freescale T4240QDS
#@SOC: t4240
#@DESCRIPTION: Machine configuration for Freescale QorIQ T4240 Development
#              System with ppce6500 core in 32b mode
#@MAINTAINER: Chunrong Guo <B40290@freescale.com>

require conf/machine/include/e6500.inc

SOC_FAMILY = "t4:t4240"

UBOOT_CONFIG ??= "nor secure-boot"
UBOOT_CONFIG[nor] = "T4240QDS_config"
UBOOT_CONFIG[secure-boot] = "T4240QDS_SECURE_BOOT_config

KERNEL_DEVICETREE ?= "t4240qds.dtb t4240qds-usdpaa.dtb \
    t4240qds-usdpaa-shared-interfaces.dtb \
"
KERNEL_DEFCONFIG ?= "${S}/arch/powerpc/configs/corenet64_fmanv3h_smp_defconfig"

JFFS2_ERASEBLOCK = "0x10000"

EXTRA_IMAGEDEPENDS += "fm-ucode rcw lib64-hypervisor hv-cfg"
```

## conf/machine/t4240rdb-64b.conf
```bitbake
#@TYPE: Machine
#@NAME: Freescale T4240RDB
#@SOC: t4240
#@DESCRIPTION: Machine configuration for Freescale QorIQ T4240 Reference
#              Design Board with ppce6500 core in 64b mode
#@MAINTAINER: Chunrong Guo <B40290@freescale.com>

require conf/machine/include/e6500-64b.inc

SOC_FAMILY = "t4:t4240"

UBOOT_CONFIG ??= "nor"
UBOOT_CONFIG[nor] = "T4240RDB_config"

KERNEL_DEVICETREE ?= "t4240rdb.dtb t4240rdb-usdpaa.dtb \
    t4240rdb-usdpaa-shared-interfaces.dtb \
"
KERNEL_DEFCONFIG ?= "${S}/arch/powerpc/configs/corenet64_fmanv3h_smp_defconfig"

JFFS2_ERASEBLOCK = "0x10000"

EXTRA_IMAGEDEPENDS += "fm-ucode rcw hypervisor hv-cfg"
```

## conf/machine/t4240rdb.conf
```bitbake
#@TYPE: Machine
#@NAME: NXP T4240RDB
#@SOC: t4240
#@DESCRIPTION: Machine configuration for NXP QorIQ T4240 Reference
#              Design Board with ppce6500 core in 32b mode
#@MAINTAINER: Chunrong Guo <chunrong.guo@nxp.com>

require conf/machine/include/e6500.inc

MACHINEOVERRIDES =. "t4:t4240:"

UBOOT_CONFIG ??= "nor"
UBOOT_CONFIG[nor] = "T4240RDB_config,,u-boot-with-dtb.bin"

HV_CFG_M = "t4240rdb"

KERNEL_DEVICETREE ?= "fsl/t4240rdb.dtb"
KERNEL_DEFCONFIG ?= "corenet64_smp_defconfig"

JFFS2_ERASEBLOCK = "0x10000"

EXTRA_IMAGEDEPENDS += "fm-ucode rcw ls2-phy"

USE_VT ?= "0"
```

## conf/machine/twr-vf65gs10.conf
```bitbake
#@TYPE: Machine
#@NAME: NXP Vybrid TWR-VF65GS10
#@SOC: VF610
#@DESCRIPTION: Machine configuration for NXP Vybrid TWR-VF65GS10
#@MAINTAINER: Stefan Agner <stefan.agner@toradex.com>

MACHINEOVERRIDES =. "vf:vf60:"

include conf/machine/include/imx-base.inc
include conf/machine/include/tune-cortexa5.inc

PREFERRED_PROVIDER_virtual/kernel ?= "linux-fslc"

UBOOT_MACHINE = "vf610twr_config"

KERNEL_DEVICETREE = "vf610-twr.dtb"

SERIAL_CONSOLE = "115200 ttyLP1"

MACHINE_FEATURES = "usbgadget usbhost vfat alsa touchscreen"
```

## meta-fsl-arm/conf/distro/include/fsl-default-providers.inc
```bitbake
# Freescale BSP default providers

PREFERRED_PROVIDER_virtual/xserver = "xserver-xorg-lite"
PREFERRED_PROVIDER_virtual/kernel ?= "linux-imx"
PREFERRED_PROVIDER_linux-libc-headers ?= "linux-libc-headers-imx"
PREFERRED_PROVIDER_u-boot ?= "u-boot"
```

## meta-fsl-arm/conf/layer.conf
```bitbake
# We have a conf and classes directory, add to BBPATH
BBPATH .= ":${LAYERDIR}"

# We have a packages directory, add to BBFILES
BBFILES += "${LAYERDIR}/recipes-*/*/*.bb \
            ${LAYERDIR}/recipes-*/*/*.bbappend"

BBFILE_COLLECTIONS += "fsl-arm"
BBFILE_PATTERN_fsl-arm := "^${LAYERDIR}/"
BBFILE_PRIORITY_fsl-arm = "5"

FSL_EULA_FILE = "${LAYERDIR}/EULA"

FSL_MIRROR ?= "http://www.freescale.com/lgfiles/NMG/MAD/YOCTO/"

MIRRORS += " \
${FSL_MIRROR}	http://download.ossystems.com.br/bsp/freescale/source/ \n \
"

# Let us add layer-specific bbappends which are only applied when that
# layer is included in our configuration
BBFILES += "${@' '.join('${LAYERDIR}/%s/recipes*/*/*.bbappend' % layer \
               for layer in BBFILE_COLLECTIONS.split())}"
```

## meta-fsl-arm/conf/machine/imx23evk.conf
```bitbake
#@TYPE: Machine
#@NAME: Freescale i.MX23 Evaluation Kit
#@SOC: i.MX23
#@DESCRIPTION: Machine configuration for Freescale i.MX23 Evaluation Kit
#@MAINTAINER: Otavio Salvador <otavio@ossystems.com.br>

include conf/machine/include/mxs-base.inc

SOC_FAMILY = "mxs:mx23"

IMXBOOTLETS_MACHINE = "stmp378x_dev"
UBOOT_MACHINE = "mx23evk_config"

KERNEL_DEVICETREE = "imx23-evk.dtb"

SDCARD_ROOTFS ?= "${DEPLOY_DIR_IMAGE}/${IMAGE_NAME}.rootfs.ext3"
IMAGE_FSTYPES ?= "tar.bz2 ext3 uboot.mxsboot-sdcard sdcard"

MACHINE_FEATURES = "apm usbgadget usbhost vfat touchscreen"
```

## meta-fsl-arm/conf/machine/imx28evk.conf
```bitbake
#@TYPE: Machine
#@NAME: Freescale i.MX28 Evaluation Kit
#@SOC: i.MX28
#@DESCRIPTION: Machine configuration for Freescale i.MX28 Evaluation Kit

include conf/machine/include/mxs-base.inc

SOC_FAMILY = "mxs:mx28"

IMXBOOTLETS_MACHINE = "iMX28_EVK"

UBOOT_CONFIG ??= "sd"
UBOOT_CONFIG[sd] = "mx28evk_config,sdcard"
UBOOT_CONFIG[nand] = "mx28evk_nand_config,ubifs"
UBOOT_CONFIG[sd-auart-console] = "mx28evk_auart_console_config,sdcard"

KERNEL_IMAGETYPE = "uImage"
KERNEL_DEVICETREE = "imx28-evk.dtb"

SDCARD_ROOTFS ?= "${DEPLOY_DIR_IMAGE}/${IMAGE_NAME}.rootfs.ext3"
IMAGE_FSTYPES ?= "tar.bz2 ext3 uboot.mxsboot-sdcard sdcard"

SERIAL_CONSOLE = "115200 ttyAMA0"

MACHINE_FEATURES = "apm usbgadget usbhost vfat alsa touchscreen"

# Gstreamer plugin
MACHINE_GSTREAMER_PLUGIN ?= "gst-fsl-plugin"
```

## meta-fsl-arm/conf/machine/imx31pdk.conf
```bitbake
#@TYPE: Machine
#@NAME: iMX31 Plateform Development Kit
#@DESCRIPTION: Machine configuration for Freescale iMX31 Platform Development Kit

include conf/machine/include/soc-family.inc
include conf/machine/include/imx-base.inc
require conf/machine/include/tune-arm1136jf-s.inc

SOC_FAMILY = "mx3:mx31"

GUI_MACHINE_CLASS = "smallscreen"

UBOOT_MAKE_TARGET = "u-boot-with-spl.bin"
UBOOT_SUFFIX = "bin"
UBOOT_MACHINE = "mx31pdk_config"
UBOOT_BINARY = "u-boot-with-spl.bin"

IMAGE_FSTYPES = "ubi jffs2 tar.bz2"
MKUBIFS_ARGS = "-m 2048 -e 129024 -c 2030"
UBINIZE_ARGS = "-m 2048 -p 128KiB -s 512"

MACHINE_FEATURES += "ext3 bluetooth ext2 screen"
```
