## conf/machine/imx6sxsabresd.conf
```bitbake
#@TYPE: Machine
#@NAME: NXP i.MX6SoloX SabreSD
#@SOC: i.MX6SX
#@DESCRIPTION: Machine configuration for NXP i.MX6SoloX Sabre SD
#@MAINTAINER: Lauren Post <Lauren.Post@nxp.com>

MACHINEOVERRIDES =. "mx6sx:"

require conf/machine/include/imx-base.inc
require conf/machine/include/arm/armv7a/tune-cortexa9.inc

KERNEL_DEVICETREE = " \
    nxp/imx/imx6sx-sdb.dtb \
    nxp/imx/imx6sx-sdb-reva.dtb \
    nxp/imx/imx6sx-sdb-sai.dtb \
"
KERNEL_DEVICETREE:append:use-nxp-bsp = " \
    nxp/imx/imx6sx-sdb-btwifi.dtb \
    nxp/imx/imx6sx-sdb-emmc.dtb \
    nxp/imx/imx6sx-sdb-lcdif1.dtb \
    nxp/imx/imx6sx-sdb-ldo.dtb \
    nxp/imx/imx6sx-sdb-m4.dtb \
    nxp/imx/imx6sx-sdb-mqs.dtb \
    nxp/imx/imx6sx-sdb-pcie-ep.dtb \
    nxp/imx/imx6sx-sdb-reva-ldo.dtb \
"

UBOOT_MAKE_TARGET = "u-boot.imx"
UBOOT_SUFFIX = "imx"

UBOOT_CONFIG ??= " \
    sd \
    ${@bb.utils.contains('MACHINE_FEATURES', 'optee', 'sd-optee', '', d)} \
"
UBOOT_CONFIG[sd]       = "mx6sxsabresd_config,sdcard"
UBOOT_CONFIG[sd-optee] = "mx6sxsabresd_optee_config,sdcard"
UBOOT_CONFIG[emmc]     = "mx6sxsabresd_emmc_config,sdcard"
UBOOT_CONFIG[qspi2]    = "mx6sxsabresd_qspi2_config"
UBOOT_CONFIG[m4fastup] = "mx6sxsabresd_m4fastup_config"

OPTEE_BIN_EXT = "6sxsdb"

SERIAL_CONSOLES = "115200;ttymxc0"

MACHINE_FIRMWARE:append:mx6 = " linux-firmware-ath6k"

MACHINE_FEATURES += "pci wifi bluetooth bcm4339 bcm43455 nxp8987-sdio"
```

## conf/machine/imx6ulevk.conf
```bitbake
#@TYPE: Machine
#@NAME: NXP i.MX6UL Evaluation Kit
#@SOC: i.MX6UL
#@DESCRIPTION: Machine configuration for NXP i.MX6UL EVK
#@MAINTAINER: Alexandru Palalau <ioan-alexandru.palalau@nxp.com>

MACHINEOVERRIDES =. "mx6ul:"

include conf/machine/include/imx-base.inc
include conf/machine/include/arm/armv7a/tune-cortexa7.inc

MACHINE_FEATURES += "wifi bluetooth bcm4339 bcm43455 nxp8987-sdio"

KERNEL_DEVICETREE = " \
    nxp/imx/imx6ul-14x14-evk-btwifi.dtb \
    nxp/imx/imx6ul-14x14-evk-csi.dtb \
    nxp/imx/imx6ul-14x14-evk.dtb \
    nxp/imx/imx6ul-14x14-evk-ecspi.dtb \
    nxp/imx/imx6ul-14x14-evk-ecspi-slave.dtb \
    nxp/imx/imx6ul-14x14-evk-emmc.dtb \
    nxp/imx/imx6ul-14x14-evk-gpmi-weim.dtb \
    nxp/imx/imx6ul-14x14-evk-reve.dtb \
    nxp/imx/imx6ul-14x14-evk-reve-btwifi.dtb \
    nxp/imx/imx6ul-14x14-evk-reve-csi.dtb \
    nxp/imx/imx6ul-14x14-evk-reve-ecspi.dtb \
    nxp/imx/imx6ul-14x14-evk-reve-ecspi-slave.dtb \
    nxp/imx/imx6ul-14x14-evk-reve-emmc.dtb \
    nxp/imx/imx6ul-14x14-evk-reve-gpmi-weim.dtb \
"
KERNEL_DEVICETREE:use-mainline-bsp = "nxp/imx/imx6ul-14x14-evk.dtb"

### u-boot-fslc settings ###

SPL_BINARY:pn-u-boot-fslc = "SPL"
UBOOT_SUFFIX:pn-u-boot-fslc = "img"

### u-boot-imx settings ###

# The u-boot-imx does not provide SPL support
SPL_BINARY:pn-u-boot-imx = ""
UBOOT_MAKE_TARGET:pn-u-boot-imx = "u-boot.imx"
UBOOT_MAKE_TARGET:pn-u-boot-imx-mfgtool = "u-boot.imx"
UBOOT_SUFFIX:pn-u-boot-imx = "imx"
UBOOT_SUFFIX:pn-u-boot-imx-mfgtool = "imx"

WKS_FILE = " \
    ${@bb.utils.contains('IMX_DEFAULT_BOOTLOADER', \
                         'u-boot-fslc', 'imx-uboot-spl-bootpart.wks.in', \
                                        'imx-uboot-bootpart.wks.in', d)}"

UBOOT_CONFIG ??= " \
    sd \
    ${@bb.utils.contains('MACHINE_FEATURES', 'optee', 'sd-optee', '', d)} \
"
UBOOT_CONFIG[sd]       = "mx6ul_14x14_evk_config,sdcard"
UBOOT_CONFIG[sd-optee] = "mx6ul_14x14_evk_optee_config,sdcard"
UBOOT_CONFIG[emmc]     = "mx6ul_14x14_evk_emmc_config,sdcard"
UBOOT_CONFIG[qspi1]    = "mx6ul_14x14_evk_qspi1_config"

OPTEE_BIN_EXT = "6ulevk"
```

## conf/machine/imx6ullevk.conf
```bitbake
#@TYPE: Machine
#@NAME: NXP i.MX6ULL Evaluation Kit
#@SOC: i.MX6ULL
#@DESCRIPTION: Machine configuration for NXP i.MX6ULL EVK
#@MAINTAINER: Lauren Post <lauren.post@nxp.com>

MACHINEOVERRIDES =. "mx6ull:"

include conf/machine/include/imx-base.inc
include conf/machine/include/arm/armv7a/tune-cortexa7.inc

MACHINE_FEATURES += "wifi bluetooth bcm4339 bcm43455 nxp8801-sdio nxp8987-sdio"

KERNEL_DEVICETREE = " \
    nxp/imx/imx6ull-14x14-evk.dtb \
"

KERNEL_DEVICETREE:append:use-nxp-bsp = " \
    nxp/imx/imx6ull-14x14-evk-btwifi.dtb \
    nxp/imx/imx6ull-14x14-evk-emmc.dtb \
    nxp/imx/imx6ull-14x14-evk-gpmi-weim.dtb \
    nxp/imx/imx6ull-14x14-evk-reve.dtb \
    nxp/imx/imx6ull-14x14-evk-reve-btwifi.dtb \
    nxp/imx/imx6ull-14x14-evk-reve-emmc.dtb \
    nxp/imx/imx6ull-14x14-evk-reve-gpmi-weim.dtb \
"

UBOOT_MAKE_TARGET = "u-boot.imx"
UBOOT_SUFFIX = "imx"

UBOOT_CONFIG ??= " \
    sd \
    ${@bb.utils.contains('MACHINE_FEATURES', 'optee', 'sd-optee', '', d)} \
"
UBOOT_CONFIG[sd]       = "mx6ull_14x14_evk_config,sdcard"
UBOOT_CONFIG[sd-optee] = "mx6ull_14x14_evk_optee_config,sdcard"
UBOOT_CONFIG[emmc]     = "mx6ull_14x14_evk_emmc_config,sdcard"
UBOOT_CONFIG[nand]     = "mx6ull_14x14_evk_nand_config,ubifs"
UBOOT_CONFIG[qspi1]    = "mx6ull_14x14_evk_qspi1_config"

OPTEE_BIN_EXT = "6ullevk"
```

## conf/machine/imx6ulz-14x14-evk.conf
```bitbake
#@TYPE: Machine
#@NAME: NXP i.MX6ULZ 14x14 Evaluation Kit
#@SOC: i.MX6ULZ
#@DESCRIPTION: Machine configuration for NXP i.MX6ULZ 14x14 EVK
#@MAINTAINER: Jun Zhu <junzhu@nxp.com>

MACHINEOVERRIDES =. "mx6ulz:"

include conf/machine/include/imx-base.inc
include conf/machine/include/arm/armv7a/tune-cortexa7.inc

MACHINE_FEATURES += "wifi bluetooth bcm4339 bcm43455 nxp8987-sdio"

KERNEL_DEVICETREE = " \
    nxp/imx/imx6ulz-14x14-evk.dtb \
"
KERNEL_DEVICETREE:append:use-nxp-bsp = " \
    nxp/imx/imx6ulz-14x14-evk-btwifi.dtb \
    nxp/imx/imx6ulz-14x14-evk-emmc.dtb \
    nxp/imx/imx6ulz-14x14-evk-gpmi-weim.dtb \
    nxp/imx/imx6ulz-14x14-evk-reve.dtb \
    nxp/imx/imx6ulz-14x14-evk-reve-btwifi.dtb \
    nxp/imx/imx6ulz-14x14-evk-reve-emmc.dtb \
    nxp/imx/imx6ulz-14x14-evk-reve-gpmi-weim.dtb \
"

UBOOT_MAKE_TARGET = "u-boot.imx"
UBOOT_SUFFIX = "imx"

UBOOT_CONFIG ??= " \
    sd \
    ${@bb.utils.contains('MACHINE_FEATURES', 'optee', 'sd-optee', '', d)} \
"
UBOOT_CONFIG[sd]       = "mx6ulz_14x14_evk_config,sdcard"
UBOOT_CONFIG[sd-optee] = "mx6ulz_14x14_evk_optee_config,sdcard"
UBOOT_CONFIG[emmc]     = "mx6ulz_14x14_evk_emmc_config,sdcard"
UBOOT_CONFIG[nand]     = "mx6ulz_14x14_evk_nand_config,ubifs"
UBOOT_CONFIG[qspi1]    = "mx6ulz_14x14_evk_qspi1_config"

OPTEE_BIN_EXT = "6ulzevk"
```

## conf/machine/imx7dsabresd.conf
```bitbake
#@TYPE: Machine
#@NAME: NXP i.MX7D SABRE Smart Device
#@SOC: i.MX7D
#@DESCRIPTION: Machine configuration for NXP i.MX7D SABRE Smart Device
#@MAINTAINER: Lauren Post <Lauren.Post@nxp.com>

MACHINEOVERRIDES =. "mx7:mx7d:"

require conf/machine/include/imx-base.inc
include conf/machine/include/arm/armv7a/tune-cortexa7.inc

MACHINE_FEATURES += "pci wifi bluetooth bcm4339 bcm43455 nxp8987-sdio"

KERNEL_DEVICETREE = "nxp/imx/imx7d-sdb.dtb"
KERNEL_DEVICETREE:append:use-nxp-bsp = " \
    nxp/imx/imx7d-sdb-epdc.dtb \
    nxp/imx/imx7d-sdb-gpmi-weim.dtb \
    nxp/imx/imx7d-sdb-m4.dtb \
    nxp/imx/imx7d-sdb-mipi-dsi.dtb \
    nxp/imx/imx7d-sdb-mqs.dtb \
    nxp/imx/imx7d-sdb-pcie-ep.dtb \
    nxp/imx/imx7d-sdb-qspi.dtb \
    nxp/imx/imx7d-sdb-reva.dtb \
    nxp/imx/imx7d-sdb-sht11.dtb \
    nxp/imx/imx7d-sdb-usd-wifi.dtb \
"

UBOOT_MAKE_TARGET = "u-boot.imx"
UBOOT_SUFFIX = "imx"

UBOOT_CONFIG ??= " \
    sd \
    ${@bb.utils.contains('MACHINE_FEATURES', 'optee', 'sd-optee', '', d)} \
"
UBOOT_CONFIG[sd]       = "mx7dsabresd_config,sdcard"
UBOOT_CONFIG[sd-optee] = "mx7dsabresd_optee_config,sdcard"
UBOOT_CONFIG[nonsec]   = "mx7dsabresd_nonsec_config,sdcard"
UBOOT_CONFIG[qspi1]    = "mx7dsabresd_qspi1_config"
UBOOT_CONFIG[nand]     = "mx7dsabresd_nand_config,ubifs"
UBOOT_CONFIG[epdc]     = "mx7dsabresd_epdc_config"

OPTEE_BIN_EXT = "7dsdb"

XSERVER += "mesa-driver-swrast"
```

## conf/machine/imx7ulpevk.conf
```bitbake
#@TYPE: Machine
#@NAME: NXP i.MX7ULP Evaluation Kit
#@SOC: i.MX7ULP
#@DESCRIPTION: Machine configuration for NXP i.MX7ULP EVK
#@MAINTAINER: Alexandru Palalau <ioan-alexandru.palalau@nxp.com>

MACHINEOVERRIDES =. "mx7:mx7ulp:"

require conf/machine/include/imx-base.inc
include conf/machine/include/arm/armv7a/tune-cortexa7.inc

MACHINE_FEATURES += "pci wifi bluetooth bcm43430 nxp8987-sdio"

KERNEL_DEVICETREE = " \
	nxp/imx/imx7ulp-evk.dtb \
"
KERNEL_DEVICETREE:append:use-nxp-bsp = " \
	nxp/imx/imx7ulp-evk-ft5416.dtb \
	nxp/imx/imx7ulp-evk-mipi.dtb \
	nxp/imx/imx7ulp-evkb.dtb \
	nxp/imx/imx7ulp-evkb-emmc.dtb \
	nxp/imx/imx7ulp-evkb-lpuart.dtb \
	nxp/imx/imx7ulp-evkb-mipi.dtb \
	nxp/imx/imx7ulp-evkb-rm68191-qhd.dtb \
	nxp/imx/imx7ulp-evkb-rm68200-wxga.dtb \
	nxp/imx/imx7ulp-evkb-sd1.dtb \
	nxp/imx/imx7ulp-evkb-sensors-to-i2c5.dtb \
	nxp/imx/imx7ulp-evkb-spi-slave.dtb \
"

UBOOT_MAKE_TARGET = "u-boot.imx"
UBOOT_SUFFIX = "imx"

UBOOT_CONFIG ??= " \
    sd \
    ${@bb.utils.contains('MACHINE_FEATURES', 'optee', 'sd-optee', '', d)} \
"
UBOOT_CONFIG[sd]       = "mx7ulp_evk_config,sdcard"
UBOOT_CONFIG[sd-optee] = "mx7ulp_evk_optee_config,sdcard"
UBOOT_CONFIG[emmc]     = "mx7ulp_evk_emmc_config,sdcard"

OPTEE_BIN_EXT = "7ulp"

# Set Serial console
SERIAL_CONSOLES = "115200;ttyLP0"
```

## conf/machine/imx8dx-mek.conf
```bitbake
#@TYPE: Machine
#@NAME: i.MX 8DX MEK
#@SOC: i.MX8DX
#@DESCRIPTION: i.MX 8DualX Multisensory Enablement Kit board
#@MAINTAINER: Lauren Post <lauren.post@nxp.com>

MACHINEOVERRIDES =. "mx8dx:"

require include/imx8x-mek.inc

KERNEL_DEVICETREE_BASENAME = "${MACHINE}"

UBOOT_CONFIG_BASENAME = "imx8dx_mek"

ATF_PLATFORM = "imx8dx"

IMX_BOOT_SOC_TARGET = "iMX8DX"
```

## conf/machine/imx8dxl-a1-lpddr4-evk.conf
```bitbake
#@TYPE: Machine
#@NAME: i.MX 8DXL A1 EVK with LPDDR4
#@SOC: i.MX8DXL A1
#@DESCRIPTION: Machine configuration for NXP i.MX 8DualXLite A1 Evaluation Kit with LPDDR4
#@MAINTAINER: Lauren Post <lauren.post@nxp.com>

require conf/machine/include/imx8dxl-lpddr4-evk.inc

IMX_SOC_REV = "A1"
```

## conf/machine/imx8dxl-ddr3-evk.conf
```bitbake
#@TYPE: Machine
#@NAME: i.MX 8DXL EVK with DDR3
#@DESCRIPTION: NXP i.MX 8DXLite Evaluation Kit with DDR3
#@MAINTAINER: Lauren Post <lauren.post@nxp.com>

require conf/machine/include/imx8dxl-evk.inc
KERNEL_DEVICETREE_BASENAME = "imx8dxl-ddr3-evk"
UBOOT_CONFIG_BASENAME = "imx8dxl_ddr3_evk"
UBOOT_CONFIG[nand] = "${UBOOT_CONFIG_BASENAME}_nand_defconfig"
```

## conf/machine/imx8dxl-evk.conf
```bitbake
#@TYPE: Machine
#@NAME: i.MX 8DXL EVK
#@DESCRIPTION: i.MX 8DXLite Evaluation Kit (EVK) board
#@MAINTAINER: Lauren Post <lauren.post@nxp.com>

MACHINEOVERRIDES =. "mx8:mx8x:mx8dxl:"

require conf/machine/include/imx-base.inc
require conf/machine/include/tune-cortexa35.inc

MACHINE_FEATURES += "pci bcm43455 bcm4356"
MACHINE_FEATURES_append_use-nxp-bsp = " bcm4359"

# Don't include kernels in standard images
RDEPENDS_${KERNEL_PACKAGE_NAME}-base = ""

LOADADDR = ""

# Disable the serial console due to auto-serial-console
SERIAL_CONSOLES = "115200;ttyLP0"

# we do not want to have getty running on tty1 as we run
# auto-serial-console there
USE_VT = "0"

KERNEL_DEVICETREE = "freescale/imx8dxl-evk.dtb"
KERNEL_DEVICETREE_append_use-nxp-bsp = " \
    freescale/imx8dxl-evk-enet0.dtb \
    freescale/imx8dxl-evk-enet0-tja1100.dtb \
    freescale/imx8dxl-evk-inmate.dtb \
    freescale/imx8dxl-evk-lpspi-slave.dtb \
    freescale/imx8dxl-evk-pcie-ep.dtb \
    freescale/imx8dxl-evk-root.dtb \
    freescale/imx8dxl-evk-rpmsg.dtb \
"

ATF_PLATFORM = "imx8dxl"
IMX_BOOT_SOC_TARGET = "iMX8DXL"

# This machine is not supported by u-boot-fslc, so we force it to use
# u-boot-imx here.
IMX_DEFAULT_BOOTLOADER = "u-boot-imx"

UBOOT_MAKE_TARGET = "all"
SPL_BINARY = "spl/u-boot-spl.bin"
UBOOT_SUFFIX = "bin"

UBOOT_CONFIG ??= "sd"
UBOOT_CONFIG[sd]   = "imx8dxl_evk_defconfig,sdcard"
UBOOT_CONFIG[fspi] = "imx8dxl_evk_fspi_defconfig"

IMX_BOOT_SEEK = "32"

IMXBOOT_TARGETS_SD = \
    "${@bb.utils.contains('MACHINE_FEATURES', 'optee', 'flash_spl', \
                                                       'flash', d)}"
IMXBOOT_TARGETS_FSPI = \
    "${@bb.utils.contains('MACHINE_FEATURES', 'optee', 'flash_spl_flexspi', \
                                                       'flash_flexspi', d)}"
IMXBOOT_TARGETS = \
    "${@bb.utils.contains('UBOOT_CONFIG',        'sd', '${IMXBOOT_TARGETS_SD}', \
                                                       '${IMXBOOT_TARGETS_FSPI}', d)}"

BOARD_TYPE = "evk"
```

## conf/machine/imx8dxl-lpddr4-evk.conf
```bitbake
#@TYPE: Machine
#@NAME: i.MX 8DXL EVK with LPDDR4
#@DESCRIPTION: i.MX 8DXLite Evaluation Kit with LPDDR4
#@MAINTAINER: Lauren Post <lauren.post@nxp.com>

require conf/machine/include/imx8dxl-evk.inc
KERNEL_DEVICETREE_BASENAME = "imx8dxl-evk"
KERNEL_DEVICETREE:append:use-nxp-bsp = " \
    freescale/${KERNEL_DEVICETREE_BASENAME}-enet0.dtb \
    freescale/${KERNEL_DEVICETREE_BASENAME}-enet0-tja1100.dtb \
    freescale/${KERNEL_DEVICETREE_BASENAME}-inmate.dtb \
    freescale/${KERNEL_DEVICETREE_BASENAME}-lcdif.dtb \
    freescale/${KERNEL_DEVICETREE_BASENAME}-lpspi-slave.dtb \
    freescale/${KERNEL_DEVICETREE_BASENAME}-pcie-ep.dtb \
    freescale/${KERNEL_DEVICETREE_BASENAME}-root.dtb \
"
UBOOT_CONFIG_BASENAME = "imx8dxl_evk"

UBOOT_CONFIG[lcd] = "${UBOOT_CONFIG_BASENAME}_lcd_defconfig"

BOARD_TYPE = "evk"
```

## conf/machine/imx8dxla1-ddr3l-evk.conf
```bitbake
#@TYPE: Machine
#@NAME: i.MX 8DXL A1 EVK with DDR3L
#@SOC: i.MX8DXL A1
#@DESCRIPTION: Machine configuration for NXP i.MX 8DualXLite A1 Evaluation Kit with DDR3L
#@MAINTAINER: Lauren Post <lauren.post@nxp.com>

require conf/machine/include/imx8dxl-ddr3l-evk.inc

IMX_SOC_REV = "A1"
```

## conf/machine/imx8dxlb0-ddr3l-evk.conf
```bitbake
#@TYPE: Machine
#@NAME: i.MX 8DXL B0 EVK with DDR3L
#@SOC: i.MX8DXL B0
#@DESCRIPTION: Machine configuration for NXP i.MX 8DualXLite B0 Evaluation Kit with DDR3L
#@MAINTAINER: Lauren Post <lauren.post@nxp.com>

require conf/machine/include/imx8dxl-ddr3l-evk.inc

IMX_SOC_REV = "B0"

MACHINE_FEATURES:append:use-nxp-bsp = " optee"
```

## conf/machine/imx8dxlb0-lpddr4-evk.conf
```bitbake
#@TYPE: Machine
#@NAME: i.MX 8DXL B0 EVK with LPDDR4
#@SOC: i.MX8DXL B0
#@DESCRIPTION: Machine configuration for NXP i.MX 8DualXLite B0 Evaluation Kit with LPDDR4
#@MAINTAINER: Lauren Post <lauren.post@nxp.com>

require conf/machine/include/imx8dxl-lpddr4-evk.inc

IMX_SOC_REV = "B0"

MACHINE_FEATURES:append:use-nxp-bsp = " optee"
```
