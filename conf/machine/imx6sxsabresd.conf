## conf/machine/imx8dxmek.conf
```bitbake
#@TYPE: Machine
#@NAME: i.MX 8DX MEK
#@DESCRIPTION: i.MX 8DX Multisensory Enablement Kit (MEK) board
#@MAINTAINER: Lauren Post <lauren.post@nxp.com>

MACHINEOVERRIDES =. "mx8:mx8x:mx8qxp:mx8dx:"

require conf/machine/include/imx-base.inc
require conf/machine/include/tune-cortexa35.inc

IMX_DEFAULT_BSP = "nxp"

MACHINE_FEATURES += "pci optee bcm43455 bcm4356"
MACHINE_FEATURES_append_use-nxp-bsp = " bcm4359"

# Don't include kernels in standard images
RDEPENDS_${KERNEL_PACKAGE_NAME}-base = ""

LOADADDR = ""

# We have to disable SERIAL_CONSOLE due to auto-serial-console
SERIAL_CONSOLES = "115200;ttyAMA0"

# we do not want to have getty running on tty1 as we run
# auto-serial-console there
USE_VT = "0"

KERNEL_DEVICETREE = "freescale/imx8dx-mek.dtb"
KERNEL_DEVICETREE_append_use-nxp-bsp = " \
    freescale/imx8dx-mek-dsi-rm67191.dtb \
    freescale/imx8dx-mek-dsi-rm67191-rpmsg.dtb \
    freescale/imx8dx-mek-dsp.dtb \
    freescale/imx8dx-mek-enet2-tja1100.dtb \
    freescale/imx8dx-mek-it6263-lvds0-dual-channel.dtb \
    freescale/imx8dx-mek-it6263-lvds0-dual-channel-rpmsg.dtb \
    freescale/imx8dx-mek-it6263-lvds1-dual-channel.dtb \
    freescale/imx8dx-mek-it6263-lvds1-dual-channel-rpmsg.dtb \
    freescale/imx8dx-mek-jdi-wuxga-lvds0-panel.dtb \
    freescale/imx8dx-mek-jdi-wuxga-lvds0-panel-rpmsg.dtb \
    freescale/imx8dx-mek-jdi-wuxga-lvds1-panel.dtb \
    freescale/imx8dx-mek-jdi-wuxga-lvds1-panel-rpmsg.dtb \
    freescale/imx8dx-mek-ov5640.dtb \
    freescale/imx8dx-mek-ov5640-rpmsg.dtb \
    freescale/imx8dx-mek-rpmsg.dtb \
"

UBOOT_MAKE_TARGET = \
    "${@bb.utils.contains('MACHINE_FEATURES', 'optee', '', \
                                                       'u-boot.bin', d)}"
SPL_BINARY = \
    "${@bb.utils.contains('MACHINE_FEATURES', 'optee', 'spl/u-boot-spl.bin', \
                                                       '', d)}"

UBOOT_CONFIG ??= "sd"
UBOOT_CONFIG[sd]   = "imx8dx_mek_config,sdcard"
UBOOT_CONFIG[fspi] = "imx8dx_mek_fspi_defconfig"

IMX_BOOT_SEEK = "32"

IMXBOOT_TARGETS_SD = \
    "${@bb.utils.contains('MACHINE_FEATURES', 'optee', 'flash_spl', \
                                                       'flash', d)}"
IMXBOOT_TARGETS_FSPI = \
    "${@bb.utils.contains('MACHINE_FEATURES', 'optee', 'flash_spl_flexspi', \
                                                       'flash_flexspi', d)}"
IMXBOOT_TARGETS = \
    "${@bb.utils.contains('UBOOT_CONFIG',        'sd', '${IMXBOOT_TARGETS_SD}', \
                                                       '${IMXBOOT_TARGETS_FSPI}', d)}"

BOARD_TYPE = "mek"

# Add additional firmware
MACHINE_FIRMWARE_append = " linux-firmware-ath10k"
```

## conf/machine/imx8mm-ddr4-evk.conf
```bitbake
#@TYPE: Machine
#@NAME: NXP i.MX 8M Mini EVK with DDR4
#@SOC: i.MX8MM
#@DESCRIPTION: Machine configuration for NXP i.MX 8M Mini Evaluation Kit with DDR4
#@MAINTAINER: Jun Zhu <junzhu@nxp.com>

require include/imx8mm-evk.inc

KERNEL_DEVICETREE_BASENAME = "${MACHINE}"
KERNEL_DEVICETREE:append:use-nxp-bsp = " \
    freescale/${KERNEL_DEVICETREE_BASENAME}-revb.dtb \
    freescale/${KERNEL_DEVICETREE_BASENAME}-revb-rm67191.dtb \
    freescale/${KERNEL_DEVICETREE_BASENAME}-revb-rm67191-cmd-ram.dtb \
    freescale/${KERNEL_DEVICETREE_BASENAME}-revb-rm67199.dtb \
    freescale/${KERNEL_DEVICETREE_BASENAME}-revb-rm67199-cmd-ram.dtb \
"

UBOOT_CONFIG_BASENAME = "imx8mm_ddr4_evk"
UBOOT_CONFIG[nand] = "${UBOOT_CONFIG_BASENAME}_nand_defconfig,ubifs"

DDR_FIRMWARE_NAME = " \
    ddr4_imem_1d.bin \
    ddr4_dmem_1d.bin \
    ddr4_imem_2d.bin \
    ddr4_dmem_2d.bin \
"

IMXBOOT_TARGETS_BASENAME = "flash_ddr4_evk"

# Mainline U-Boot doesn't support DDR4 so it must be set to u-boot-imx.
IMX_DEFAULT_BOOTLOADER = "u-boot-imx"
```

## conf/machine/imx8mm-lpddr4-evk.conf
```bitbake
#@TYPE: Machine
#@NAME: NXP i.MX 8M Mini EVK with LPDDR4
#@SOC: i.MX8MM
#@DESCRIPTION: Machine configuration for NXP i.MX 8M Mini Evaluation Kit with LPDDR4
#@MAINTAINER: Jun Zhu <junzhu@nxp.com>

require include/imx8mm-evk.inc

# The device tree name is implicit for LPDDR4, so can't use MACHINE here
KERNEL_DEVICETREE_BASENAME = "imx8mm-evk"
KERNEL_DEVICETREE:append:use-nxp-bsp = " \
    freescale/${KERNEL_DEVICETREE_BASENAME}-8mic-revE.dtb \
    freescale/${KERNEL_DEVICETREE_BASENAME}-8mic-swpdm.dtb \
    freescale/${KERNEL_DEVICETREE_BASENAME}-ak4497.dtb \
    freescale/${KERNEL_DEVICETREE_BASENAME}-ak5558.dtb \
    freescale/${KERNEL_DEVICETREE_BASENAME}-audio-tdm.dtb \
    freescale/${KERNEL_DEVICETREE_BASENAME}-dpdk.dtb \
    freescale/${KERNEL_DEVICETREE_BASENAME}-ecspi-slave.dtb \
    freescale/${KERNEL_DEVICETREE_BASENAME}-lk.dtb \
    freescale/${KERNEL_DEVICETREE_BASENAME}-inmate.dtb \
    freescale/${KERNEL_DEVICETREE_BASENAME}-qca-wifi.dtb \
    freescale/${KERNEL_DEVICETREE_BASENAME}-revb-qca-wifi.dtb \
    freescale/${KERNEL_DEVICETREE_BASENAME}-root.dtb \
    freescale/${KERNEL_DEVICETREE_BASENAME}-rpmsg.dtb \
    freescale/${KERNEL_DEVICETREE_BASENAME}-rpmsg-wm8524.dtb \
    freescale/${KERNEL_DEVICETREE_BASENAME}-usd-wifi.dtb \
"


UBOOT_CONFIG_BASENAME = "imx8mm_evk"
UBOOT_CONFIG[fspi] = "${UBOOT_CONFIG_BASENAME}_fspi_defconfig"

DDR_FIRMWARE_NAME = " \
    lpddr4_pmu_train_1d_imem.bin \
    lpddr4_pmu_train_1d_dmem.bin \
    lpddr4_pmu_train_2d_imem.bin \
    lpddr4_pmu_train_2d_dmem.bin \
"

IMXBOOT_TARGETS_BASENAME = "flash_evk"
```

## conf/machine/imx8mmevk.conf
```bitbake
#@TYPE: Machine
#@NAME: NXP i.MX8MM LPDDR4 Evaluation Kit and i.MX8MM DDR4 Evaluation Kit
#@SOC: i.MX8MM
#@DESCRIPTION: Machine configuration for NXP i.MX8MMini LPDDR4 EVK and i.MX8MMini DDR4 EVK
#@MAINTAINER: Jun Zhu <junzhu@nxp.com>

MACHINEOVERRIDES =. "mx8:mx8m:mx8mm:"

require conf/machine/include/imx-base.inc
require conf/machine/include/tune-cortexa53.inc

MACHINE_FEATURES += " pci wifi bluetooth optee qca9377 qca6174"

KERNEL_DEVICETREE = "freescale/fsl-imx8mm-evk.dtb \
                     freescale/fsl-imx8mm-evk-ak4497.dtb freescale/fsl-imx8mm-evk-ak5558.dtb \
                     freescale/fsl-imx8mm-evk-audio-tdm.dtb freescale/fsl-imx8mm-evk-inmate.dtb \
                     freescale/fsl-imx8mm-evk-m4.dtb freescale/fsl-imx8mm-evk-rm67191.dtb \
                     freescale/fsl-imx8mm-ddr4-evk.dtb freescale/fsl-imx8mm-ddr4-evk-rm67191.dtb \
                     freescale/fsl-imx8mm-ddr4-qca9377-evk.dtb freescale/fsl-imx8mm-evk-root.dtb"

UBOOT_CONFIG ??= "sd"
UBOOT_CONFIG[sd] = "imx8mm_evk_config,sdcard"
UBOOT_CONFIG[fspi] = "imx8mm_evk_fspi_defconfig"
UBOOT_CONFIG[mfgtool] = "imx8mm_evk_config"
SPL_BINARY = "spl/u-boot-spl.bin"

# Set DDR FIRMWARE
DDR_FIRMWARE_NAME = "lpddr4_pmu_train_1d_imem.bin lpddr4_pmu_train_1d_dmem.bin lpddr4_pmu_train_2d_imem.bin lpddr4_pmu_train_2d_dmem.bin"

# Set u-boot DTB
UBOOT_DTB_NAME = "fsl-imx8mm-evk.dtb"

# Set imx-mkimage boot target
IMXBOOT_TARGETS = "${@bb.utils.contains('UBOOT_CONFIG', 'fspi', 'flash_evk_flexspi', 'flash_evk', d)}"

# Set Serial console
SERIAL_CONSOLES = "115200;ttymxc1"

IMAGE_BOOTLOADER = "imx-boot"

LOADADDR = ""
UBOOT_SUFFIX = "bin"
UBOOT_MAKE_TARGET = ""
IMX_BOOT_SEEK = "33"

OPTEE_BIN_EXT = "8mm"

# Add additional firmware
MACHINE_FIRMWARE_append = " linux-firmware-ath10k"
```

## conf/machine/imx8mn-ddr4-evk.conf
```bitbake
#@TYPE: Machine
#@NAME: NXP i.MX 8M Nano Evaluation Kit with DDR4
#@SOC: i.MX8MM
#@DESCRIPTION: Machine configuration for NXP i.MX 8M Nano EVK with DDR4
#@MAINTAINER: Andrey Zhizhikin <andrey.z@gmail.com>

require include/imx8mn-evk.inc

KERNEL_DEVICETREE_BASENAME = "${MACHINE}"
KERNEL_DEVICETREE:append:use-nxp-bsp = " \
    freescale/${KERNEL_DEVICETREE_BASENAME}-usd-wifi.dtb \
"
UBOOT_CONFIG_BASENAME = "imx8mn_ddr4_evk"

UBOOT_CONFIG[nom] = "${UBOOT_CONFIG_BASENAME}_nom_defconfig"

DDR_FIRMWARE_VERSION = "201810"
DDR_FIRMWARE_NAME = " \
    ddr4_imem_1d_${DDR_FIRMWARE_VERSION}.bin \
    ddr4_dmem_1d_${DDR_FIRMWARE_VERSION}.bin \
    ddr4_imem_2d_${DDR_FIRMWARE_VERSION}.bin \
    ddr4_dmem_2d_${DDR_FIRMWARE_VERSION}.bin \
"
IMXBOOT_TARGETS_BASENAME = "flash_ddr4_evk"

# Mainline BSP doesn't support DDR4 so it must be set to nxp.
# Also this machine isn't supported by u-boot-fslc but imx8mn-evk.inc already
# set the bootloader to u-boot-imx instead when NXP BSP is used.
IMX_DEFAULT_BSP = "nxp"
```

## conf/machine/imx8mn-lpddr4-evk.conf
```bitbake
#@TYPE: Machine
#@NAME: NXP i.MX 8M Nano Evaluation Kit with LPDDR4
#@SOC: i.MX8MN
#@DESCRIPTION: Machine configuration for NXP i.MX 8M Nano EVK with LPDDR4
#@MAINTAINER: Jun Zhu <junzhu@nxp.com>

require include/imx8mn-evk.inc

# The device tree name is implicit for LPDDR4, so can't use MACHINE here
KERNEL_DEVICETREE_BASENAME = "imx8mn-evk"
KERNEL_DEVICETREE:append:use-nxp-bsp = " \
    freescale/${KERNEL_DEVICETREE_BASENAME}-inmate.dtb \
    freescale/${KERNEL_DEVICETREE_BASENAME}-root.dtb \
    freescale/${KERNEL_DEVICETREE_BASENAME}-usd-wifi.dtb \
    freescale/${KERNEL_DEVICETREE_BASENAME}-8mic-revE.dtb \
    freescale/${KERNEL_DEVICETREE_BASENAME}-8mic-swpdm.dtb \
"
UBOOT_CONFIG_BASENAME = "imx8mn_evk"
DDR_FIRMWARE_NAME = " \
    lpddr4_pmu_train_1d_imem.bin \
    lpddr4_pmu_train_1d_dmem.bin \
    lpddr4_pmu_train_2d_imem.bin \
    lpddr4_pmu_train_2d_dmem.bin \
"
IMXBOOT_TARGETS_BASENAME = "flash_evk"

# Mainline BSP doesn't support LPDDR4 so it must be set to nxp.
# Also this machine isn't supported by u-boot-fslc but imx8mn-evk.inc already
# set the bootloader to u-boot-imx instead when NXP BSP is used.
IMX_DEFAULT_BSP = "nxp"
```

## conf/machine/imx8mnevk.conf
```bitbake
#@TYPE: Machine
#@NAME: NXP i.MX8M Nano DDR4 Evaluation Kit
#@SOC: i.MX8MM
#@DESCRIPTION: Machine configuration for NXP i.MX8M Nano DDR4 EVK
#@MAINTAINER: Andrey Zhizhikin <andrey.z@gmail.com>

MACHINEOVERRIDES =. "mx8:mx8m:mx8mn:"

require conf/machine/include/imx-base.inc
require conf/machine/include/tune-cortexa53.inc

MACHINE_FEATURES += "wifi bluetooth optee bcm43455 bcm4356"

# NXP BSP can consume proprietary jailhouse and Broadcom drivers
MACHINE_FEATURES_append_use-nxp-bsp = " jailhouse bcm4359"

# Mainline kernel contains only two DTB file for
# imx8mnevk machine
KERNEL_DEVICETREE = " \
	freescale/imx8mn-ddr4-evk.dtb \
	freescale/imx8mn-evk.dtb \
"

KERNEL_DEVICETREE_append_use-nxp-bsp = " \
	freescale/imx8mn-ddr4-evk-ak5558.dtb \
	freescale/imx8mn-ddr4-evk-inmate.dtb \
	freescale/imx8mn-ddr4-evk-rm67191.dtb \
	freescale/imx8mn-ddr4-evk-root.dtb \
	freescale/imx8mn-ddr4-evk-rpmsg.dtb \
	freescale/imx8mn-ddr4-evk-usd-wifi.dtb \
	freescale/imx8mn-evk-ak5558.dtb \
	freescale/imx8mn-evk-inmate.dtb \
	freescale/imx8mn-evk-rm67191.dtb \
	freescale/imx8mn-evk-root.dtb \
	freescale/imx8mn-evk-rpmsg.dtb \
	freescale/imx8mn-evk-8mic-revE.dtb \
"

UBOOT_CONFIG ??= "sd"
UBOOT_CONFIG[sd]      = "imx8mn_ddr4_evk_defconfig,sdcard"
UBOOT_CONFIG[mfgtool] = "imx8mn_ddr4_evk_defconfig"
SPL_BINARY = "spl/u-boot-spl.bin"

# Set DDR FIRMWARE
DDR_FIRMWARE_NAME = "ddr4_imem_1d_201810.bin \
                     ddr4_dmem_1d_201810.bin \
                     ddr4_imem_2d_201810.bin \
                     ddr4_dmem_2d_201810.bin"

# Set u-boot DTB
UBOOT_DTB_NAME = "imx8mn-ddr4-evk.dtb"

# Set ATF platform name
ATF_PLATFORM = "imx8mn"

# Set imx-mkimage boot target
IMXBOOT_TARGETS = "${@bb.utils.contains('UBOOT_CONFIG', 'fspi', 'flash_ddr4_evk_flexspi', 'flash_ddr4_evk', d)}"
IMX_BOOT_SOC_TARGET = "iMX8MN"

# Set Serial console
SERIAL_CONSOLES = "115200;ttymxc1"

BOOT_SPACE = "65536"
LOADADDR = ""
UBOOT_SUFFIX = "bin"
UBOOT_MAKE_TARGET = ""

# Image boot offset as defined in section 6.1.6.1 "Primary image offset and IVT offset" of
# i.MX 8M Nano Applications Processor Reference Manual, Rev. 0, 12/2019
# Doc ID: IMX8MNRM
IMX_BOOT_SEEK = "32"

OPTEE_BIN_EXT = "8mn"

# Add additional firmware
MACHINE_FIRMWARE_append = " linux-firmware-ath10k"
```

## conf/machine/imx8mnul-ddr3l-evk.conf
```bitbake
#@TYPE: Machine
#@NAME: NXP i.MX 8MNUL EVK with DDR3L
#@SOC: i.MX8MN
#@DESCRIPTION: Machine configuration for NXP i.MX 8M Nano UltraLite Evaluation Kit with DDR3L
#@MAINTAINER: Jun Zhu <junzhu@nxp.com>

MACHINEOVERRIDES =. "mx8mnul:"

require conf/machine/include/imx-base.inc
require conf/machine/include/arm/armv8a/tune-cortexa53.inc

MACHINE_FEATURES += "wifi bluetooth bcm43455 bcm4356"

# NXP BSP can consume proprietary jailhouse and Broadcom drivers
# OP-TEE is also applicable to NXP BSP, mainline BSP seems not to have
# a full support for it yet.
MACHINE_FEATURES:append:use-nxp-bsp = " optee jailhouse bcm4359"

KERNEL_DEVICETREE_BASENAME = "imx8mn-ddr3l-evk"
KERNEL_DEVICETREE = " \
    freescale/${KERNEL_DEVICETREE_BASENAME}.dtb \
"
KERNEL_DEVICETREE:append:use-nxp-bsp = " \
    freescale/${KERNEL_DEVICETREE_BASENAME}-ak5558.dtb \
    freescale/${KERNEL_DEVICETREE_BASENAME}-rpmsg.dtb \
"

UBOOT_DTB_NAME = "${KERNEL_DEVICETREE_BASENAME}.dtb"

IMX_DEFAULT_BOOTLOADER = "u-boot-imx"
IMX_DEFAULT_KERNEL = "linux-imx"

UBOOT_SUFFIX = "bin"

UBOOT_CONFIG ??= "sd"
UBOOT_CONFIG_BASENAME      = "imx8mn_ddr3l_evk"
UBOOT_CONFIG[sd]   = "${UBOOT_CONFIG_BASENAME}_config,sdcard"
UBOOT_CONFIG[fspi] = "${UBOOT_CONFIG_BASENAME}_defconfig"

SPL_BINARY = "spl/u-boot-spl.bin"

ATF_PLATFORM = "imx8mn"

# Set DDR FIRMWARE
DDR_FIRMWARE_VERSION = "201810"
DDR_FIRMWARE_NAME = " \
    ddr3_dmem_1d_${DDR_FIRMWARE_VERSION}.bin \
    ddr3_imem_1d_${DDR_FIRMWARE_VERSION}.bin \
"

# Set imx-mkimage boot target
IMXBOOT_TARGETS_BASENAME = "flash_ddr3l_evk"
IMXBOOT_TARGETS = " \
    ${@bb.utils.contains('UBOOT_CONFIG', 'fspi', '${IMXBOOT_TARGETS_BASENAME}_flexspi', \
                                                 '${IMXBOOT_TARGETS_BASENAME}', d)}"

IMX_BOOT_SOC_TARGET = "iMX8MN"

SERIAL_CONSOLES = "115200;ttymxc1"

IMAGE_BOOTLOADER = "imx-boot"

BOOT_SPACE = "65536"
LOADADDR = ""
UBOOT_MAKE_TARGET = "all"
UBOOT_MAKE_TARGET:pn-u-boot-imx = ""
IMX_BOOT_SEEK = "32"

OPTEE_BIN_EXT = "8mnul"
```

## conf/machine/imx8mp-ddr4-evk.conf
```bitbake
#@TYPE: Machine
#@NAME: NXP i.MX 8M Plus EVK with DDR4
#@SOC: i.MX8MP
#@DESCRIPTION: Machine configuration for NXP i.MX 8M Plus Evaluation Kit with DDR4
#@MAINTAINER: Jun Zhu <junzhu@nxp.com>

require include/imx8mp-evk.inc

# FIXME: This machine is not yet supported by u-boot-fslc, so for now
# use u-boot-imx for mainline.
IMX_DEFAULT_BOOTLOADER:use-mainline-bsp = "u-boot-imx"

KERNEL_DEVICETREE_BASENAME = "${MACHINE}"

UBOOT_CONFIG_BASENAME = "imx8mp_ddr4_evk"
UBOOT_CONFIG[nand] = "${UBOOT_CONFIG_BASENAME}_nand_defconfig"

# Set DDR FIRMWARE
DDR_FIRMWARE_VERSION = "202006"
DDR_FIRMWARE_NAME = " \
    ddr4_dmem_1d_${DDR_FIRMWARE_VERSION}.bin \
    ddr4_imem_1d_${DDR_FIRMWARE_VERSION}.bin \
    ddr4_dmem_2d_${DDR_FIRMWARE_VERSION}.bin \
    ddr4_imem_2d_${DDR_FIRMWARE_VERSION}.bin \
"

IMXBOOT_TARGETS_BASENAME = "flash_ddr4_evk"

# Mainline BSP doesn't support DDR4 so it must be set to nxp.
# Also this machine isn't supported by u-boot-fslc but imx8mp-evk.inc already
# set the bootloader to u-boot-imx instead when NXP BSP is used.
IMX_DEFAULT_BSP = "nxp"
```
