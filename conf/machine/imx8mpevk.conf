## conf/machine/imx8mpevk.conf
```bitbake
#@TYPE: Machine
#@NAME: NXP i.MX8MP Evaluation Kit and i.MX8MP Evaluation Kit
#@SOC: i.MX8MP
#@DESCRIPTION: Machine configuration for NXP i.MX8MP EVK
#@MAINTAINER: Alexandru Palalau <ioan-alexandru.palalau@nxp.com>

MACHINEOVERRIDES =. "mx8:mx8m:mx8mp:"

require conf/machine/include/imx-base.inc
require conf/machine/include/tune-cortexa53.inc

MACHINE_FEATURES += "pci wifi bluetooth optee"
MACHINE_FEATURES_use-nxp-bsp_append = " mrvl8997"

# Mainline kernel contains only one DTB file for
# imx8mpevk machine
KERNEL_DEVICETREE = "freescale/imx8mp-evk.dtb"

# NXP kernel has additional DTB files for various board configuration and
# derivates. Include them here for NXP BSP only
KERNEL_DEVICETREE_use-nxp-bsp_append = " \
	freescale/imx8mp-ab2.dtb \
	freescale/imx8mp-evk-basler.dtb \
	freescale/imx8mp-evk-dsp.dtb \
	freescale/imx8mp-evk-flexcan2.dtb \
	freescale/imx8mp-evk-inmate.dtb \
	freescale/imx8mp-evk-jdi-wuxga-lvds-panel.dtb \
	freescale/imx8mp-evk-it6263-lvds-dual-channel.dtb \
	freescale/imx8mp-evk-ov2775.dtb \
	freescale/imx8mp-evk-rm67191.dtb \
	freescale/imx8mp-evk-root.dtb \
	freescale/imx8mp-evk-rpmsg.dtb \
	freescale/imx8mp-evk-sof-wm8960.dtb \
"

UBOOT_CONFIG ??= "sd"
UBOOT_CONFIG[sd] = "imx8mp_evk_defconfig,sdcard"
UBOOT_CONFIG[fspi] = "imx8mp_evk_defconfig"
UBOOT_CONFIG[ecc] = "imx8mp_evk_inline_ecc_defconfig"
UBOOT_CONFIG[mfgtool] = "imx8mp_evk_defconfig"
SPL_BINARY = "spl/u-boot-spl.bin"

# Set DDR FIRMWARE
DDR_FIRMWARE_NAME = " \
	lpddr4_pmu_train_1d_dmem_201904.bin \
	lpddr4_pmu_train_1d_imem_201904.bin \
	lpddr4_pmu_train_2d_dmem_201904.bin \
	lpddr4_pmu_train_2d_imem_201904.bin \
"

# Set u-boot DTB
UBOOT_DTB_NAME = "imx8mp-evk.dtb"

# Set ATF platform name
ATF_PLATFORM = "imx8mp"

# Set imx-mkimage boot target
IMXBOOT_TARGETS = "${@bb.utils.contains('UBOOT_CONFIG', 'fspi', 'flash_evk_flexspi', 'flash_evk', d)}"
IMX_BOOT_SOC_TARGET = "iMX8MP"

# Set Serial console
SERIAL_CONSOLES = "115200;ttymxc1"

IMAGE_BOOTLOADER = "imx-boot"

LOADADDR = ""
UBOOT_SUFFIX = "bin"
UBOOT_MAKE_TARGET = ""
IMX_BOOT_SEEK = "32"

OPTEE_BIN_EXT = "8mp"

# Add additional firmware
MACHINE_FIRMWARE_append = " linux-firmware-ath10k"
```

## conf/machine/imx8mq-evk.conf
```bitbake
#@TYPE: Machine
#@NAME: NXP i.MX 8M Quad EVK
#@SOC: i.MX8MQ
#@DESCRIPTION: Machine configuration for NXP i.MX 8M Quad Evaluation Kit
#@MAINTAINER: Jun Zhu <junzhu@nxp.com>

MACHINEOVERRIDES =. "mx8mq:"

require conf/machine/include/imx-base.inc
require conf/machine/include/arm/armv8a/tune-cortexa53.inc

# Mainline BSP defaults to "generic" cortexa53 configuration,
# adjust it here to include crypto extension which enables
# inline NEON and FPU code generation
DEFAULTTUNE:use-mainline-bsp = "cortexa53-crypto"

MACHINE_FEATURES += "pci wifi bluetooth bcm43455 bcm4356 nxp8997-pcie nxp8997-sdio nxp9098-pcie nxp9098-sdio"
MACHINE_FEATURES:append:use-nxp-bsp = " optee bcm4359"

MACHINE_SOCARCH_FILTER:append:mx8mq = " virtual/libopenvg virtual/libgles1 virtual/libgles2 virtual/egl virtual/mesa virtual/libgl virtual/libg2d"

KERNEL_DEVICETREE = " \
	freescale/imx8mq-evk.dtb \
"
KERNEL_DEVICETREE:append:use-nxp-bsp = " \
	freescale/imx8mq-evk-ak4497.dtb \
	freescale/imx8mq-evk-audio-tdm.dtb \
	freescale/imx8mq-evk-dcss-adv7535.dtb \
	freescale/imx8mq-evk-dcss-rm67191.dtb \
	freescale/imx8mq-evk-dcss-rm67199.dtb \
	freescale/imx8mq-evk-dp.dtb \
	freescale/imx8mq-evk-dual-display.dtb \
	freescale/imx8mq-evk-inmate.dtb \
	freescale/imx8mq-evk-lcdif-adv7535.dtb \
	freescale/imx8mq-evk-lcdif-rm67191.dtb \
	freescale/imx8mq-evk-lcdif-rm67199.dtb \
	freescale/imx8mq-evk-pcie-ep.dtb \
	freescale/imx8mq-evk-pcie1-m2.dtb \
	freescale/imx8mq-evk-pdm.dtb \
	freescale/imx8mq-evk-root.dtb \
	freescale/imx8mq-evk-rpmsg.dtb \
	freescale/imx8mq-evk-usd-wifi.dtb \
	freescale/imx8mq-evk-usdhc2-m2.dtb \
"

IMX_DEFAULT_BOOTLOADER:use-nxp-bsp = "u-boot-imx"
IMX_DEFAULT_BOOTLOADER:use-mainline-bsp = "u-boot-fslc"

UBOOT_SUFFIX = "bin"

UBOOT_CONFIG ??= "sd"
UBOOT_CONFIG[sd]       = "imx8mq_evk_config,sdcard"

SPL_BINARY = "spl/u-boot-spl.bin"

# Set DDR FIRMWARE
DDR_FIRMWARE_NAME = " \
    lpddr4_pmu_train_1d_imem.bin \
    lpddr4_pmu_train_1d_dmem.bin \
    lpddr4_pmu_train_2d_imem.bin \
    lpddr4_pmu_train_2d_dmem.bin \
"

# Set u-boot DTB
UBOOT_DTB_NAME = "imx8mq-evk.dtb"

# Set ATF platform name
ATF_PLATFORM = "imx8mq"

# Set imx-mkimage boot target
IMXBOOT_TARGETS = "flash_evk flash_evk_no_hdmi flash_dp_evk"
IMX_BOOT_SOC_TARGET = "iMX8M"

# Add support for Syslinux to mainline BSP.
# U-Boot has the Distro Boot mode enabled by default, which
# require that either Syslinux to be enabled, or a boot script
# to be used to define the boot process.
# We opt-in for Syslinux, since it is designated as a preferred
# distro boot mode according to the U-Boot documentation.
UBOOT_EXTLINUX:use-mainline-bsp = "1"
UBOOT_EXTLINUX_LABELS:use-mainline-bsp = "default"
UBOOT_EXTLINUX_DEFAULT_LABEL:use-mainline-bsp = "i.MX8M Quad EVK"

UBOOT_EXTLINUX_MENU_DESCRIPTION:default:use-mainline-bsp = "i.MX8M Quad EVK"
UBOOT_EXTLINUX_FDT:default:use-mainline-bsp     = "../imx8mq-evk.dtb"
UBOOT_EXTLINUX_CONSOLE:default:use-mainline-bsp = "console=${console}"
UBOOT_EXTLINUX_ROOT:default:use-mainline-bsp    ??= "root=/dev/mmcblk1p2"

# Add extlinux.conf to the lis of files, which are deployed onto the
# boot partition
IMAGE_BOOT_FILES:append:use-mainline-bsp = " extlinux.conf;extlinux/extlinux.conf"

LOADADDR = ""
UBOOT_MAKE_TARGET = ""
IMX_BOOT_SEEK = "33"

OPTEE_BIN_EXT = "8mq"

# Add additional firmware
MACHINE_FIRMWARE:append = " linux-firmware-ath10k"
```

## conf/machine/imx8mq-lpddr4-wevk.conf
```bitbake
#@TYPE: Machine
#@NAME: NXP i.MX 8M Quad LPDDR4 WEVK
#@SOC: i.MX8MQ
#@DESCRIPTION: Machine configuration for NXP i.MX 8M Quad LPDDR4 EVK with NXP Wi-Fi
#@MAINTAINER: Jun Zhu <junzhu@nxp.com>

MACHINEOVERRIDES =. "imx8mq-evk:"
require conf/machine/imx8mq-evk.conf

UBOOT_CONFIG ??= "sd"
UBOOT_CONFIG[sd] = "imx8mq_wevk_config,sdcard"

# Set imx-mkimage boot target
IMXBOOT_TARGETS = "flash_evk flash_evk_no_hdmi"

# Mainline BSP doesn't support LPDDR4 WEVK board so it must be set to nxp.
# Also this machine isn't supported by u-boot-fslc but imx8mq-evk.conf already
# set the bootloader to u-boot-imx instead when NXP BSP is used.
IMX_DEFAULT_BSP = "nxp"
```

## conf/machine/imx8mqevk.conf
```bitbake
#@TYPE: Machine
#@NAME: NXP i.MX8MQ Evaluation Kit
#@SOC: i.MX8MQ
#@DESCRIPTION: Machine configuration for NXP i.MX8MQ EVK
#@MAINTAINER: Alexandru Palalau <ioan-alexandru.palalau@nxp.com>

MACHINEOVERRIDES =. "mx8:mx8m:mx8mq:"

require conf/machine/include/imx-base.inc
require conf/machine/include/tune-cortexa53.inc

MACHINE_FEATURES += "pci wifi bluetooth optee qca6174"

MACHINE_SOCARCH_FILTER_append_mx8mq = " virtual/libopenvg virtual/libgles1 virtual/libgles2 virtual/egl virtual/mesa virtual/libgl virtual/libg2d"

KERNEL_DEVICETREE = "freescale/fsl-imx8mq-evk.dtb freescale/fsl-imx8mq-evk-ak4497.dtb \
                     freescale/fsl-imx8mq-evk-audio-tdm.dtb freescale/fsl-imx8mq-evk-b3.dtb \
                     freescale/fsl-imx8mq-evk-dcss-adv7535.dtb freescale/fsl-imx8mq-evk-dcss-rm67191.dtb \
                     freescale/fsl-imx8mq-evk-dcss-adv7535-b3.dtb freescale/fsl-imx8mq-evk-dcss-rm67191-b3.dtb \
                     freescale/fsl-imx8mq-evk-dual-display-b3.dtb \
                     freescale/fsl-imx8mq-evk-dual-display.dtb freescale/fsl-imx8mq-evk-drm.dtb \
                     freescale/fsl-imx8mq-evk-dp.dtb freescale/fsl-imx8mq-evk-edp.dtb \
                     freescale/fsl-imx8mq-evk-inmate.dtb \
                     freescale/fsl-imx8mq-evk-lcdif-adv7535.dtb \
                     freescale/fsl-imx8mq-evk-lcdif-adv7535-b3.dtb \
                     freescale/fsl-imx8mq-evk-m4.dtb freescale/fsl-imx8mq-evk-mipi-csi2.dtb \
                     freescale/fsl-imx8mq-evk-pcie1-m2.dtb freescale/fsl-imx8mq-evk-pdm.dtb \
                     freescale/fsl-imx8mq-evk-root.dtb"

UBOOT_CONFIG ??= "sd"
UBOOT_CONFIG[sd] = "imx8mq_evk_config,sdcard"
UBOOT_CONFIG[mfgtool] = "imx8mq_evk_config"
SPL_BINARY = "spl/u-boot-spl.bin"

# Set DDR FIRMWARE
DDR_FIRMWARE_NAME = "lpddr4_pmu_train_1d_imem.bin lpddr4_pmu_train_1d_dmem.bin lpddr4_pmu_train_2d_imem.bin lpddr4_pmu_train_2d_dmem.bin"

# Set u-boot DTB
UBOOT_DTB_NAME = "fsl-imx8mq-evk.dtb"

# Set imx-mkimage boot target
IMXBOOT_TARGETS = "flash_evk flash_evk_no_hdmi flash_dp_evk"

# Set Serial console
SERIAL_CONSOLES = "115200;ttymxc0"

IMAGE_BOOTLOADER = "imx-boot"

LOADADDR = ""
UBOOT_SUFFIX = "bin"
UBOOT_MAKE_TARGET = ""
IMX_BOOT_SEEK = "33"

OPTEE_BIN_EXT = "8mq"

# Add additional firmware
MACHINE_FIRMWARE_append = " linux-firmware-ath10k"

# Use gstreamer 1.14 from meta-freescale
PREFERRED_VERSION_gstreamer1.0 ?= "1.14.imx"
PREFERRED_VERSION_gstreamer1.0-plugins-base ?= "1.14.imx"
PREFERRED_VERSION_gstreamer1.0-plugins-good ?= "1.14.imx"
PREFERRED_VERSION_gstreamer1.0-plugins-bad ?= "1.14.imx"
PREFERRED_VERSION_gstreamer1.0-libav ?= "1.14.0"
```

## conf/machine/imx8qm-mek.conf
```bitbake
#@TYPE: Machine
#@NAME: i.MX 8QM MEK
#@SOC: i.MX8QM
#@DESCRIPTION: i.MX 8QuadMax Multisensory Enablement Kit board, rev B0
#@MAINTAINER: Lauren Post <lauren.post@nxp.com>

MACHINEOVERRIDES =. "mx8:mx8qm:"

require conf/machine/include/imx-base.inc
require conf/machine/include/arm/armv8a/tune-cortexa72-cortexa53.inc

IMX_DEFAULT_BSP = "nxp"

MACHINE_FEATURES += "pci optee bcm43455 bcm4356 nxp8997-pcie nxp9098-pcie"
MACHINE_FEATURES:append:use-nxp-bsp = " bcm4359"

# Don't include kernels in standard images
RRECOMMENDS:${KERNEL_PACKAGE_NAME}-base = ""

LOADADDR = ""

# We have to disable SERIAL_CONSOLE due to auto-serial-console
SERIAL_CONSOLES = "115200;ttyAMA0"

# we do not want to have getty running on tty1 as we run
# auto-serial-console there
USE_VT = "0"

KERNEL_DEVICETREE = " \
    freescale/imx8qm-mek.dtb \
    freescale/imx8qm-mek-ca53.dtb \
    freescale/imx8qm-mek-ca72.dtb \
    freescale/imx8qm-mek-dsi-rm67191.dtb \
    freescale/imx8qm-mek-dsi-rm67199.dtb \
    freescale/imx8qm-mek-dsi-serdes.dtb \
    freescale/imx8qm-mek-dsi-serdes-dual-display.dtb \
    freescale/imx8qm-mek-dsi-serdes-dual-display-rpmsg.dtb \
    freescale/imx8qm-mek-dsi-serdes-rpmsg.dtb \
    freescale/imx8qm-mek-enet2-tja1100.dtb \
    freescale/imx8qm-mek-hdmi.dtb \
    freescale/imx8qm-mek-hdmi-rx.dtb \
    freescale/imx8qm-mek-hdmi-rx-ov5640.dtb \
    freescale/imx8qm-mek-jdi-wuxga-lvds1-panel.dtb \
    freescale/imx8qm-mek-jdi-wuxga-lvds1-panel-rpmsg.dtb \
    freescale/imx8qm-mek-ov5640.dtb \
    freescale/imx8qm-mek-pcie-ep.dtb \
    freescale/imx8qm-mek-rpmsg.dtb \
    freescale/imx8qm-mek-sof.dtb \
    freescale/imx8qm-mek-sof-cs42888.dtb \
    freescale/imx8qm-mek-sof-wm8960.dtb \
    freescale/imx8qm-mek-usd-wifi.dtb \
    freescale/imx8qm-mek-usdhc3-m2.dtb \
"

UBOOT_MAKE_TARGET = \
    "${@bb.utils.contains('MACHINE_FEATURES', 'optee', '', \
                                                       'u-boot.bin', d)}"
SPL_BINARY = \
    "${@bb.utils.contains('MACHINE_FEATURES', 'optee', 'spl/u-boot-spl.bin', \
                                                       '', d)}"
IMX_DEFAULT_BOOTLOADER:use-nxp-bsp = "u-boot-imx"
IMX_DEFAULT_BOOTLOADER:use-mainline-bsp = "u-boot-fslc"

UBOOT_SUFFIX = "bin"

UBOOT_CONFIG ??= "sd"
UBOOT_CONFIG[sd]      = "imx8qm_mek_defconfig,sdcard"
UBOOT_CONFIG[fspi]    = "imx8qm_mek_fspi_defconfig"

IMX_BOOT_SEEK = "32"

IMAGE_BOOT_FILES += "hdmitxfw.bin hdmirxfw.bin dpfw.bin"

# Set ATF platform name
ATF_PLATFORM = "imx8qm"

IMXBOOT_TARGETS_SD = \
    "${@bb.utils.contains('MACHINE_FEATURES', 'optee', 'flash_spl', \
                                                       'flash flash_ca72', d)}"
IMXBOOT_TARGETS_FSPI = \
    "${@bb.utils.contains('MACHINE_FEATURES', 'optee', 'flash_spl_flexspi', \
                                                       'flash_flexspi', d)}"
IMXBOOT_TARGETS = \
    "${@bb.utils.contains('UBOOT_CONFIG',        'sd', '${IMXBOOT_TARGETS_SD}', \
                                                       '${IMXBOOT_TARGETS_FSPI}', d)}"
IMX_BOOT_SOC_TARGET = "iMX8QM"

BOARD_TYPE = "mek"

# Add additional firmware
MACHINE_FIRMWARE:append = " linux-firmware-ath10k"
```

## conf/machine/imx8qmmek.conf
```bitbake
#@TYPE: Machine
#@NAME: i.MX 8QM MEK
#@DESCRIPTION: i.MX 8QuadMax MEK board
#@MAINTAINER: Alexandru Palalau <ioan-alexandru.palalau@nxp.com>

MACHINEOVERRIDES =. "mx8:mx8qm:"

require conf/machine/include/imx-base.inc
require conf/machine/include/arm/arch-arm64.inc

MACHINE_FEATURES_append = " qca6174"

# Don't include kernels in standard images
RDEPENDS_${KERNEL_PACKAGE_NAME}-base = ""

LOADADDR = ""

# We have to disable SERIAL_CONSOLE due to auto-serial-console
SERIAL_CONSOLES = "115200;ttyAMA0"

# we do not want to have getty running on tty1 as we run
# auto-serial-console there
USE_VT = "0"

KERNEL_DEVICETREE = "freescale/fsl-imx8qm-mek.dtb \
                     freescale/fsl-imx8qm-mek_ca53.dtb freescale/fsl-imx8qm-mek_ca72.dtb \
                     freescale/fsl-imx8qm-mek-dom0.dtb freescale/fsl-imx8qm-mek-dom0-dpu2.dtb \
                     freescale/fsl-imx8qm-mek-domu-car.dtb \
                     freescale/fsl-imx8qm-mek-domu-dpu1.dtb freescale/fsl-imx8qm-mek-domu-dpu1-hdmi.dtb \
                     freescale/fsl-imx8qm-mek-domu.dtb \
                     freescale/fsl-imx8qm-mek-dsi-rm67191.dtb freescale/fsl-imx8qm-mek-dsp.dtb \
                     freescale/fsl-imx8qm-mek-enet2-tja1100.dtb \
                     freescale/fsl-imx8qm-mek-hdmi.dtb freescale/fsl-imx8qm-mek-hdmi-in.dtb \
                     freescale/fsl-imx8qm-mek-inmate.dtb freescale/fsl-imx8qm-mek-jdi-wuxga-lvds1-panel.dtb \
                     freescale/fsl-imx8qm-mek-ov5640.dtb \
                     freescale/fsl-imx8qm-mek-root.dtb \
                     freescale/fsl-imx8qm-mek-rpmsg.dtb "

UBOOT_MAKE_TARGET = "u-boot.bin"
UBOOT_SUFFIX = "bin"
UBOOT_CONFIG ??= "sd"
UBOOT_CONFIG[sd] = "imx8qm_mek_defconfig,sdcard"
UBOOT_CONFIG[fspi] = "imx8qm_mek_fspi_defconfig"
UBOOT_CONFIG[mfgtool] = "imx8qm_mek_defconfig"

IMAGE_BOOTLOADER = "imx-boot"
IMX_BOOT_SEEK = "33"

WKS_FILE_DEPENDS_append = " firmware-imx-8"
IMAGE_BOOT_FILES += "hdmitxfw.bin hdmirxfw.bin dpfw.bin"

IMXBOOT_TARGETS = \
    "${@bb.utils.contains('UBOOT_CONFIG',         'sd', 'flash', \
                                                        'flash_flexspi', d)}"

BOARD_TYPE = "mek"

# Add additional firmware
MACHINE_FIRMWARE_append = " linux-firmware-ath10k"
```
