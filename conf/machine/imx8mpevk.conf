## conf/machine/imx8qxp-mek.conf
```bitbake
#@TYPE: Machine
#@NAME: i.MX 8QXP MEK
#@SOC: i.MX8QXP
#@DESCRIPTION: i.MX 8QuadXPlus Multisensory Enablement Kit board
#@MAINTAINER: Lauren Post <lauren.post@nxp.com>

MACHINEOVERRIDES =. "mx8qxp:"

require include/imx8x-mek.inc

KERNEL_DEVICETREE_BASENAME = "${MACHINE}"
KERNEL_DEVICETREE:append:use-nxp-bsp = " \
    freescale/${KERNEL_DEVICETREE_BASENAME}-a0.dtb \
    freescale/${KERNEL_DEVICETREE_BASENAME}-dpu-lcdif.dtb \
    freescale/${KERNEL_DEVICETREE_BASENAME}-dpu-lcdif-rpmsg.dtb \
    freescale/${KERNEL_DEVICETREE_BASENAME}-dsi-rm67199.dtb \
    freescale/${KERNEL_DEVICETREE_BASENAME}-dsi-rm67199-rpmsg.dtb \
    freescale/${KERNEL_DEVICETREE_BASENAME}-enet2.dtb \
    freescale/${KERNEL_DEVICETREE_BASENAME}-enet2-sja1105.dtb \
    freescale/${KERNEL_DEVICETREE_BASENAME}-enet2-tja1100.dtb \
    freescale/${KERNEL_DEVICETREE_BASENAME}-lcdif.dtb \
    freescale/${KERNEL_DEVICETREE_BASENAME}-lcdif-rpmsg.dtb \
    freescale/${KERNEL_DEVICETREE_BASENAME}-pcie-ep.dtb \
    freescale/${KERNEL_DEVICETREE_BASENAME}-sof.dtb \
    freescale/${KERNEL_DEVICETREE_BASENAME}-sof-cs42888.dtb \
    freescale/${KERNEL_DEVICETREE_BASENAME}-sof-wm8960.dtb \
    freescale/${KERNEL_DEVICETREE_BASENAME}-sof-wm8962.dtb \
    freescale/${KERNEL_DEVICETREE_BASENAME}-max9286.dtb \
    freescale/${KERNEL_DEVICETREE_BASENAME}-max9286-rpmsg.dtb \
    freescale/${KERNEL_DEVICETREE_BASENAME}-ov5640-csi.dtb \
    freescale/${KERNEL_DEVICETREE_BASENAME}-ov5640-csi-rpmsg.dtb \
    freescale/${KERNEL_DEVICETREE_BASENAME}-ov5640-dual.dtb \
    freescale/${KERNEL_DEVICETREE_BASENAME}-ov5640-dual-rpmsg.dtb \
    freescale/${KERNEL_DEVICETREE_BASENAME}-ov5640-parallel.dtb \
    freescale/${KERNEL_DEVICETREE_BASENAME}-ov5640-parallel-rpmsg.dtb \
"

UBOOT_CONFIG_BASENAME = "imx8qxp_mek"

ATF_PLATFORM = "imx8qx"

IMX_BOOT_SOC_TARGET = "iMX8QX"
```

## conf/machine/imx8qxpmek.conf
```bitbake
#@TYPE: Machine
#@NAME: i.MX 8QXP MEK
#@DESCRIPTION: i.MX 8QXP Multisensory Enablement Kit (MEK) board
#@MAINTAINER: Lauren Post <lauren.post@nxp.com>

MACHINEOVERRIDES =. "mx8:mx8x:mx8qxp:"

require conf/machine/include/imx-base.inc
require conf/machine/include/tune-cortexa35.inc

IMX_DEFAULT_BSP = "nxp"

MACHINE_FEATURES += "pci optee bcm43455 bcm4356"
MACHINE_FEATURES_append_use-nxp-bsp = " bcm4359"

# Don't include kernels in standard images
RDEPENDS_${KERNEL_PACKAGE_NAME}-base = ""

LOADADDR = ""

# We have to disable SERIAL_CONSOLE due to auto-serial-console
SERIAL_CONSOLES = "115200;ttyAMA0"

# we do not want to have getty running on tty1 as we run
# auto-serial-console there
USE_VT = "0"

KERNEL_DEVICETREE = " \
	freescale/imx8qxp-mek.dtb \
	freescale/imx8qxp-mek-a0.dtb \
	freescale/imx8qxp-mek-dom0.dtb \
	freescale/imx8qxp-mek-dpu-lcdif.dtb \
	freescale/imx8qxp-mek-dpu-lcdif-rpmsg.dtb \
	freescale/imx8qxp-mek-dsi-rm67191.dtb \
	freescale/imx8qxp-mek-dsi-rm67191-rpmsg.dtb \
	freescale/imx8qxp-mek-dsp.dtb \
	freescale/imx8qxp-mek-enet2-tja1100.dtb \
	freescale/imx8qxp-mek-enet2.dtb \
	freescale/imx8qxp-mek-inmate.dtb \
	freescale/imx8qxp-mek-it6263-lvds0-dual-channel.dtb \
	freescale/imx8qxp-mek-it6263-lvds0-dual-channel-rpmsg.dtb \
	freescale/imx8qxp-mek-it6263-lvds1-dual-channel.dtb \
	freescale/imx8qxp-mek-it6263-lvds1-dual-channel-rpmsg.dtb \
	freescale/imx8qxp-mek-jdi-wuxga-lvds0-panel.dtb \
	freescale/imx8qxp-mek-jdi-wuxga-lvds0-panel-rpmsg.dtb \
	freescale/imx8qxp-mek-jdi-wuxga-lvds1-panel.dtb \
	freescale/imx8qxp-mek-jdi-wuxga-lvds1-panel-rpmsg.dtb \
	freescale/imx8qxp-mek-lcdif.dtb \
	freescale/imx8qxp-mek-lcdif-rpmsg.dtb \
	freescale/imx8qxp-mek-ov5640.dtb \
	freescale/imx8qxp-mek-ov5640-rpmsg.dtb \
	freescale/imx8qxp-mek-pcie-ep.dtb \
	freescale/imx8qxp-mek-root.dtb \
	freescale/imx8qxp-mek-rpmsg.dtb \
	freescale/imx8qxp-mek-sof-cs42888.dtb \
	freescale/imx8qxp-mek-sof-wm8960.dtb \
"

UBOOT_MAKE_TARGET = \
    "${@bb.utils.contains('MACHINE_FEATURES', 'optee', '', \
                                                       'u-boot.bin', d)}"
SPL_BINARY = \
    "${@bb.utils.contains('MACHINE_FEATURES', 'optee', 'spl/u-boot-spl.bin', \
                                                       '', d)}"

UBOOT_CONFIG ??= "sd"
UBOOT_CONFIG[sd]   = "imx8qxp_mek_defconfig,sdcard"
UBOOT_CONFIG[fspi] = "imx8qxp_mek_fspi_defconfig"

IMX_BOOT_SEEK = "32"

# Set ATF platform name
ATF_PLATFORM = "imx8qx"

IMXBOOT_TARGETS_SD = \
    "${@bb.utils.contains('MACHINE_FEATURES', 'optee', 'flash_spl', \
                                                       'flash', d)}"
IMXBOOT_TARGETS_FSPI = \
    "${@bb.utils.contains('MACHINE_FEATURES', 'optee', 'flash_spl_flexspi', \
                                                       'flash_flexspi', d)}"
IMXBOOT_TARGETS = \
    "${@bb.utils.contains('UBOOT_CONFIG',        'sd', '${IMXBOOT_TARGETS_SD}', \
                                                       '${IMXBOOT_TARGETS_FSPI}', d)}"
IMX_BOOT_SOC_TARGET = "iMX8QX"

BOARD_TYPE = "mek"

# Add additional firmware
MACHINE_FIRMWARE_append = " linux-firmware-ath10k"
```

## conf/machine/imx8ulp-lpddr4-evk.conf
```bitbake
#@TYPE: Machine
#@NAME: i.MX 8ULP EVK
#@SOC: i.MX8ULP
#@DESCRIPTION: Machine configuration for NXP i.MX 8ULP Evaluation Kit with LPDDR4
#@MAINTAINER: Jun Zhu <junzhu@nxp.com>

require include/imx8ulp-evk.inc

KERNEL_DEVICETREE_BASENAME = "imx8ulp-evk"

KERNEL_DEVICETREE:append:use-nxp-bsp = " \
    freescale/${KERNEL_DEVICETREE_BASENAME}-epdc.dtb \
    freescale/${KERNEL_DEVICETREE_BASENAME}-flexio-i2c.dtb \
    freescale/${KERNEL_DEVICETREE_BASENAME}-i3c.dtb \
    freescale/${KERNEL_DEVICETREE_BASENAME}-lpa.dtb \
    freescale/${KERNEL_DEVICETREE_BASENAME}-lpspi-slave.dtb \
    freescale/${KERNEL_DEVICETREE_BASENAME}-nd.dtb \
    freescale/${KERNEL_DEVICETREE_BASENAME}-rk055hdmipi4m.dtb \
    freescale/${KERNEL_DEVICETREE_BASENAME}-rk055hdmipi4mv2.dtb \
    freescale/${KERNEL_DEVICETREE_BASENAME}-sof-btsco.dtb \
"

UBOOT_CONFIG_BASENAME = "imx8ulp_evk"

MACHINE_FEATURES += "soc-reva1"
UPOWER_FIRMWARE_NAME = "upower_a1.bin"
IMX_DEFAULT_BSP = "nxp"
```

## conf/machine/imx93-11x11-lpddr4x-evk.conf
```bitbake
#@TYPE: Machine
#@NAME: NXP i.MX 93 11x11 Evaluation Kit with LPDDR4X
#@SOC: i.MX93
#@DESCRIPTION: Machine configuration for NXP i.MX 93 11x11 EVK with LPDDR4X
#@MAINTAINER: Jun Zhu <junzhu@nxp.com>

require include/imx93-evk.inc

KERNEL_DEVICETREE_BASENAME = "imx93-11x11-evk"

KERNEL_DEVICETREE:append:use-nxp-bsp = " \
    freescale/${KERNEL_DEVICETREE_BASENAME}-aud-hat.dtb \
    freescale/${KERNEL_DEVICETREE_BASENAME}-boe-wxga-lvds-panel.dtb \
    freescale/${KERNEL_DEVICETREE_BASENAME}-flexio-i2c.dtb \
    freescale/${KERNEL_DEVICETREE_BASENAME}-flexspi-m2.dtb \
    freescale/${KERNEL_DEVICETREE_BASENAME}-i2c-spi-slave.dtb \
    freescale/${KERNEL_DEVICETREE_BASENAME}-i3c.dtb \
    freescale/${KERNEL_DEVICETREE_BASENAME}-inmate.dtb \
    freescale/${KERNEL_DEVICETREE_BASENAME}-iw612-otbr.dtb \
    freescale/${KERNEL_DEVICETREE_BASENAME}-ld.dtb \
    freescale/${KERNEL_DEVICETREE_BASENAME}-lpuart.dtb \
    freescale/${KERNEL_DEVICETREE_BASENAME}-mqs.dtb \
    freescale/${KERNEL_DEVICETREE_BASENAME}-mt9m114.dtb \
    freescale/${KERNEL_DEVICETREE_BASENAME}-rm67199.dtb \
    freescale/${KERNEL_DEVICETREE_BASENAME}-root.dtb \
    freescale/${KERNEL_DEVICETREE_BASENAME}-rpmsg.dtb \
    freescale/${KERNEL_DEVICETREE_BASENAME}-8mic-reve.dtb \
 "

UBOOT_CONFIG_BASENAME = "imx93_11x11_evk"

DDR_FIRMWARE_NAME = " \
    lpddr4_dmem_1d_v202201.bin \
    lpddr4_dmem_2d_v202201.bin \
    lpddr4_imem_1d_v202201.bin \
    lpddr4_imem_2d_v202201.bin \
"

WKS_FILE_DEPENDS:append:imx-nxp-bsp = " imx-m33-demos"
IMAGE_BOOT_FILES:append:imx-nxp-bsp = " \
    mcore-demos/imx93-11x11-evk_m33_TCM_power_mode_switch.bin \
    mcore-demos/imx93-11x11-evk_m33_TCM_rpmsg_lite_pingpong_rtos_linux_remote.bin \
    mcore-demos/imx93-11x11-evk_m33_TCM_rpmsg_lite_str_echo_rtos.bin \
    mcore-demos/imx93-11x11-evk_m33_TCM_sai_low_power_audio.bin \
"
```

## conf/machine/imx93-14x14-lpddr4x-evk.conf
```bitbake
#@TYPE: Machine
#@NAME: NXP i.MX 93 14x14 Evaluation Kit with LPDDR4X
#@SOC: i.MX93
#@DESCRIPTION: Machine configuration for NXP i.MX 93 14x14 EVK with LPDDR4X
#@MAINTAINER: Jun Zhu <junzhu@nxp.com>

require conf/machine/include/imx93-evk.inc

KERNEL_DEVICETREE_BASENAME = "imx93-14x14-evk"

KERNEL_DEVICETREE:append:use-nxp-bsp = " \
    freescale/${KERNEL_DEVICETREE_BASENAME}-aud-hat.dtb \
    freescale/${KERNEL_DEVICETREE_BASENAME}-dsi-serdes.dtb \
    freescale/${KERNEL_DEVICETREE_BASENAME}-flexspi-m2.dtb \
    freescale/${KERNEL_DEVICETREE_BASENAME}-i3c.dtb \
    freescale/${KERNEL_DEVICETREE_BASENAME}-lvds-it6263.dtb \
    freescale/${KERNEL_DEVICETREE_BASENAME}-mqs.dtb \
    freescale/${KERNEL_DEVICETREE_BASENAME}-rm67199.dtb \
    freescale/${KERNEL_DEVICETREE_BASENAME}-sja1105.dtb \
    freescale/${KERNEL_DEVICETREE_BASENAME}-tja1103.dtb \
    freescale/${KERNEL_DEVICETREE_BASENAME}-8mic-reve.dtb \
"

UBOOT_CONFIG_BASENAME = "imx93_14x14_evk"

DDR_FIRMWARE_NAME = " \
    lpddr4_dmem_1d_v202201.bin \
    lpddr4_dmem_2d_v202201.bin \
    lpddr4_imem_1d_v202201.bin \
    lpddr4_imem_2d_v202201.bin \
"

WKS_FILE_DEPENDS:append:imx-nxp-bsp = " imx-m33-demos"
IMAGE_BOOT_FILES:append:imx-nxp-bsp = " \
    mcore-demos/imx93-14x14-evk_m33_TCM_power_mode_switch.bin \
    mcore-demos/imx93-14x14-evk_m33_TCM_rpmsg_lite_pingpong_rtos_linux_remote.bin \
    mcore-demos/imx93-14x14-evk_m33_TCM_rpmsg_lite_str_echo_rtos.bin \
"
```

## conf/machine/imx93-9x9-lpddr4-qsb.conf
```bitbake
#@TYPE: Machine
#@NAME: NXP i.MX93 9x9 Quick Start Board with LPDDR4
#@SOC: i.MX93
#@DESCRIPTION: Machine configuration for NXP i.MX93 9x9 QSB with LPDDR4
#@MAINTAINER: Jun Zhu <junzhu@nxp.com>

require include/imx93-evk.inc

KERNEL_DEVICETREE_BASENAME = "imx93-9x9-qsb"

KERNEL_DEVICETREE:append:use-nxp-bsp = " \
    freescale/${KERNEL_DEVICETREE_BASENAME}-can1.dtb \
    freescale/${KERNEL_DEVICETREE_BASENAME}-flexspi-m2.dtb \
    freescale/${KERNEL_DEVICETREE_BASENAME}-i3c.dtb \
    freescale/${KERNEL_DEVICETREE_BASENAME}-lpspi-slave.dtb \
    freescale/${KERNEL_DEVICETREE_BASENAME}-lpspi.dtb \
    freescale/${KERNEL_DEVICETREE_BASENAME}-mt9m114.dtb \
    freescale/${KERNEL_DEVICETREE_BASENAME}-ontat-wvga-panel.dtb \
    freescale/${KERNEL_DEVICETREE_BASENAME}-rpmsg.dtb \
    freescale/${KERNEL_DEVICETREE_BASENAME}-rpmsg-lpv.dtb \
    freescale/${KERNEL_DEVICETREE_BASENAME}-tianma-wvga-panel.dtb \
"

UBOOT_CONFIG_BASENAME = "imx93_9x9_qsb"

DDR_FIRMWARE_NAME = " \
    lpddr4_dmem_1d_v202201.bin \
    lpddr4_dmem_2d_v202201.bin \
    lpddr4_imem_1d_v202201.bin \
    lpddr4_imem_2d_v202201.bin \
"

WKS_FILE_DEPENDS:append:imx-nxp-bsp = " imx-m33-demos"
IMAGE_BOOT_FILES:append:imx-nxp-bsp = " \
    mcore-demos/imx93-9x9-qsb_m33_TCM_power_mode_switch.bin \
    mcore-demos/imx93-9x9-qsb_m33_TCM_low_power_wakeword.bin \
    mcore-demos/imx93-9x9-qsb_m33_TCM_rpmsg_lite_pingpong_rtos_linux_remote.bin \
    mcore-demos/imx93-9x9-qsb_m33_TCM_rpmsg_lite_str_echo_rtos.bin \
    mcore-demos/imx93-9x9-qsb_m33_TCM_sai_low_power_audio.bin \
"
```

## conf/machine/imx943-19x19-lpddr4-evk.conf
```bitbake
#@TYPE: Machine
#@NAME: NXP i.MX 943 19x19 Evaluation Kit with LPDDR4
#@SOC: i.MX943
#@DESCRIPTION: Machine configuration for NXP i.MX 943 19x19 EVK with LPDDR4
#@MAINTAINER: Jun Zhu <junzhu@nxp.com>

require conf/machine/include/imx943-evk.inc

KERNEL_DEVICETREE:append:use-nxp-bsp = " \
"

UBOOT_CONFIG_BASENAME = "imx943_evk"

OEI_BOARD  ?= "mx943lp4-19"
DDR_TYPE   = "lpddr4x"
DDR_FIRMWARE_NAME = " \
    lpddr4x_dmem_v202409.bin \
    lpddr4x_dmem_qb_v202409.bin \
    lpddr4x_imem_v202409.bin \
    lpddr4x_imem_qb_v202409.bin \
"
OEI_DDR_CONFIG     = "MIMX943_LPDDR4_EVK_19X19_4266MTS_FW2024.09_timing"
OEI_DDR_CONFIG_ECC = "MIMX943_LPDDR4_EVK_19X19_4266MTS_FW2024.09_ECC_enabled_timing"
```

## conf/machine/imx95-19x19-verdin.conf
```bitbake
#@TYPE: Machine
#@NAME: Toradex i.MX 95 19x19 Verdin Evaluation Kit
#@SOC: i.MX95
#@DESCRIPTION: Machine configuration for Toradex i.MX 95 19x19 Verdin Evaluation Ki
#@MAINTAINER: Flora Hu <flora.hu@nxp.com>

MACHINEOVERRIDES =. "mx95:"

require conf/machine/include/imx95-evk.inc
IMX_DEFAULT_BSP = "nxp"

KERNEL_DEVICETREE_BASENAME = "imx95-19x19-verdin"

KERNEL_DEVICETREE:append:use-nxp-bsp = " \
    freescale/${KERNEL_DEVICETREE_BASENAME}-adv7535.dtb \
    freescale/${KERNEL_DEVICETREE_BASENAME}-adv7535.dtbo \
    freescale/${KERNEL_DEVICETREE_BASENAME}-adv7535-ap1302.dtb \
    freescale/${KERNEL_DEVICETREE_BASENAME}-ap1302.dtb \
    freescale/${KERNEL_DEVICETREE_BASENAME}-ap1302.dtbo \
    freescale/${KERNEL_DEVICETREE_BASENAME}-lt8912.dtb \
    freescale/${KERNEL_DEVICETREE_BASENAME}-lt8912.dtbo \
    freescale/${KERNEL_DEVICETREE_BASENAME}-lt8912-ap1302.dtb \
    freescale/${KERNEL_DEVICETREE_BASENAME}-lt9611uxc.dtb \
    freescale/${KERNEL_DEVICETREE_BASENAME}-lt9611uxc.dtbo \
    freescale/${KERNEL_DEVICETREE_BASENAME}-lt9611uxc-ap1302.dtb \
    freescale/${KERNEL_DEVICETREE_BASENAME}-os08a20.dtb \
    freescale/${KERNEL_DEVICETREE_BASENAME}-os08a20.dtbo \
    freescale/${KERNEL_DEVICETREE_BASENAME}-os08a20-isp-lt8912.dtb \
    freescale/${KERNEL_DEVICETREE_BASENAME}-ox03c10.dtb \
    freescale/${KERNEL_DEVICETREE_BASENAME}-ox03c10.dtbo \
    freescale/${KERNEL_DEVICETREE_BASENAME}-ox03c10-isp-lt8912.dtb \
    freescale/${KERNEL_DEVICETREE_BASENAME}-ox05b1s.dtb \
    freescale/${KERNEL_DEVICETREE_BASENAME}-ox05b1s.dtbo \
    freescale/${KERNEL_DEVICETREE_BASENAME}-ox05b1s-isp-lt8912.dtb \
    freescale/${KERNEL_DEVICETREE_BASENAME}-panel-cap-touch-10inch-dsi.dtb \
    freescale/${KERNEL_DEVICETREE_BASENAME}-panel-cap-touch-10inch-dsi.dtbo \
    freescale/${KERNEL_DEVICETREE_BASENAME}-panel-cap-touch-10inch-lvds.dtb \
    freescale/${KERNEL_DEVICETREE_BASENAME}-rm692c9.dtb \
    freescale/${KERNEL_DEVICETREE_BASENAME}-rm692c9.dtbo \
    freescale/${KERNEL_DEVICETREE_BASENAME}-rpmsg.dtb \
    freescale/${KERNEL_DEVICETREE_BASENAME}-ti-serdes.dtb \
    freescale/${KERNEL_DEVICETREE_BASENAME}-ti-serdes.dtbo \
"

UBOOT_CONFIG_BASENAME = "imx95_19x19_verdin"

UBOOT_CONFIG ??= "sd"
UBOOT_CONFIG[sd]    = "${UBOOT_CONFIG_BASENAME}_defconfig"
UBOOT_CONFIG[fspi]  = "${UBOOT_CONFIG_BASENAME}_fspi_defconfig"

IMXBOOT_TARGETS = "flash_a55"

OEI_BOARD  = "mx95lp5"
DDR_TYPE   = "lpddr5"

DDR_FIRMWARE_NAME = " \
    lpddr5_dmem_v202311.bin \
    lpddr5_dmem_qb_v202311.bin \
    lpddr5_imem_v202311.bin \
    lpddr5_imem_qb_v202311.bin \
"

IMXBOOT_VARIANT = ""

# The System Manager Firmware Name corresponds to a particular binary implementation
# in the Yocto deploy folder. The name is comprised of the Firmware Basename and the
# default system manager Config name, e.g., m33_image-mx95evk.bin and
# m33_image-mx95evk_fusa.bin for the standard BSP version and FuSa version, respectively
# The System Manager Firmware Basename is an alias used by imx-boot instead of using
# a unique name for each implementation, e.g., m33_image.bin for i.MX 95
SYSTEM_MANAGER_FIRMWARE_BASENAME ?= "m33_image"
SYSTEM_MANAGER_FIRMWARE_NAME     ?= "m33_image-mx95evk"
```

## conf/machine/include/e500mc.inc
```bitbake
TARGET_FPU = "hard"

require conf/machine/include/powerpc/tune-ppce500mc.inc
require conf/machine/include/qoriq-ppc.inc

MACHINEOVERRIDES =. "e500mc:"
```

## conf/machine/include/e500v2.inc
```bitbake
require conf/machine/include/powerpc/tune-ppce500v2.inc

MACHINEOVERRIDES =. "e500v2:"
require conf/machine/include/qoriq-ppc.inc
```

## conf/machine/include/e5500-64b.inc
```bitbake
TARGET_FPU = "hard"
DEFAULTTUNE ?= "ppc64e5500"

require conf/machine/include/powerpc/tune-ppce5500.inc
require conf/machine/include/qoriq-ppc.inc

MACHINEOVERRIDES =. "e5500-64b:"

require conf/multilib.conf
MULTILIBS ?= "multilib:lib32"
DEFAULTTUNE:virtclass-multilib-lib32 ?= "ppce5500"
```

## conf/machine/include/e5500.inc
```bitbake
TARGET_FPU = "hard"

require conf/machine/include/powerpc/tune-ppce5500.inc
require conf/machine/include/qoriq-ppc.inc

MACHINEOVERRIDES =. "e5500:"
```
