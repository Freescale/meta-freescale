## conf/machine/include/imx943-evk.inc
```bitbake
MACHINEOVERRIDES =. "mx943:"

require conf/machine/include/imx-base.inc
require conf/machine/include/arm/armv8-2a/tune-cortexa55.inc

MACHINE_FEATURES += "pci wifi bluetooth"
MACHINE_FEATURES:append:use-nxp-bsp = " crrm optee dpdk nxpiw612-sdio nxp9098-pcie nxpaw693-pcie jailhouse rvgpu-emu"

KERNEL_DEVICETREE_BASENAME = "imx943-evk"
KERNEL_DEVICETREE = " \
    freescale/${KERNEL_DEVICETREE_BASENAME}.dtb \
    freescale/${KERNEL_DEVICETREE_BASENAME}-crrm.dtb \
    freescale/${KERNEL_DEVICETREE_BASENAME}-inmate.dtb \
    freescale/${KERNEL_DEVICETREE_BASENAME}-netc-rpmsg.dtb \
    freescale/${KERNEL_DEVICETREE_BASENAME}-mqs.dtb \
    freescale/${KERNEL_DEVICETREE_BASENAME}-pcie1-ep.dtb \
    freescale/${KERNEL_DEVICETREE_BASENAME}-pcie1-ep.dtbo \
    freescale/${KERNEL_DEVICETREE_BASENAME}-rpmsg.dtb \
    freescale/${KERNEL_DEVICETREE_BASENAME}-root.dtb \
    freescale/${KERNEL_DEVICETREE_BASENAME}-sdwifi.dtb \
    freescale/${KERNEL_DEVICETREE_BASENAME}-sgmii.dtb \
"
UBOOT_DTB_NAME = "${KERNEL_DEVICETREE_BASENAME}.dtb"

IMX_DEFAULT_BOOTLOADER:use-nxp-bsp = "u-boot-imx"
IMX_DEFAULT_BOOTLOADER:use-mainline-bsp = "u-boot-fslc"

LOADADDR = ""
UBOOT_SUFFIX = "bin"
UBOOT_MAKE_TARGET = ""

SPL_BINARY = "spl/u-boot-spl.bin"

UBOOT_CONFIG ??= "${@bb.utils.contains('COMBINED_FEATURES', 'crrm', 'crrm', 'sd', d)}"
UBOOT_CONFIG[sd]     = "${UBOOT_CONFIG_BASENAME}_defconfig"
UBOOT_CONFIG[sd-ecc] = "${UBOOT_CONFIG_BASENAME}_defconfig"
UBOOT_CONFIG[crrm]   = "${UBOOT_CONFIG_BASENAME}_xspi_crrm_defconfig"
UBOOT_CONFIG[xspi]   = "${UBOOT_CONFIG_BASENAME}_xspi_defconfig"
UBOOT_CONFIG_IMAGE_FSTYPES[sd]     = "sdcard"
UBOOT_CONFIG_IMAGE_FSTYPES[sd-ecc] = "sdcard"

ATF_PLATFORM = "imx94"
OEI_CORE = "m33"

IMXBOOT_VARIANTS = "alt jailhouse rpmsg netc netc_reset netc_standalone"
# imx943 netc have different mcore demo for different bootloader
#| |Standard | netc | netc_reset | netc_standalone
#|--|--|--|--|--|
#| M33S | imx943evk_cm33_core1_TCM_power_mode_switch.bin | imx943evk_cm33_core1_TCM_netc_share.bin | imx943evk_cm33_core1_TCM_all_reset_but_netc_switch.bin | imx943evk_cm33_core1_TCM_netc_switch_standalone.bin |
#| M70 | imx943evk_cm7_core0_TCM_power_mode_switch.bin | imx943evk_cm7_core0_TCM_power_mode_switch.bin | imx943evk_cm7_core0_TCM_power_mode_switch.bin | imx943evk_cm7_core0_TCM_power_mode_switch.bin |
#| M71 | imx943evk_cm7_core1_TCM_power_mode_switch.bin | imx943evk_cm7_core1_TCM_power_mode_switch.bin | imx943evk_cm7_core1_TCM_all_reset_but_netc_trigger.bin | imx943evk_cm7_core1_TCM_power_mode_switch.bin |

M33_IMAGE = "${@bb.utils.contains('IMXBOOT_VARIANT', 'netc',            'imx943evk_cm33_core1_TCM_netc_share.bin', \
                bb.utils.contains('IMXBOOT_VARIANT', 'netc_reset',      'imx943evk_cm33_core1_TCM_all_reset_but_netc_switch.bin', \
                bb.utils.contains('IMXBOOT_VARIANT', 'netc_standalone', 'imx943evk_cm33_core1_TCM_netc_switch_standalone.bin', \
                                                                        'imx943evk_cm33_core1_TCM_power_mode_switch.bin', d), d), d)}"
M70_IMAGE = "imx943evk_cm7_core0_TCM_power_mode_switch.bin"
M71_IMAGE = "${@bb.utils.contains('IMXBOOT_VARIANT', 'netc_reset', 'imx943evk_cm7_core1_TCM_all_reset_but_netc_trigger.bin', \
                                                                   'imx943evk_cm7_core1_TCM_power_mode_switch.bin', d)}"

# Multiple system manager configs by IMXBOOT_VARIANT
SYSTEM_MANAGER_CONFIG = "${@bb.utils.contains('IMXBOOT_VARIANT', 'alt',            'mx94alt', \
                           bb.utils.contains('IMXBOOT_VARIANT', 'jailhouse',       'mx94evkjailhouse', \
                           bb.utils.contains('IMXBOOT_VARIANT', 'netc',            'mx94evknetc', \
                           bb.utils.contains('IMXBOOT_VARIANT', 'netc_standalone', 'mx94evknetc', \
                           bb.utils.contains('IMXBOOT_VARIANT', 'netc_reset',      'mx94evknetc', \
                           bb.utils.contains('IMXBOOT_VARIANT', 'rpmsg',           'mx94evkrpmsg', \
                                                                                   'mx94evk', d), d), d), d), d),d) }"

MSEL_TYPE = "${@bb.utils.contains('IMXBOOT_VARIANT', 'alt',       '1', \
                                                                  '0', d)}"

SYSTEM_MANAGER_FIRMWARE_BASENAME = "m33_image"

IMXBOOT_TARGETS_BASENAME = "flash"

# imx-boot (flash.bin) targets based on UBOOT_CONFIG and IMXBOOT_VARIANT
IMXBOOT_TARGETS_SD = "${@bb.utils.contains('IMXBOOT_VARIANT', 'alt',             '${IMXBOOT_TARGETS_BASENAME}_a55', \
                         bb.utils.contains('IMXBOOT_VARIANT', 'jailhouse',       '${IMXBOOT_TARGETS_BASENAME}_jailhouse', \
                         bb.utils.contains('IMXBOOT_VARIANT', 'netc',            '${IMXBOOT_TARGETS_BASENAME}_all', \
                         bb.utils.contains('IMXBOOT_VARIANT', 'netc_standalone', '${IMXBOOT_TARGETS_BASENAME}_all', \
                         bb.utils.contains('IMXBOOT_VARIANT', 'netc_reset',      '${IMXBOOT_TARGETS_BASENAME}_all', \
                         bb.utils.contains('IMXBOOT_VARIANT', 'rpmsg',           '${IMXBOOT_TARGETS_BASENAME}_a55', \
                                                                                 '${IMXBOOT_TARGETS_BASENAME}_all ${IMXBOOT_TARGETS_BASENAME}_a55', d), d), d), d), d), d)} \
"

IMXBOOT_TARGETS = " \
    ${@bb.utils.contains('UBOOT_CONFIG', 'crrm',   'flash_a55_xspi_crrm', \
       bb.utils.contains('UBOOT_CONFIG', 'xspi',   'flash_a55_xspi', \
       bb.utils.contains('UBOOT_CONFIG', 'sd-ecc', '${IMXBOOT_TARGETS_BASENAME}_all', \
                                                   '${IMXBOOT_TARGETS_SD}', d), d), d)}"

IMX_BOOT_SOC_TARGET = "iMX94"
IMX_BOOT_SEEK = "32"

# We have to disable SERIAL_CONSOLE due to auto-serial-console
SERIAL_CONSOLES = "115200;ttyLP0"

IMX_DEFAULT_BSP = "nxp"

WKS_FILE_DEPENDS:append:imx-nxp-bsp = " imx-mcore-demos"
IMAGE_BOOT_FILES:append:imx-nxp-bsp = " \
    mcore-demos/imx943evk_cm33_core1_TCM_all_reset_but_netc_switch.bin \
    mcore-demos/imx943evk_cm33_core1_TCM_hello_world.bin \
    mcore-demos/imx943evk_cm33_core1_TCM_netc_share.bin \
    mcore-demos/imx943evk_cm33_core1_TCM_netc_switch_standalone.bin \
    mcore-demos/imx943evk_cm33_core1_TCM_power_mode_switch.bin \
    mcore-demos/imx943evk_cm33_core1_TCM_rpmsg_lite_pingpong_rtos_linux_remote.bin \
    mcore-demos/imx943evk_cm33_core1_TCM_rpmsg_lite_str_echo_rtos.bin \
    mcore-demos/imx943evk_cm7_core0_TCM_hello_world.bin \
    mcore-demos/imx943evk_cm7_core0_TCM_power_mode_switch.bin \
    mcore-demos/imx943evk_cm7_core0_TCM_rpmsg_lite_pingpong_rtos_linux_remote.bin \
    mcore-demos/imx943evk_cm7_core0_TCM_rpmsg_lite_str_echo_rtos.bin \
    mcore-demos/imx943evk_cm7_core0_TCM_sai_low_power_audio.bin \
    mcore-demos/imx943evk_cm7_core1_TCM_all_reset_but_netc_trigger.bin \
    mcore-demos/imx943evk_cm7_core1_TCM_hello_world.bin \
    mcore-demos/imx943evk_cm7_core1_TCM_power_mode_switch.bin \
    mcore-demos/imx943evk_cm7_core1_TCM_rpmsg_lite_pingpong_rtos_linux_remote.bin \
    mcore-demos/imx943evk_cm7_core1_TCM_rpmsg_lite_str_echo_rtos.bin \
"
```

## conf/machine/include/imx95-evk.inc
```bitbake
require conf/machine/include/imx-base.inc
require conf/machine/include/arm/armv8-2a/tune-cortexa55.inc

MACHINE_FEATURES += "pci wifi bluetooth optee"
MACHINE_FEATURES:append:use-nxp-bsp = " nxpwifi-all-pcie nxpwifi-all-sdio jailhouse dpdk xen"

KERNEL_DEVICETREE = " \
    freescale/${KERNEL_DEVICETREE_BASENAME}.dtb \
"

IMX_DEFAULT_BOOTLOADER:use-nxp-bsp = "u-boot-imx"
IMX_DEFAULT_BOOTLOADER:use-mainline-bsp = "u-boot-fslc"

LOADADDR = ""
UBOOT_SUFFIX = "bin"
UBOOT_MAKE_TARGET = ""

SPL_BINARY = "spl/u-boot-spl.bin"

UBOOT_CONFIG ??= "sd"
UBOOT_CONFIG[sd] = "${UBOOT_CONFIG_BASENAME}_evk_defconfig,sdcard"
UBOOT_CONFIG[fspi] = "${UBOOT_CONFIG_BASENAME}_evk_fspi_defconfig"

ATF_PLATFORM = "imx95"
OEI_CONFIGS = "ddr tcm"
OEI_CORE   = "m33"
OEI_SOC    = "mx95"
OEI_BOARD  ?= "mx95lp5"
DDR_TYPE   ?= "lpddr5"

IMXBOOT_VARIANTS = "alt jailhouse netc"

# Multiple system manager configs by IMXBOOT_VARIANT
SYSTEM_MANAGER_CONFIG = "${@bb.utils.contains('IMXBOOT_VARIANT', 'alt',       'mx95alt', \
                            bb.utils.contains('IMXBOOT_VARIANT', 'jailhouse', 'mx95evkjailhouse', \
                            bb.utils.contains('IMXBOOT_VARIANT', 'netc',      'mx95netc', \
                                                                              'mx95evk', d), d), d)}"

# imx-boot (flash.bin) targets based on UBOOT_CONFIG and IMXBOOT_VARIANT
IMXBOOT_TARGETS_SD = "${@bb.utils.contains('IMXBOOT_VARIANT', 'alt',       '${IMXBOOT_TARGETS_BASENAME}_alt', \
                         bb.utils.contains('IMXBOOT_VARIANT', 'jailhouse', '${IMXBOOT_TARGETS_BASENAME}_jailhouse', \
                         bb.utils.contains('IMXBOOT_VARIANT', 'netc',      '${IMXBOOT_TARGETS_BASENAME}_netc', \
                                                                           '${IMXBOOT_TARGETS_BASENAME}_all ${IMXBOOT_TARGETS_BASENAME}_a55', d), d), d)} \
"

IMXBOOT_TARGETS = " \
    ${@bb.utils.contains('UBOOT_CONFIG', 'fspi', '${IMXBOOT_TARGETS_BASENAME}_a55_flexspi', '${IMXBOOT_TARGETS_SD}', d)} \
"

IMX_BOOT_SOC_TARGET = "iMX95"
IMX_BOOT_SEEK = "32"

# We have to disable SERIAL_CONSOLE due to auto-serial-console
SERIAL_CONSOLES = "115200;ttyLP0"

IMX_DEFAULT_BSP = "nxp"
```

## conf/machine/include/qoriq-arm.inc
```bitbake
# Provides the common settings for QorIQ ARM

# default assignment to override defaults from kernel.bbclass
# should be assigned by machine if other type needed
KERNEL_IMAGETYPE ?= "uImage"

SERIAL_CONSOLES ?= "115200;ttyS0 115200;ttyS1 115200;ttyEHV0 115200;ttyLP0 115200;ttyAMA0"
SERIAL_CONSOLES_CHECK ?= "${SERIAL_CONSOLES}"

MACHINEOVERRIDES =. "qoriq-arm:"

require conf/machine/include/qoriq-base.inc
```

## conf/machine/include/qoriq-arm64.inc
```bitbake
# Provides the QorIQ common settings for ARM64

KERNEL_IMAGETYPE ?= "Image"

SERIAL_CONSOLES ?= "115200;ttyS0 115200;ttyS1 115200;ttyAMA0"
SERIAL_CONSOLES_CHECK ?= "${SERIAL_CONSOLES}"

MACHINEOVERRIDES =. "qoriq-arm64:"

require conf/machine/include/qoriq-base.inc
```

## conf/machine/include/qoriq-base.inc
```bitbake
# common providers of QorIQ targets
PREFERRED_PROVIDER_u-boot ??= "u-boot-qoriq"
PREFERRED_PROVIDER_virtual/bootloader ??= "${PREFERRED_PROVIDER_u-boot}"
PREFERRED_PROVIDER_virtual/kernel ??= "linux-qoriq"
PREFERRED_PROVIDER_u-boot-tools-native ??= "u-boot-tools-native"
PREFERRED_PROVIDER_u-boot-mkimage-native ??= "u-boot-tools-native"
PREFERRED_PROVIDER_u-boot-mkimage ??= "u-boot-tools"
PREFERRED_PROVIDER_nativesdk-u-boot-mkimage ??= "nativesdk-u-boot-tools"
PREFERRED_VERSION_testfloat = "2a"

SOC_DEFAULT_IMAGE_FSTYPES = "tar.gz"
SOC_DEFAULT_IMAGE_FSTYPES:append:ls1043a = " wic.bz2"
SOC_DEFAULT_IMAGE_FSTYPES:append:ls1046a = " wic.bz2"
IMAGE_FSTYPES ?= "${SOC_DEFAULT_IMAGE_FSTYPES}"

# Composite Image Layout (in KBytes)
IMAGE_OFFSET_PBL ?= "4"
IMAGE_OFFSET_FIP ?= "1024"
IMAGE_OFFSET_FMAN_UCODE ?= "9216"

# Composite Image Filenames
IMAGE_FILE_PBL_SD ?= "atf/bl2_sd.pbl"
IMAGE_FILE_FIP_UBOOT ?= "atf/fip_uboot.bin"

# Do not update fstab file when using wic images
WIC_CREATE_EXTRA_ARGS ?= "--no-fstab-update"

IMAGE_BOOT_FILES ?= " \
    ${KERNEL_IMAGETYPE} \
    *.dtb \
"

SOC_DEFAULT_WKS_FILE ?= ""
SOC_DEFAULT_WKS_FILE:ls1043a ?= "ls104x-uboot-bootpart.wks.in"
SOC_DEFAULT_WKS_FILE:ls1046a ?= "ls104x-uboot-bootpart.wks.in"

WKS_FILE ?= "${SOC_DEFAULT_WKS_FILE}"

MACHINE_FEATURES ?= "pci ext2 ext3 serial"
MACHINE_EXTRA_RRECOMMENDS += "udev-extraconf udev-rules-qoriq kernel-modules"

EXTRA_IMAGEDEPENDS += "u-boot qoriq-cst-native"

MACHINEOVERRIDES =. "qoriq:"

# Machines or distros can define which BSP it should use by default. We are
# intending to default for nxp BSP by default and specific machines or
# DISTROs might change it if need.
#
# Two values are considered valid: mainline, nxp
QORIQ_DEFAULT_BSP ?= "nxp"

MACHINEOVERRIDES =. "use-${QORIQ_DEFAULT_BSP}-bsp:"

# Sub-architecture support
MACHINE_SOCARCH_SUFFIX ?= ""
MACHINE_SOCARCH_SUFFIX:qoriq = "-qoriq"

MACHINE_ARCH_FILTER = "virtual/kernel"

INHERIT += "fsl-dynamic-packagearch"
```

## conf/machine/include/qoriq-ppc.inc
```bitbake
# Provides the common settings for QorIQ PPC

KERNEL_IMAGETYPE ?= "uImage"

SERIAL_CONSOLES ?= "115200;ttyS0 115200;ttyS1 115200;ttyEHV0"
SERIAL_CONSOLES_CHECK ?= "${SERIAL_CONSOLES}"

MACHINEOVERRIDES =. "qoriq-ppc:"

require conf/machine/include/qoriq-base.inc
```

## conf/machine/ls1012afrdm-32b.conf
```bitbake
#@TYPE: Machine
#@NAME: NXP LS1012AFRDM board
#@SOC: LSCH2
#@DESCRIPTION: Machine configuration for NXP QorIQ LS1012ARDB
#              with ARM Cortext-A53 core
#@MAINTAINER: Zongchun Yu <Zongchun.Yu@nxp.com>

MACHINEOVERRIDES =. "fsl-lsch2:fsl-lsch2-32b:ls1012a:"

require conf/machine/include/qoriq-arm.inc
require conf/machine/include/arm/arch-arm64.inc

DEFAULTTUNE = "armv7ahf-neon"

KERNEL_CLASSES  = " kernel-itbimage "
KERNEL_IMAGETYPES = "itbImage"

DTB_LOAD = "0x90000000"
UBOOT_ENTRYPOINT = "0x80008000"

UBOOT_CONFIG ??= "qspi"
UBOOT_CONFIG[qspi] = "ls1012afrdm_qspi_defconfig,,u-boot-dtb.bin"

KERNEL_IMAGETYPE = "zImage"
KERNEL_DEVICETREE ?= "freescale/fsl-ls1012a-frdm.dtb"
KERNEL_DEFCONFIG ?= "multi_v7_defconfig"

EXTRA_IMAGEDEPENDS += "ppa rcw"
USE_VT = "0"

require conf/multilib.conf
MULTILIBS ?= "multilib:lib64"
DEFAULTTUNE_virtclass-multilib-lib64 ?= "aarch64"
```

## conf/machine/ls1012afrdm.conf
```bitbake
#@TYPE: Machine
#@NAME: NXP LS1012AFRDM board
#@SOC: LSCH2
#@DESCRIPTION: Machine configuration for NXP QorIQ LS1012ARDB
#              with ARM Cortext-A53 core
#@MAINTAINER: Zongchun Yu <Zongchun.Yu@nxp.com>

MACHINEOVERRIDES =. "fsl-lsch2:ls1012a:"

require conf/machine/include/qoriq-arm64.inc
require conf/machine/include/arm/arch-arm64.inc

KERNEL_CLASSES  = " kernel-itbimage "
KERNEL_IMAGETYPES = "itbImage"

DTB_LOAD = "0x90000000"
UBOOT_ENTRYPOINT = "0x80080000"

UBOOT_CONFIG ??= "qspi"
UBOOT_CONFIG[qspi] = "ls1012afrdm_qspi_defconfig,,u-boot-dtb.bin"

KERNEL_DEVICETREE ?= "freescale/fsl-ls1012a-frdm.dtb"
KERNEL_DEFCONFIG ?= "defconfig"

EXTRA_IMAGEDEPENDS += "ppa ppfe-firmware rcw"
USE_VT = "0"
```

## conf/machine/ls1012afrwy-32b.conf
```bitbake
#@TYPE: Machine
#@NAME: NXP LS1012AFRWY board
#@SOC: LSCH2
#@DESCRIPTION: Machine configuration for NXP QorIQ LS1012AFRWY in 32-bit mode
#              with ARM Cortext-A53 core
#@MAINTAINER: Chunrong Guo <Chunrong.Guo@nxp.com>

MACHINEOVERRIDES =. "fsl-lsch2:fsl-lsch2-32b:ls1012a:"

require conf/machine/include/qoriq-arm.inc
require conf/machine/include/arm/arch-arm64.inc

DEFAULTTUNE = "armv7ahf-neon"

KERNEL_CLASSES  = " kernel-fitimage "
KERNEL_IMAGETYPES = "fitImage"

UBOOT_DTB_LOADADDRESS = "0x90000000"
UBOOT_ENTRYPOINT = "0x80080000"

UBOOT_CONFIG ??= "qspi-secure-boot qspi"
UBOOT_CONFIG[qspi] = "ls1012afrwy_qspi_defconfig,,u-boot-dtb.bin"
UBOOT_CONFIG[qspi-secure-boot] = "ls1012afrwy_qspi_SECURE_BOOT_defconfig,,u-boot-dtb.bin"

KERNEL_DEVICETREE ?= "freescale/fsl-ls1012a-frwy.dtb"
KERNEL_DEFCONFIG ?= "multi_v7_defconfig"

EXTRA_IMAGEDEPENDS += "ppa ppfe-firmware rcw"
USE_VT = "0"

require conf/multilib.conf
MULTILIBS ?= "multilib:lib64"
DEFAULTTUNE_virtclass-multilib-lib64 ?= "aarch64"
```
