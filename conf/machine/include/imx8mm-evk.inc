## conf/machine/ls1012afrwy.conf
```bitbake
#@TYPE: Machine
#@NAME: NXP LS1012AFRWY board
#@SOC: LSCH2
#@DESCRIPTION: Machine configuration for NXP QorIQ LS1012AFRWY
#              with ARM Cortext-A53 core
#@MAINTAINER: Chunrong Guo <Chunrong.Guo@nxp.com>

MACHINEOVERRIDES =. "fsl-lsch2:ls1012a:"

require conf/machine/include/qoriq-arm64.inc
require conf/machine/include/arm/arch-arm64.inc

MACHINE_FEATURES += "optee"

KERNEL_CLASSES  = " kernel-fitimage "
KERNEL_IMAGETYPES = "fitImage"

UBOOT_DTB_LOADADDRESS = "0x90000000"
UBOOT_ENTRYPOINT = "0x80080000"

UBOOT_CONFIG ??= "tfa-secure-boot tfa"
UBOOT_CONFIG[tfa] = "ls1012afrwy_tfa_defconfig"
UBOOT_CONFIG[tfa-secure-boot] = "ls1012afrwy_tfa_SECURE_BOOT_defconfig"

RCWQSPI ?= "N_SSNP_3305/rcw_1000"

KERNEL_DEVICETREE ?= "freescale/fsl-ls1012a-frwy.dtb"
KERNEL_DEFCONFIG ?= "defconfig"

EXTRA_IMAGEDEPENDS += "ppfe-firmware rcw qoriq-atf"
USE_VT = "0"
```

## conf/machine/ls1012ardb-32b.conf
```bitbake
#@TYPE: Machine
#@NAME: NXP LS1012ARDB board
#@SOC: LSCH2
#@DESCRIPTION: Machine configuration for NXP QorIQ LS1012ARDB
#              with ARM Cortext-A53 core
#@MAINTAINER: Zongchun Yu <Zongchun.Yu@nxp.com>

MACHINEOVERRIDES =. "fsl-lsch2:fsl-lsch2-32b:ls1012a:"

require conf/machine/include/qoriq-arm.inc
require conf/machine/include/arm/arch-arm64.inc

DEFAULTTUNE = "armv7ahf-neon"

KERNEL_CLASSES  = " kernel-itbimage "
KERNEL_IMAGETYPES = "itbImage"

DTB_LOAD = "0x90000000"
UBOOT_ENTRYPOINT = "0x80008000"

UBOOT_CONFIG ??= "qspi-secure-boot qspi"
UBOOT_CONFIG[qspi] = "ls1012ardb_qspi_defconfig,,u-boot-dtb.bin"
UBOOT_CONFIG[qspi-secure-boot] = "ls1012ardb_qspi_SECURE_BOOT_defconfig,,u-boot-dtb.bin"

KERNEL_IMAGETYPE = "zImage"
KERNEL_DEVICETREE ?= "freescale/fsl-ls1012a-rdb.dtb"
KERNEL_DEFCONFIG ?= "multi_v7_defconfig"

EXTRA_IMAGEDEPENDS += "ppa rcw"
USE_VT = "0"

require conf/multilib.conf
MULTILIBS ?= "multilib:lib64"
DEFAULTTUNE_virtclass-multilib-lib64 ?= "aarch64"
```

## conf/machine/ls1012ardb.conf
```bitbake
#@TYPE: Machine
#@NAME: NXP LS1012ARDB board
#@SOC: LSCH2
#@DESCRIPTION: Machine configuration for NXP QorIQ LS1012ARDB
#              with ARM Cortext-A53 core
#@MAINTAINER: Zongchun Yu <Zongchun.Yu@nxp.com>

MACHINEOVERRIDES =. "fsl-lsch2:ls1012a:"

require conf/machine/include/qoriq-arm64.inc
require conf/machine/include/arm/arch-arm64.inc

MACHINE_FEATURES += "optee"

KERNEL_CLASSES  = " kernel-fitimage "
KERNEL_IMAGETYPES = "fitImage"

UBOOT_DTB_LOADADDRESS = "0x90000000"
UBOOT_ENTRYPOINT = "0x80080000"

UBOOT_CONFIG ??= "tfa-secure-boot tfa"
UBOOT_CONFIG[tfa] = "ls1012ardb_tfa_defconfig"
UBOOT_CONFIG[tfa-secure-boot] = "ls1012ardb_tfa_SECURE_BOOT_defconfig"

RCWQSPI ?= "R_SPNH_3508/rcw_1000"
RCWQSPISEC ?= "R_SPNH_3508/rcw_1000"

KERNEL_DEVICETREE ?= "freescale/fsl-ls1012a-rdb.dtb freescale/fsl-ls1012a-qds.dtb"
KERNEL_DEFCONFIG ?= "defconfig"

EXTRA_IMAGEDEPENDS += "ppfe-firmware rcw qoriq-atf"
USE_VT = "0"
```

## conf/machine/ls1021atwr.conf
```bitbake
#@TYPE: Machine
#@NAME: NXP LS1021ATWR board
#@SOC: ls102xa
#@DESCRIPTION: Machine configuration for NXP QorIQ LS1 Tower System
#              Module Rev2.0 with ARM Cortex-A7 core
#@MAINTAINER: Zhenhua Luo <zhenhua.luo@freescale.com>

MACHINEOVERRIDES =. "ls102xa:"

require conf/machine/include/qoriq-arm.inc
require conf/machine/include/tune-cortexa7.inc

DEFAULTTUNE = "cortexa7hf-neon"

UBOOT_CONFIG ??= "sdcard-ifc sdcard-qspi lpuart qspi secure-boot nor"
UBOOT_CONFIG[nor] = "ls1021atwr_nor_config,,u-boot-dtb.bin"
UBOOT_CONFIG[sdcard-ifc] = "ls1021atwr_sdcard_ifc_config,,u-boot-with-spl-pbl.bin"
UBOOT_CONFIG[sdcard-qspi] = "ls1021atwr_sdcard_qspi_config,,u-boot-with-spl-pbl.bin"
UBOOT_CONFIG[lpuart] = "ls1021atwr_nor_lpuart_config,,u-boot-dtb.bin"
UBOOT_CONFIG[qspi] = "ls1021atwr_qspi_config,,u-boot-dtb.bin"
UBOOT_CONFIG[secure-boot] = "ls1021atwr_nor_SECURE_BOOT_config"

QE_UCODE="iram_Type_A_LS1021a_r1.0.bin"

KERNEL_DEVICETREE ?= "ls1021a-twr.dtb"
KERNEL_DEFCONFIG ?= "${S}/arch/arm/configs/ls1021a_defconfig"

UBOOT_ENTRYPOINT = "0x80008000"
EXTRA_IMAGEDEPENDS += "rcw qe-ucode"
USE_VT ?= "0"
```

## conf/machine/ls1028ardb.conf
```bitbake
#@TYPE: Machine
#@NAME: NXP LS1028ARDB
#@SOC: LSCH3
#@DESCRIPTION: Machine configuration for running LS1028ARDB in 64-bit mode
#@MAINTAINER: Chunrong.Guo <chunrong.guo@nxp.com>

MACHINEOVERRIDES =. "fsl-lsch3:ls1028a:"

require conf/machine/include/qoriq-arm64.inc
require conf/machine/include/arm/arch-arm64.inc

MACHINE_FEATURES += "optee"

KERNEL_CLASSES  = " kernel-fitimage "
KERNEL_IMAGETYPES = "fitImage"

UBOOT_DTB_LOADADDRESS = "0x90000000"
UBOOT_ENTRYPOINT = "0x80080000"

UBOOT_CONFIG ??= "tfa-secure-boot tfa"
UBOOT_CONFIG[tfa-secure-boot] = "ls1028ardb_tfa_SECURE_BOOT_defconfig"
UBOOT_CONFIG[tfa] = "ls1028ardb_tfa_defconfig"

KERNEL_DEVICETREE ?= "freescale/fsl-ls1028a-rdb.dtb freescale/fsl-ls1028a-qds.dtb"
KERNEL_DEVICETREE:append:use-nxp-bsp = "\
    freescale/fsl-ls1028a-rdb-dpdk.dtb \
"
KERNEL_DEFCONFIG ?= "defconfig"

SERIAL_CONSOLES ?= "115200;ttyS0 115200;ttyS1 115200;ttyAMA0"
SERIAL_CONSOLES_CHECK ?= "${SERIAL_CONSOLES}"

RCWSD ?= "R_SQPP_0x85bb/rcw_1500_gpu600"
RCWXSPI ?= "R_SQPP_0x85bb/rcw_1500_gpu600"
RCWEMMC ?= "R_SQPP_0x85bb/rcw_1500_gpu600"

EXTRA_IMAGEDEPENDS += "rcw qoriq-atf dp-firmware-cadence"
USE_VT = "0"
```

## conf/machine/ls1043ardb-32b.conf
```bitbake
#@TYPE: Machine
#@NAME: NXP LS1043ARDB-32B
#@SOC: LSCH2
#@DESCRIPTION: Machine configuration for running LS1043A in 32B mode
#@MAINTAINER: Ting Liu <ting.liu@nxp.com>

MACHINEOVERRIDES =. "fsl-lsch2:fsl-lsch2-32b:ls1043a:"

require conf/machine/include/qoriq-arm.inc
require conf/machine/include/arm/arch-arm64.inc

DEFAULTTUNE = "armv7ahf-neon"

KERNEL_CLASSES  = " kernel-itbimage "
KERNEL_IMAGETYPES = "itbImage"

DTB_LOAD = "0x9ffe0000"
UBOOT_ENTRYPOINT = "0x80008000"

UBOOT_CONFIG ??= "nand sdcard nor"
UBOOT_CONFIG[nor] = "ls1043ardb_config,,u-boot-dtb.bin"
UBOOT_CONFIG[nand] = "ls1043ardb_nand_config,,u-boot-with-spl-pbl.bin"
UBOOT_CONFIG[sdcard] = "ls1043ardb_sdcard_config,,u-boot-with-spl-pbl.bin"
UBOOT_CONFIG[secure-boot] = "ls1043ardb_SECURE_BOOT_defconfig,,u-boot-dtb.bin"

QE_UCODE = "iram_Type_A_LS1021a_r1.0.bin"

KERNEL_DEVICETREE ?= "freescale/fsl-ls1043a-rdb-sdk.dtb freescale/fsl-ls1043a-rdb-usdpaa.dtb"
KERNEL_DEFCONFIG ?= "multi_v7_defconfig"

SERIAL_CONSOLES ?= "115200;ttyS0 115200;ttyAMA0"
SERIAL_CONSOLES_CHECK ?= "${SERIAL_CONSOLES}"

EXTRA_IMAGEDEPENDS += "fm-ucode rcw ppa qe-ucode"
USE_VT = "0"

require conf/multilib.conf
MULTILIBS ?= "multilib:lib64"
DEFAULTTUNE_virtclass-multilib-lib64 ?= "aarch64"
```

## conf/machine/ls1043ardb-be.conf
```bitbake
#@TYPE: Machine
#@NAME: Freescale LS1043ARDB 
#@SOC: LSCH2
#@DESCRIPTION: Machine configuration for running LS1043A in 64-bit mode
#@MAINTAINER: Chunrong Guo <nxa13725@nxp.com>

DEFAULTTUNE = "aarch64_be"

require conf/machine/include/qoriq-arm64.inc
require conf/machine/include/arm/arch-arm64.inc

MACHINEOVERRIDES =. "fsl-lsch2:ls1043a:"

KERNEL_CLASSES  = " kernel-itbimage "
KERNEL_IMAGETYPES = "itbImage"

DTB_LOAD = "0x90000000"
UBOOT_ENTRYPOINT = "0x80080000"

UBOOT_CONFIG ??= "nand sdcard nor"
UBOOT_CONFIG[nor] = "ls1043ardb_config,,u-boot-dtb.bin"
UBOOT_CONFIG[nand] = "ls1043ardb_nand_config,,u-boot-with-spl-pbl.bin"
UBOOT_CONFIG[sdcard] = "ls1043ardb_sdcard_config,,u-boot-with-spl-pbl.bin"
UBOOT_CONFIG[secure-boot] = "ls1043ardb_SECURE_BOOT_defconfig,,u-boot-dtb.bin"
UBOOT_CONFIG[nand-secure-boot] = "ls1043ardb_nand_SECURE_BOOT_defconfig,,u-boot-with-spl-pbl.bin"
UBOOT_CONFIG[nand-spl-secure-boot] = "ls1043ardb_nand_SECURE_BOOT_defconfig,,spl/u-boot-spl.bin"
UBOOT_CONFIG[nand-dtb-secure-boot] = "ls1043ardb_nand_SECURE_BOOT_defconfig,,u-boot-dtb.bin"
UBOOT_CONFIG[sdcard-secure-boot] = "ls1043ardb_sdcard_SECURE_BOOT_defconfig,,u-boot-with-spl-pbl.bin"
UBOOT_CONFIG[sdcard-spl-secure-boot] = "ls1043ardb_sdcard_SECURE_BOOT_defconfig,,spl/u-boot-spl.bin"
UBOOT_CONFIG[sdcard-dtb-secure-boot] = "ls1043ardb_sdcard_SECURE_BOOT_defconfig,,u-boot-dtb.bin"

QE_UCODE = "iram_Type_A_LS1021a_r1.0.bin"
LE_UBOOT_FOR_ARMBE_TARGET = "1"

KERNEL_DEVICETREE ?= "freescale/fsl-ls1043a-rdb-sdk.dtb freescale/fsl-ls1043a-rdb-usdpaa.dtb"
KERNEL_DEFCONFIG ?= "defconfig"

EXTRA_IMAGEDEPENDS += "fm-ucode ppa rcw qe-ucode"

USE_VT = "0"
```

## conf/machine/ls1043ardb.conf
```bitbake
#@TYPE: Machine
#@NAME: NXP LS1043ARDB board
#@SOC: LSCH2
#@DESCRIPTION: Machine configuration for NXP QorIQ LS1043ARDB
#              with ARM Cortext-A53 core
#@MAINTAINER: Ting Liu <ting.liu@nxp.com>

MACHINEOVERRIDES =. "fsl-lsch2:ls1043a:"

require conf/machine/include/qoriq-arm64.inc
require conf/machine/include/arm/arch-arm64.inc

MACHINE_FEATURES += "optee"

KERNEL_CLASSES  = " kernel-fitimage "
KERNEL_IMAGETYPES = "fitImage"

UBOOT_DTB_LOADADDRESS = "0x90000000"
UBOOT_ENTRYPOINT = "0x80080000"

UBOOT_CONFIG ??= "tfa-secure-boot tfa"
UBOOT_CONFIG[tfa] = "ls1043ardb_tfa_defconfig"
UBOOT_CONFIG[tfa-secure-boot] = "ls1043ardb_tfa_SECURE_BOOT_defconfig"

KERNEL_DEVICETREE ?= "\
    freescale/fsl-ls1043a-rdb.dtb \
    freescale/fsl-ls1043a-qds.dtb \
"
# usdpaa dtb is used for dpdk. TODO: rename in kernel
KERNEL_DEVICETREE:prepend:use-nxp-bsp = "\
    freescale/fsl-ls1043a-rdb-sdk.dtb \
    freescale/fsl-ls1043a-rdb-usdpaa.dtb \
    freescale/fsl-ls1043a-qds-sdk.dtb \
"
KERNEL_DEFCONFIG ?= "defconfig"

UEFI_NORBOOT ?= "LS1043ARDB_EFI_NORBOOT.fd"
RCWNOR ?= "RR_FQPP_1455/rcw_1600"
RCWSD ?= "RR_FQPP_1455/rcw_1600_sdboot"
RCWNAND ?= "RR_FQPP_1455/rcw_1600_nandboot"

QE_UCODE = "iram_Type_A_LS1021a_r1.0.bin"
FMAN_UCODE ?= "fsl_fman_ucode_ls1043_r1.1_106_4_18.bin"

EXTRA_IMAGEDEPENDS += "fm-ucode rcw qe-ucode uefi qoriq-atf ls2-phy"
USE_VT = "0"
```

## conf/machine/ls1046afrwy.conf
```bitbake
#@TYPE: Machine
#@NAME: NXP LS1046AFRWY
#@SOC: LSCH2
#@DESCRIPTION: Machine configuration for running LS1046A in 64-bit mode
#@MAINTAINER: Chunrong.guo <chunrong.guo@nxp.com>

MACHINEOVERRIDES =. "fsl-lsch2:ls1046a:"

require conf/machine/include/qoriq-arm64.inc
require conf/machine/include/arm/arch-arm64.inc

MACHINE_FEATURES += "optee"

KERNEL_CLASSES  = " kernel-fitimage "
KERNEL_IMAGETYPES = "fitImage"

UBOOT_DTB_LOADADDRESS = "0x90000000"
UBOOT_ENTRYPOINT = "0x80080000"

UBOOT_CONFIG ??= "tfa-secure-boot tfa"
UBOOT_CONFIG[tfa] = "ls1046afrwy_tfa_defconfig,,u-boot-dtb.bin"
UBOOT_CONFIG[tfa-secure-boot] = "ls1046afrwy_tfa_SECURE_BOOT_defconfig,,u-boot-dtb.bin"

KERNEL_DEVICETREE ?= "\
    freescale/fsl-ls1046a-frwy-sdk.dtb \
    freescale/fsl-ls1046a-frwy-usdpaa.dtb \
"
KERNEL_DEFCONFIG ?= "defconfig"

SERIAL_CONSOLES ?= "115200;ttyS0 115200;ttyAMA0 115200;ttyLP0"
SERIAL_CONSOLES_CHECK ?= "${SERIAL_CONSOLES}"

RCWQSPI ?= "NN_NNQNNPNP_3040_0506/rcw_1600_qspiboot"
RCWSD ?= "NN_NNQNNPNP_3040_0506/rcw_1600_sdboot"

EXTRA_IMAGEDEPENDS += "fm-ucode rcw atf ls2-phy qe-ucode"
USE_VT = "0"
```
