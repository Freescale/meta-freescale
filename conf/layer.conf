## conf/layer.conf
```bitbake
# We have a conf and classes directory, add to BBPATH
BBPATH .= ":${LAYERDIR}"

# We have a packages directory, add to BBFILES
BBFILES += "${LAYERDIR}/recipes-*/*/*.bb \
            ${LAYERDIR}/recipes-*/*/*.bbappend"

BBFILE_COLLECTIONS += "freescale-layer"
BBFILE_PATTERN_freescale-layer := "^${LAYERDIR}/"
BBFILE_PRIORITY_freescale-layer = "5"
LAYERSERIES_COMPAT_freescale-layer = "kirkstone langdale mickledore nanbield scarthgap"
LAYERDEPENDS_freescale-layer = "core"

# Add the Freescale-specific licenses into the metadata
LICENSE_PATH += "${LAYERDIR}/custom-licenses"

FSL_EULA_FILE = "${LAYERDIR}/EULA"

IMX_MIRROR ?= "https://www.nxp.com/lgfiles/NMG/MAD/YOCTO/"

# FIXME: set this to avoid changing all the recipes that use it
FSL_MIRROR ?= "${IMX_MIRROR}"

MIRRORS += " \
${IMX_MIRROR}   http://download.ossystems.com.br/bsp/freescale/source/ \n \
"
# Needs gbm_bo_create_with_modifiers2() API which is not
# implemented in imx GL driver implementation
COMPATIBLE_HOST:pn-xdg-desktop-portal-wlr:imxgpu = "(null)"

# For compatibility with layers before scarthgap
PROVIDES:pn-bmap-tools-native = "bmaptool-native"
RPROVIDES:pn-bmap-tools-native:bmap-tools-native = "bmaptool-native"
PROVIDES:pn-bmap-tools = "bmaptool"
RPROVIDES:pn-bmap-tools:bmap-tools = "bmaptool"

BBFILES_DYNAMIC += " \
    aglprofilegraphical:${LAYERDIR}/dynamic-layers/aglprofilegraphical/*/*/*.bb \
    aglprofilegraphical:${LAYERDIR}/dynamic-layers/aglprofilegraphical/*/*/*.bbappend \
    \
    chromium-browser-layer:${LAYERDIR}/dynamic-layers/chromium-browser-layer/*/*/*.bb \
    chromium-browser-layer:${LAYERDIR}/dynamic-layers/chromium-browser-layer/*/*/*.bbappend \
    \
    filesystem-layer:${LAYERDIR}/dynamic-layers/filesystem-layer/*/*/*.bb \
    filesystem-layer:${LAYERDIR}/dynamic-layers/filesystem-layer/*/*/*.bbappend \
    \
    gnome-layer:${LAYERDIR}/dynamic-layers/gnome-layer/*/*/*.bb \
    gnome-layer:${LAYERDIR}/dynamic-layers/gnome-layer/*/*/*.bbappend \
    \
    ivi:${LAYERDIR}/dynamic-layers/ivi/*/*/*.bb \
    ivi:${LAYERDIR}/dynamic-layers/ivi/*/*/*.bbappend \
    \
    meta-arm:${LAYERDIR}/dynamic-layers/meta-arm/*/*/*.bbappend \
    \
    multimedia-layer:${LAYERDIR}/dynamic-layers/multimedia-layer/*/*/*.bb \
    multimedia-layer:${LAYERDIR}/dynamic-layers/multimedia-layer/*/*/*.bbappend \
    \
    openembedded-layer:${LAYERDIR}/dynamic-layers/openembedded-layer/*/*/*.bb \
    openembedded-layer:${LAYERDIR}/dynamic-layers/openembedded-layer/*/*/*.bbappend \
    \
    qt4-layer:${LAYERDIR}/dynamic-layers/qt4-layer/*/*/*.bb \
    qt4-layer:${LAYERDIR}/dynamic-layers/qt4-layer/*/*/*.bbappend \
    \
    qt5-layer:${LAYERDIR}/dynamic-layers/qt5-layer/*/*/*.bb \
    qt5-layer:${LAYERDIR}/dynamic-layers/qt5-layer/*/*/*.bbappend \
    \
    qt6-layer:${LAYERDIR}/dynamic-layers/qt6-layer/*/*/*.bb \
    qt6-layer:${LAYERDIR}/dynamic-layers/qt6-layer/*/*/*.bbappend \
    \
    virtualization-layer:${LAYERDIR}/dynamic-layers/virtualization-layer/*/*/*.bb \
    virtualization-layer:${LAYERDIR}/dynamic-layers/virtualization-layer/*/*/*.bbappend \
"
```

## conf/machine/b4420qds-64b.conf
```bitbake
#@TYPE: Machine
#@NAME: NXP B4420QDS-64B
#@SOC: b4420
#@DESCRIPTION: Machine configuration for NXP QorIQ Qonverge B4420
#              Application Development System with ppce6500 core in
#              64b mode
#@MAINTAINER: Chunrong Guo <B40290@freescale.com>

MACHINEOVERRIDES =. "b4:b4420:"

require conf/machine/include/e6500-64b.inc

UBOOT_CONFIG ??= "nor"
UBOOT_CONFIG[nor] = "B4420QDS_config"

KERNEL_DEVICETREE ?= "b4420qds.dtb b4420qds-usdpaa.dtb"
KERNEL_DEFCONFIG ?= "${S}/arch/powerpc/configs/corenet64_fmanv3h_smp_defconfig"

JFFS2_ERASEBLOCK = "0x10000"

EXTRA_IMAGEDEPENDS += "fm-ucode rcw"

USE_VT ?= "0"
```

## conf/machine/b4860qds-64b.conf
```bitbake
#@TYPE: Machine
#@NAME: NXP B4860QDS-64B
#@SOC: b4860
#@DESCRIPTION: Machine configuration for NXP QorIQ Qonverge B4860
#              Application Development System with ppce6500 core in
#              64b mode
#@MAINTAINER: Chunrong Guo <B40290@freescale.com>

MACHINEOVERRIDES =. "b4:b4860:"

require conf/machine/include/e6500-64b.inc

UBOOT_CONFIG ??= "secure-boot nor"
UBOOT_CONFIG[nor] = "B4860QDS_config"
UBOOT_CONFIG[secure-boot] = "B4860QDS_SECURE_BOOT_config"

KERNEL_DEVICETREE ?= "b4860qds.dtb b4860qds-usdpaa.dtb \
    b4860qds-usdpaa-shared-interfaces.dtb \
"
KERNEL_DEFCONFIG ?= "${S}/arch/powerpc/configs/corenet64_fmanv3h_smp_defconfig"

JFFS2_ERASEBLOCK = "0x10000"
EXTRA_IMAGEDEPENDS += "fm-ucode rcw hypervisor hv-cfg"
USE_VT ?= "0"
```

## conf/machine/bsc9131rdb.conf
```bitbake
#@TYPE: Machine
#@NAME: Freescale BSC9131RDB
#@SOC: bsc9131
#@DESCRIPTION: Machine configuration for Freescale QorIQ Qonverge BSC9131
#              Reference Design Board with ppce500v2 core
#@MAINTAINER: Chunrong Guo <B40290@freescale.com> 

require conf/machine/include/e500v2.inc

SOC_FAMILY = "bsc9131"

UBOOT_CONFIG ??= "nand nand-sysclk100 spi spi-sysclk100"
UBOOT_CONFIG[nand] = "BSC9131RDB_NAND_config"
UBOOT_CONFIG[nand-sysclk100] = "BSC9131RDB_NAND_SYSCLK100_config"
UBOOT_CONFIG[spi] = "BSC9131RDB_SPIFLASH_config"
UBOOT_CONFIG[spi-sysclk100] = "BSC9131RDB_SPIFLASH_SYSCLK100_config"

KERNEL_DEVICETREE ?= "bsc9131rdb.dtb"
KERNEL_DEFCONFIG ?= "${S}/arch/powerpc/configs/85xx/bsc913x_defconfig"

JFFS2_ERASEBLOCK = "0x10000"
```

## conf/machine/bsc9132qds.conf
```bitbake
#@TYPE: Machine
#@NAME: Freescale BSC9132QDS
#@SOC: bsc9132
#@DESCRIPTION: Machine configuration for Freescale QorIQ Qonverge BSC9132
#              Qonverge Development System with ppce500v2 core
#@MAINTAINER: Chunrong Guo <B40290@freescale.com>

require conf/machine/include/e500v2.inc

SOC_FAMILY = "bsc9132"

UBOOT_CONFIG ??= "nand-ddrclk133 nand-ddrclk100 nor-ddrclk100 nor-ddrclk133 \
sdcard-ddrclk100 sdcard-ddrclk133 spi-ddrclk100 spi-ddrclk133 \
nand-ddrclk100-secure nand-ddrclk133-secure nor-ddrclk100-secure \
nor-ddrclk133-secure sdcard-ddrclk100-secure sdcard-ddrclk133-secure \
spi-ddrclk100-secure spi-ddrclk133-secure"
UBOOT_CONFIG[nand-ddrclk133] = "BSC9132QDS_NAND_DDRCLK133_config"
UBOOT_CONFIG[nand-ddrclk100] = "BSC9132QDS_NAND_DDRCLK100_config"
UBOOT_CONFIG[nor-ddrclk100] = "BSC9132QDS_NOR_DDRCLK100_config"
UBOOT_CONFIG[nor-ddrclk133] = "BSC9132QDS_NOR_DDRCLK133_config"
UBOOT_CONFIG[sdcard-ddrclk100] = "BSC9132QDS_SDCARD_DDRCLK100_config"
UBOOT_CONFIG[sdcard-ddrclk133] = "BSC9132QDS_SDCARD_DDRCLK133_config"
UBOOT_CONFIG[spi-ddrclk100] = "BSC9132QDS_SPIFLASH_DDRCLK100_config"
UBOOT_CONFIG[spi-ddrclk133] = "BSC9132QDS_SPIFLASH_DDRCLK133_config"
UBOOT_CONFIG[nand-ddrclk100-secure] = "BSC9132QDS_NAND_DDRCLK100_SECURE_config"
UBOOT_CONFIG[nand-ddrclk133-secure] = "BSC9132QDS_NAND_DDRCLK133_SECURE_config"
UBOOT_CONFIG[nor-ddrclk100-secure] = "BSC9132QDS_NOR_DDRCLK100_SECURE_config"
UBOOT_CONFIG[nor-ddrclk133-secure] = "BSC9132QDS_NOR_DDRCLK133_SECURE_config"
UBOOT_CONFIG[sdcard-ddrclk100-secure] = "BSC9132QDS_SDCARD_DDRCLK100_SECURE_config"
UBOOT_CONFIG[sdcard-ddrclk133-secure] = "BSC9132QDS_SDCARD_DDRCLK133_SECURE_config"
UBOOT_CONFIG[spi-ddrclk100-secure] = "BSC9132QDS_SPIFLASH_DDRCLK100_SECURE_config"
UBOOT_CONFIG[spi-ddrclk133-secure] = "BSC9132QDS_SPIFLASH_DDRCLK133_SECURE_config"

KERNEL_DEVICETREE ?= "bsc9132qds.dtb"
KERNEL_DEFCONFIG ?= "${S}/arch/powerpc/configs/85xx/bsc913x_smp_defconfig"

JFFS2_ERASEBLOCK = "0x10000"
```

## conf/machine/c293pcie.conf
```bitbake
#@TYPE: Machine
#@NAME: NXP C293PCIE
#@SOC: c293pcie
#@DESCRIPTION: Machine configuration for NXP C29x Crypto Coprocessor
#              PCI Express Adapter Platform with ppce500v2 core
#@MAINTAINER: Chunrong Guo <B40290@freescale.com>

MACHINEOVERRIDES =. "c29x:"

require conf/machine/include/e500v2.inc

BOOTFORMAT_CONFIG = "config_ddr3_512m_c29xpcie_800M.dat"

UBOOT_CONFIG ??= "spi secboot spi-secboot nor"
UBOOT_CONFIG[nor] = "C29XPCIE_config"
UBOOT_CONFIG[spi] = "C29XPCIE_SPIFLASH_config"
UBOOT_CONFIG[secboot] = "C29XPCIE_NOR_SECBOOT_config"
UBOOT_CONFIG[spi-secboot] = "C29XPCIE_SPIFLASH_SECBOOT_config"

KERNEL_DEVICETREE ?= "c293pcie.dtb"
KERNEL_DEFCONFIG ?= "${S}/arch/powerpc/configs/mpc85xx_defconfig"

JFFS2_ERASEBLOCK = "0x10000"
USE_VT ?= "0"
```

## conf/machine/imx23evk.conf
```bitbake
#@TYPE: Machine
#@NAME: NXP i.MX23 Evaluation Kit
#@SOC: i.MX23
#@DESCRIPTION: Machine configuration for NXP i.MX23 Evaluation Kit
#@MAINTAINER: Otavio Salvador <otavio@ossystems.com.br>

MACHINEOVERRIDES =. "mxs:mx23:"

include conf/machine/include/imx-base.inc
include conf/machine/include/arm/armv5/tune-arm926ejs.inc

# This machine is not supported by u-boot-imx as it is not tested by NXP on this
# board. So we force it to use u-boot-fslc which is based on mainline here.
IMX_DEFAULT_BOOTLOADER = "u-boot-fslc"

UBOOT_MAKE_TARGET = "u-boot.sb"
UBOOT_SUFFIX = "sb"

UBOOT_MACHINE = "mx23evk_config"

KERNEL_DEVICETREE = "nxp/mxs/imx23-evk.dtb"
```

## conf/machine/imx25pdk.conf
```bitbake
#@TYPE: Machine
#@NAME: NXP i.MX25 Evaluation Kit
#@SOC: i.MX25
#@DESCRIPTION: Machine configuration for NXP i.MX25 Evaluation Kit
#@MAINTAINER: Otavio Salvador <otavio@ossystems.com.br>

MACHINEOVERRIDES =. "mx25:"

include conf/machine/include/imx-base.inc
include conf/machine/include/tune-arm926ejs.inc

# This machine is not supported by u-boot-imx as it is not tested by NXP on this
# board. So we force it to use u-boot-fslc which is based on mainline here.
IMX_DEFAULT_BOOTLOADER = "u-boot-fslc"

UBOOT_MAKE_TARGET = "u-boot.imx"
UBOOT_SUFFIX = "imx"

UBOOT_MACHINE ?= "mx25pdk_defconfig"

KERNEL_DEVICETREE = "imx25-pdk.dtb"

SERIAL_CONSOLES = "115200;ttymxc0"

MACHINE_FEATURES = "usbgadget usbhost vfat alsa touchscreen"

WKS_FILE = "imx-uboot.wks"
MACHINE_ESSENTIAL_EXTRA_RDEPENDS += " \
    kernel-image \
    kernel-devicetree \
"
```

## conf/machine/imx28evk.conf
```bitbake
#@TYPE: Machine
#@NAME: Freescale i.MX28 Evaluation Kit
#@SOC: i.MX28
#@DESCRIPTION: Machine configuration for Freescale i.MX28 Evaluation Kit
#@MAINTAINER: Otavio Salvador <otavio@ossystems.com.br>

include conf/machine/include/mxs-base.inc

SOC_FAMILY = "mxs:mx28"

IMXBOOTLETS_MACHINE = "iMX28_EVK"

UBOOT_CONFIG ??= "sd"
UBOOT_CONFIG[sd] = "mx28evk_config,sdcard"
UBOOT_CONFIG[nand] = "mx28evk_nand_config,ubifs"
UBOOT_CONFIG[sd-auart-console] = "mx28evk_auart_console_config,sdcard"

KERNEL_DEVICETREE = "imx28-evk.dtb"

SDCARD_ROOTFS ?= "${DEPLOY_DIR_IMAGE}/${IMAGE_NAME}.rootfs.ext3"
IMAGE_FSTYPES ?= "tar.bz2 ext3 uboot.mxsboot-sdcard sdcard"

SERIAL_CONSOLE = "115200 ttyAMA0"

MACHINE_FEATURES = "apm usbgadget usbhost vfat alsa touchscreen"

## Parameters for NAND IC part-# K9LBG08U0D-PCB0

MKUBIFS_ARGS = "--min-io-size 4096 --leb-size 516096 --max-leb-cnt 8139"
UBINIZE_ARGS = "--min-io-size 4096 --peb-size 524288 --sub-page-size 4096"
MXSBOOT_NAND_ARGS = "-w 4096 -o 218 -e 524288"

## To determine parameters' values, run "ubiattach -m 6 /dev/ubi_ctrl"
## (assuming the rootfs device is /dev/mtd6).  Here's an example:

# # ubiattach -m 6 /dev/ubi_ctrl
# [   28.640396] UBI: attaching mtd6 to ubi0
# [   53.000817] UBI: scanning is finished
# [   53.126052] UBI: attached mtd6 (name "filesystem", size 4079 MiB) to ubi0
# [   53.133109] UBI: PEB size: 524288 bytes (512 KiB), LEB size: 516096 bytes
# [   53.140149] UBI: min./max. I/O unit sizes: 4096/4096, sub-page size 4096
# [   53.146895] UBI: VID header offset: 4096 (aligned 4096), data offset: 8192
# [   53.153931] UBI: good PEBs: 8139, bad PEBs: 20, corrupted PEBs: 0
# [   53.160263] UBI: user volume: 1, internal volumes: 1, max. volumes count: 128
# [   53.167444] UBI: max/mean erase counter: 2/1, WL threshold: 4096, image sequence number: 0
# [   53.175872] UBI: available PEBs: 4113, total reserved PEBs: 4026, PEBs reserved for bad PEB handling: 140
# [   53.189399] UBI: background thread "ubi_bgt0d" started, PID 217
# UBI device number 0, total 8139 LEBs (4200505344 bytes, f GiB), available 4113 LEBs (2122702848 bytes, f GiB), LEB size 516096 bytes (f KiB)

# --min-io-size: see "min./max. I/O unit sizes: " in the ubiattach output
# --leb-size: see "LEB size:" in the ubiattach output
# --max-leb-cnt: see "total <n> LEBs" in the ubiattach output, where <n> is the number you want
# --peb-size: see "PEB size:" in the ubiattach output (pick the value in bytes)
# --sub-page-size: see "sub-page size" in the ubiattach output
```

## conf/machine/imx31pdk.conf
```bitbake
#@TYPE: Machine
#@NAME: Freescale i.MX31 Platform Development Kit
#@SOC: i.MX31
#@DESCRIPTION: Machine configuration for Freescale i.MX31 Platform Development Kit

include conf/machine/include/imx-base.inc
require conf/machine/include/tune-arm1136jf-s.inc

SOC_FAMILY = "mx3:mx31"

GUI_MACHINE_CLASS = "smallscreen"

UBOOT_MAKE_TARGET = "u-boot-with-spl.bin"
UBOOT_SUFFIX = "bin"
UBOOT_MACHINE = "mx31pdk_config"
UBOOT_BINARY = "u-boot-with-spl.bin"
KERNEL_IMAGETYPE = "uImage"

IMAGE_FSTYPES = "ubi jffs2 tar.bz2"
MKUBIFS_ARGS = "-m 2048 -e 129024 -c 2030"
UBINIZE_ARGS = "-m 2048 -p 128KiB -s 512"

MACHINE_FEATURES += "ext3 bluetooth ext2 screen"
```

## conf/machine/imx51evk.conf
```bitbake
#@TYPE: Machine
#@NAME: NXP i.MX51 Evaluation Kit
#@SOC: i.MX51
#@DESCRIPTION: Machine configuration for NXP i.MX51 Evaluation Kit
#@MAINTAINER: Daiane Angolini <daiane.angolini@nxp.com>

MACHINEOVERRIDES =. "mx5:mx51:"

include conf/machine/include/imx-base.inc
include conf/machine/include/arm/armv7a/tune-cortexa8.inc

KERNEL_DEVICETREE = "nxp/imx/imx51-babbage.dtb"

# This machine is not supported by u-boot-imx as it is not tested by NXP on this
# board. So we force it to use u-boot-fslc which is based on mainline here.
IMX_DEFAULT_BOOTLOADER = "u-boot-fslc"

UBOOT_MAKE_TARGET = "u-boot.imx"
UBOOT_SUFFIX = "imx"

UBOOT_MACHINE = "mx51evk_config"
```

## conf/machine/imx53ard.conf
```bitbake
#@TYPE: Machine
#@NAME: NXP i.MX53 SABRE Automotive Board
#@SOC: i.MX53
#@DESCRIPTION: Machine configuration for NXP i.MX53 SABRE Automotive Board
#@MAINTAINER: Daiane Angolini <daiane.angolini@nxp.com>

MACHINEOVERRIDES =. "mx5:mx53:"

include conf/machine/include/imx-base.inc
include conf/machine/include/tune-cortexa8.inc

# Disable perf features as 2.6.35.3 fails to build otherwise
PERF_FEATURES_ENABLE = ""

KERNEL_DEVICETREE = "imx53-ard.dtb"

UBOOT_MACHINE = "mx53ard_config"
KERNEL_IMAGETYPE = "uImage"

MACHINE_FIRMWARE += "linux-firmware-ar3k \
                     linux-firmware-ath6k"
MACHINE_FEATURES += "wifi bluetooth"
```

## conf/machine/imx53qsb.conf
```bitbake
#@TYPE: Machine
#@NAME: NXP i.MX53 Quick Start Board
#@SOC: i.MX53
#@DESCRIPTION: Machine configuration for NXP i.MX53 Quick Start Board
#@MAINTAINER: Trevor Woerner <twoerner@gmail.com>

MACHINEOVERRIDES =. "mx5:mx53:"

include conf/machine/include/imx-base.inc
include conf/machine/include/arm/armv7a/tune-cortexa8.inc

KERNEL_DEVICETREE = "nxp/imx/imx53-qsb.dtb nxp/imx/imx53-qsrb.dtb"

# This machine is not supported by u-boot-imx as it is not tested by NXP on this
# board. So we force it to use u-boot-fslc which is based on mainline here.
IMX_DEFAULT_BOOTLOADER = "u-boot-fslc"

UBOOT_MAKE_TARGET = "u-boot.imx"
UBOOT_SUFFIX = "imx"

UBOOT_MACHINE = "mx53loco_config"

MACHINE_FIRMWARE = "linux-firmware-ar3k \
                     linux-firmware-ath6k"
MACHINE_FEATURES += " wifi bluetooth"
```
