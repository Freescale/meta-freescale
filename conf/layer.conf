## conf/machine/imx6dlsabreauto.conf
```bitbake
#@TYPE: Machine
#@NAME: NXP i.MX6DL SABRE Automotive
#@SOC: i.MX6DL
#@DESCRIPTION: Machine configuration for NXP i.MX6DL SABRE Automotive
#@MAINTAINER: Daiane Angolini <daiane.angolini@nxp.com>

MACHINEOVERRIDES =. "mx6:mx6dl:"

require conf/machine/include/imx6sabreauto-common.inc

KERNEL_DEVICETREE = "imx6dl-sabreauto.dtb imx6dl-sabreauto-gpmi-weim.dtb imx6dl-sabreauto-ecspi.dtb \
                     imx6dl-sabreauto-flexcan1.dtb imx6dl-sabreauto-enetirq.dtb"

UBOOT_CONFIG ??= "sd"
UBOOT_CONFIG[sd] = "mx6dlsabreauto_config,sdcard"
UBOOT_CONFIG[eimnor] = "mx6dlsabreauto_eimnor_config"
UBOOT_CONFIG[nand] = "mx6dlsabreauto_nand_config,ubifs"
UBOOT_CONFIG[spinor] = "mx6dlsabreauto_spinor_config"
UBOOT_CONFIG[mfgtool] = "mx6dlsabreauto_config"
```

## conf/machine/imx6qdlsabreauto.conf
```bitbake
#@TYPE: Machine
#@NAME: NXP i.MX6QP/Q/DL SABRE Automotive
#@SOC: i.MX6QP/Q/DL
#@DESCRIPTION: Machine configuration for NXP i.MX6QP/Q/DL SABRE Automotive
#@MAINTAINER: Daiane Angolini <daiane.angolini@nxp.com>
#
# This machine replaces the following machines:
#    * imx6qpsabreauto
#    * imx6qsabreauto
#    * imx6dlsabreauto
#    * imx6solosabreauto
# and is able to work for all the machines.

MACHINEOVERRIDES =. "mx6q:mx6dl:"

require conf/machine/include/imx-base.inc
require conf/machine/include/arm/armv7a/tune-cortexa9.inc

KERNEL_DEVICETREE = " \
    nxp/imx/imx6qp-sabreauto.dtb \
    nxp/imx/imx6qp-sabreauto-ecspi.dtb \
    nxp/imx/imx6qp-sabreauto-flexcan1.dtb \
    nxp/imx/imx6qp-sabreauto-gpmi-weim.dtb \
    \
    nxp/imx/imx6q-sabreauto.dtb \
    nxp/imx/imx6q-sabreauto-gpmi-weim.dtb \
    nxp/imx/imx6q-sabreauto-ecspi.dtb \
    nxp/imx/imx6q-sabreauto-flexcan1.dtb \
    nxp/imx/imx6q-sabreauto-enetirq.dtb \
    \
    nxp/imx/imx6dl-sabreauto.dtb \
    nxp/imx/imx6dl-sabreauto-gpmi-weim.dtb \
    nxp/imx/imx6dl-sabreauto-ecspi.dtb \
    nxp/imx/imx6dl-sabreauto-flexcan1.dtb \
    nxp/imx/imx6dl-sabreauto-enetirq.dtb \
"
KERNEL_DEVICETREE:use-mainline-bsp = " \
    nxp/imx/imx6qp-sabreauto.dtb \
    nxp/imx/imx6q-sabreauto.dtb \
    nxp/imx/imx6dl-sabreauto.dtb \
"

UBOOT_CONFIG ??= " \
    sd \
    ${@oe.utils.ifelse(d.getVar('IMX_DEFAULT_BOOTLOADER') == 'u-boot-imx', \
           bb.utils.contains('MACHINE_FEATURES', 'optee', 'sd-optee', '', d), '')}"

### u-boot-fslc settings ###
SPL_BINARY:pn-u-boot-fslc = "SPL"
UBOOT_SUFFIX:pn-u-boot-fslc = "img"

### u-boot-imx settings ###
SPL_BINARY:pn-u-boot-imx = ""
UBOOT_MAKE_TARGET:pn-u-boot-imx = "u-boot.imx"
UBOOT_SUFFIX:pn-u-boot-imx = "imx"
UBOOT_MAKE_TARGET:pn-u-boot-imx-mfgtool = "u-boot.imx"
UBOOT_SUFFIX:pn-u-boot-imx-mfgtool = "imx"

UBOOT_CONFIG[sd]       = "${UBOOT_CONFIG_MACHINE_NAME}_defconfig,sdcard"
UBOOT_CONFIG[sd-optee] = "${UBOOT_CONFIG_MACHINE_NAME}_optee_defconfig,sdcard"
UBOOT_CONFIG[eimnor]   = "${UBOOT_CONFIG_MACHINE_NAME}_eimnor_defconfig"
UBOOT_CONFIG[nand]     = "${UBOOT_CONFIG_MACHINE_NAME}_nand_defconfig,ubifs"
UBOOT_CONFIG[spinor]   = "${UBOOT_CONFIG_MACHINE_NAME}_spinor_defconfig"
UBOOT_CONFIG[sata]     = "${UBOOT_CONFIG_MACHINE_NAME}_sata_defconfig"

# The u-boot-imx does not provide unified functionality for DL/Q/QP SoC
# variants. Change the defconfig to the targeted SoC variant.
UBOOT_CONFIG_MACHINE_NAME                       = "mx6sabreauto"
UBOOT_CONFIG_MACHINE_NAME:pn-u-boot-imx         = "mx6qpsabreauto"
UBOOT_CONFIG_MACHINE_NAME:pn-u-boot-imx-mfgtool = "mx6qpsabreauto"

WKS_FILE = " \
    ${@bb.utils.contains('IMX_DEFAULT_BOOTLOADER', \
                         'u-boot-fslc', 'imx-uboot-spl-bootpart.wks.in', \
                                        'imx-uboot-bootpart.wks.in', d)}"

OPTEE_BIN_EXT = "6qpauto"

SERIAL_CONSOLES = "115200;ttymxc3"

MACHINE_FIRMWARE:append:mx6 = " linux-firmware-ath6k"

MACHINE_FEATURES += " pci wifi bluetooth nxp8987-sdio"
```

## conf/machine/imx6qdlsabresd.conf
```bitbake
#@TYPE: Machine
#@NAME: NXP i.MX6QP/Q/DL SABRE Smart Device
#@SOC: i.MX6QP/Q/DL
#@DESCRIPTION: Machine configuration for NXP i.MX6QP/Q/DL SABRE Smart Device
#@MAINTAINER: Otavio Salvador <otavio@ossystems.com.br>
#
# This machine replaces the following machines:
#    * imx6qpsabresd
#    * imx6qsabresd
#    * imx6dlsabresd
#    * imx6solosabresd
# and is able to work for all the machines.

MACHINEOVERRIDES =. "mx6q:mx6dl:"

require conf/machine/include/imx-base.inc
require conf/machine/include/arm/armv7a/tune-cortexa9.inc

KERNEL_DEVICETREE = " \
	nxp/imx/imx6qp-sabresd-btwifi.dtb \
	nxp/imx/imx6qp-sabresd.dtb \
	nxp/imx/imx6qp-sabresd-hdcp.dtb \
	nxp/imx/imx6qp-sabresd-ldo.dtb \
	\
	nxp/imx/imx6q-sabresd-btwifi.dtb \
	nxp/imx/imx6q-sabresd.dtb \
	nxp/imx/imx6q-sabresd-enetirq.dtb \
	nxp/imx/imx6q-sabresd-hdcp.dtb \
	nxp/imx/imx6q-sabresd-ldo.dtb \
	nxp/imx/imx6q-sabresd-uart.dtb \
	\
	nxp/imx/imx6dl-sabresd-btwifi.dtb \
	nxp/imx/imx6dl-sabresd.dtb \
	nxp/imx/imx6dl-sabresd-enetirq.dtb \
	nxp/imx/imx6dl-sabresd-hdcp.dtb \
	nxp/imx/imx6dl-sabresd-ldo.dtb \
"
KERNEL_DEVICETREE:use-mainline-bsp = " \
    nxp/imx/imx6qp-sabresd.dtb \
    nxp/imx/imx6q-sabresd.dtb \
    nxp/imx/imx6dl-sabresd.dtb \
"

UBOOT_CONFIG ??= " \
    sd \
    ${@oe.utils.ifelse(d.getVar('IMX_DEFAULT_BOOTLOADER') == 'u-boot-imx', \
           bb.utils.contains('MACHINE_FEATURES', 'optee', 'sd-optee', '', d), '')}"

### u-boot-fslc settings ###
SPL_BINARY:pn-u-boot-fslc = "SPL"
UBOOT_SUFFIX:pn-u-boot-fslc = "img"

### u-boot-imx settings ###
SPL_BINARY:pn-u-boot-imx = ""
UBOOT_MAKE_TARGET:pn-u-boot-imx = "u-boot.imx"
UBOOT_SUFFIX:pn-u-boot-imx = "imx"
UBOOT_MAKE_TARGET:pn-u-boot-imx-mfgtool = "u-boot.imx"
UBOOT_SUFFIX:pn-u-boot-imx-mfgtool = "imx"

UBOOT_CONFIG[sd]       = "${UBOOT_CONFIG_MACHINE_NAME}_defconfig,sdcard"
UBOOT_CONFIG[sd-optee] = "${UBOOT_CONFIG_MACHINE_NAME}_optee_defconfig,sdcard"
UBOOT_CONFIG[sata]     = "${UBOOT_CONFIG_MACHINE_NAME}_sata_defconfig"

# The u-boot-imx does not provide unified functionality for DL/Q/QP SoC
# variants. Change the defconfig to the targeted SoC variant.
UBOOT_CONFIG_MACHINE_NAME                       = "mx6sabresd"
UBOOT_CONFIG_MACHINE_NAME:pn-u-boot-imx         = "mx6qsabresd"
UBOOT_CONFIG_MACHINE_NAME:pn-u-boot-imx-mfgtool = "mx6qsabresd"

WKS_FILE = " \
    ${@bb.utils.contains('IMX_DEFAULT_BOOTLOADER', \
                         'u-boot-fslc', 'imx-uboot-spl-bootpart.wks.in', \
                                        'imx-uboot-bootpart.wks.in', d)}"

OPTEE_BIN_EXT = "6qsdb"

SERIAL_CONSOLES = "115200;ttymxc0"

MACHINE_FIRMWARE:append:mx6 = " linux-firmware-ath6k"

MACHINE_FEATURES += " pci wifi bluetooth nxp8987-sdio"
```

## conf/machine/imx6qpsabreauto.conf
```bitbake
#@TYPE: Machine
#@NAME: NXP i.MX6Q Plus SABRE Automotive
#@SOC: i.MX6QP
#@DESCRIPTION: Machine configuration for NXP i.MX6QP SABRE Automotive
#@MAINTAINER: Lauren Post <lauren.post@nxp.com>

MACHINEOVERRIDES =. "mx6:mx6q:"

require conf/machine/include/imx6sabreauto-common.inc

KERNEL_DEVICETREE = "imx6qp-sabreauto.dtb imx6qp-sabreauto-ecspi.dtb imx6qp-sabreauto-flexcan1.dtb \
                     imx6qp-sabreauto-gpmi-weim.dtb"

PREFERRED_PROVIDER_u-boot = "u-boot-imx"
PREFERRED_PROVIDER_virtual/bootloader = "u-boot-imx"
PREFERRED_PROVIDER_virtual/kernel = "linux-imx"

UBOOT_CONFIG ??= "sd"
UBOOT_CONFIG[sd] = "mx6qpsabreauto_config,sdcard"
UBOOT_CONFIG[eimnor] = "mx6qpsabreauto_eimnor_config"
UBOOT_CONFIG[nand] = "mx6qpsabreauto_nand_config,ubifs"
UBOOT_CONFIG[spinor] = "mx6qpsabreauto_spinor_config"
UBOOT_CONFIG[sata] = "mx6qpsabreauto_sata_config"
UBOOT_CONFIG[mfgtool] = "mx6qpsabreauto_config"
```

## conf/machine/imx6qpsabresd.conf
```bitbake
#@TYPE: Machine
#@NAME: NXP i.MX6Q Plus SABRE Smart Device
#@SOC: i.MX6QP
#@DESCRIPTION: Machine configuration for NXP i.MX6QP SABRE Smart Device
#@MAINTAINER: Lauren Post <lauren.post@nxp.com>

MACHINEOVERRIDES =. "mx6:mx6q:"

require conf/machine/include/imx6sabresd-common.inc

KERNEL_DEVICETREE = "imx6qp-sabresd.dtb imx6qp-sabresd-btwifi.dtb imx6qp-sabresd-hdcp.dtb \
                     imx6qp-sabresd-ldo.dtb imx6qp-sabresd-ldo-pcie-cert.dtb"

PREFERRED_PROVIDER_u-boot = "u-boot-imx"
PREFERRED_PROVIDER_virtual/bootloader = "u-boot-imx"

UBOOT_CONFIG ??= "sd"
UBOOT_CONFIG[sd] = "mx6qpsabresd_config,sdcard"
UBOOT_CONFIG[sata] = "mx6qpsabresd_sata_config"
UBOOT_CONFIG[mfgtool] = "mx6qpsabresd_config"
```

## conf/machine/imx6qsabreauto.conf
```bitbake
#@TYPE: Machine
#@NAME: NXP i.MX6Q SABRE Automotive
#@SOC: i.MX6Q
#@DESCRIPTION: Machine configuration for NXP i.MX6Q SABRE Automotive
#@MAINTAINER: Daiane Angolini <daiane.angolini@nxp.com>

MACHINEOVERRIDES =. "mx6:mx6q:"

require conf/machine/include/imx6sabreauto-common.inc

KERNEL_DEVICETREE = "imx6q-sabreauto.dtb imx6q-sabreauto-gpmi-weim.dtb imx6q-sabreauto-ecspi.dtb \
                     imx6q-sabreauto-flexcan1.dtb imx6q-sabreauto-enetirq.dtb"

UBOOT_CONFIG ??= "sd"
UBOOT_CONFIG[sd] = "mx6qsabreauto_config,sdcard"
UBOOT_CONFIG[eimnor] = "mx6qsabreauto_eimnor_config"
UBOOT_CONFIG[nand] = "mx6qsabreauto_nand_config,ubifs"
UBOOT_CONFIG[spinor] = "mx6qsabreauto_spinor_config"
UBOOT_CONFIG[sata] = "mx6qsabreauto_sata_config"
UBOOT_CONFIG[mfgtool] = "mx6qsabreauto_config"
```

## conf/machine/imx6qsabresd.conf
```bitbake
#@TYPE: Machine
#@NAME: NXP i.MX6Q SABRE Smart Device
#@SOC: i.MX6Q
#@DESCRIPTION: Machine configuration for NXP i.MX6Q SABRE Smart Device
#@MAINTAINER: Otavio Salvador <otavio@ossystems.com.br>

MACHINEOVERRIDES =. "mx6:mx6q:"

require conf/machine/include/imx6sabresd-common.inc

KERNEL_DEVICETREE = "imx6q-sabresd.dtb imx6q-sabresd-ldo.dtb imx6q-sabresd-hdcp.dtb \
                     imx6q-sabresd-enetirq.dtb imx6q-sabresd-btwifi.dtb"

UBOOT_CONFIG ??= "sd"
UBOOT_CONFIG[sd] = "mx6qsabresd_config,sdcard"
UBOOT_CONFIG[sata] = "mx6qsabresd_sata_config"
UBOOT_CONFIG[mfgtool] = "mx6qsabresd_config"
```

## conf/machine/imx6slevk.conf
```bitbake
#@TYPE: Machine
#@NAME: NXP i.MX6SL Evaluation Kit
#@SOC: i.MX6SL
#@DESCRIPTION: Machine configuration for NXP i.MX6SL Evaluation Kit
#@MAINTAINER: Otavio Salvador <otavio@ossystems.com.br>

MACHINEOVERRIDES =. "mx6sl:"

include conf/machine/include/imx-base.inc
require conf/machine/include/arm/armv7a/tune-cortexa9.inc

KERNEL_DEVICETREE = "nxp/imx/imx6sl-evk.dtb"
KERNEL_DEVICETREE:append:use-nxp-bsp = " \
    nxp/imx/imx6sl-evk-btwifi.dtb \
    nxp/imx/imx6sl-evk-csi.dtb \
    nxp/imx/imx6sl-evk-ldo.dtb \
    nxp/imx/imx6sl-evk-uart.dtb \
"

UBOOT_MAKE_TARGET = "u-boot.imx"
UBOOT_SUFFIX = "imx"

UBOOT_CONFIG ??= " \
    sd \
    ${@bb.utils.contains('MACHINE_FEATURES', 'optee', 'sd-optee', '', d)} \
"
UBOOT_CONFIG[sd]       = "mx6slevk_config,sdcard"
UBOOT_CONFIG[sd-optee] = "mx6slevk_optee_config,sdcard"
UBOOT_CONFIG[epdc]     = "mx6slevk_epdc_config"
UBOOT_CONFIG[spinor]   = "mx6slevk_spinor_config"

OPTEE_BIN_EXT = "6slevk"

SERIAL_CONSOLES = "115200;ttymxc0"

MACHINE_FEATURES += "pci wifi bluetooth bcm4339 bcm43455 nxp8987-sdio"

MACHINE_FIRMWARE += "linux-firmware-ath6k firmware-imx-epdc"
```

## conf/machine/imx6sllevk.conf
```bitbake
#@TYPE: Machine
#@NAME: NXP i.MX6SLL Evaluation Kit
#@SOC: i.MX6SLL
#@DESCRIPTION: Machine configuration for NXP i.MX6SLL EVK
#@MAINTAINER: Alexandru Palalau ioan-alexandru.palalau@nxp.com

MACHINEOVERRIDES =. "mx6sll:"

include conf/machine/include/imx-base.inc
require conf/machine/include/arm/armv7a/tune-cortexa9.inc

KERNEL_DEVICETREE = "nxp/imx/imx6sll-evk.dtb"
KERNEL_DEVICETREE:append:use-nxp-bsp = " \
    nxp/imx/imx6sll-evk-btwifi.dtb \
    nxp/imx/imx6sll-evk-reva.dtb"

UBOOT_MAKE_TARGET = "u-boot.imx"
UBOOT_SUFFIX = "imx"

UBOOT_CONFIG ??= " \
    sd \
    ${@bb.utils.contains('MACHINE_FEATURES', 'optee', 'sd-optee', '', d)} \
"
UBOOT_CONFIG[sd]       = "mx6sllevk_config,sdcard"
UBOOT_CONFIG[sd-optee] = "mx6sllevk_optee_config,sdcard"
UBOOT_CONFIG[epdc]     = "mx6sllevk_epdc_config"

OPTEE_BIN_EXT:imx6sllevk = "6sllevk"

SERIAL_CONSOLES = "115200;ttymxc0"

MACHINE_FEATURES += "wifi bluetooth bcm4339 bcm43455 nxp8987-sdio"

# MESA DRI library
XSERVER += "mesa-driver-swrast"

PREFERRED_PROVIDER_u-boot = "u-boot-fslc"
PREFERRED_PROVIDER_virtual/bootloader = "u-boot-fslc"
```

## conf/machine/imx6solosabreauto.conf
```bitbake
#@TYPE: Machine
#@NAME: NXP i.MX6Solo SABRE Automotive
#@SOC: i.MX6S
#@DESCRIPTION: Machine configuration for NXP i.MX6Solo SABRE Automotive

MACHINEOVERRIDES =. "mx6:mx6dl:"

require conf/machine/include/imx6sabresd-common.inc

KERNEL_DEVICETREE = "imx6dl-sabreauto.dtb"

PREFERRED_PROVIDER_u-boot = "u-boot-imx"
PREFERRED_PROVIDER_virtual/bootloader = "u-boot-imx"
KERNEL_IMAGETYPE = "zImage"

UBOOT_CONFIG ??= "sd"
UBOOT_CONFIG[sd] = "mx6solosabreauto_config,sdcard"
UBOOT_CONFIG[eimnor] = "mx6solosabreauto_eimnor_config"
UBOOT_CONFIG[nand] = "mx6solosabreauto_nand_config,ubifs"
UBOOT_CONFIG[spinor] = "mx6solosabreauto_spinor_config"
UBOOT_CONFIG[mfgtool] = "mx6solosabreauto_config"
```

## conf/machine/imx6solosabresd.conf
```bitbake
#@TYPE: Machine
#@NAME: NXP i.MX6Solo SABRE Smart Device
#@SOC: i.MX6S
#@DESCRIPTION: Machine configuration for NXP i.MX6Solo SABRE Smart Device
#@MAINTAINER: Otavio Salvador <otavio@ossystems.com.br>

MACHINEOVERRIDES =. "mx6:mx6dl:"

require conf/machine/include/imx6sabresd-common.inc

KERNEL_DEVICETREE = "imx6dl-sabresd.dtb imx6dl-sabresd-ldo.dtb"

PREFERRED_PROVIDER_u-boot = "u-boot-imx"
PREFERRED_PROVIDER_virtual/bootloader = "u-boot-imx"
KERNEL_IMAGETYPE = "zImage"

UBOOT_CONFIG ??= "sd"
UBOOT_CONFIG[sd] = "mx6solosabresd_config,sdcard"
UBOOT_CONFIG[mfgtool] = "mx6solosabresd_config"
```

## conf/machine/imx6sxsabreauto.conf
```bitbake
#@TYPE: Machine
#@NAME: NXP i.MX6SoloX Sabre Automotive
#@SOC: i.MX6SX
#@DESCRIPTION: Machine configuration for NXP i.MX6SoloX Sabre Automotive
#@MAINTAINER: Lauren Post <Lauren.Post@nxp.com>

MACHINEOVERRIDES =. "mx6sx:"

require conf/machine/include/imx-base.inc
require conf/machine/include/arm/armv7a/tune-cortexa9.inc

KERNEL_DEVICETREE = "nxp/imx/imx6sx-sabreauto.dtb"
KERNEL_DEVICETREE:use-mainline-bsp = "nxp/imx/imx6sx-sabreauto.dtb"

UBOOT_MAKE_TARGET = "u-boot.imx"
UBOOT_SUFFIX = "imx"

UBOOT_CONFIG ??= " \
    sd \
    ${@bb.utils.contains('MACHINE_FEATURES', 'optee', 'sd-optee', '', d)} \
"
UBOOT_CONFIG[sd]       = "mx6sxsabreauto_config,sdcard"
UBOOT_CONFIG[sd-optee] = "mx6sxsabreauto_optee_config,sdcard"
UBOOT_CONFIG[qspi1]    = "mx6sxsabreauto_qspi1_config"
UBOOT_CONFIG[nand]     = "mx6sxsabreauto_nand_config,ubifs"

OPTEE_BIN_EXT = "6sxauto"

SERIAL_CONSOLES = "115200;ttymxc3"

MACHINE_FIRMWARE:append:mx6 = " linux-firmware-ath6k"

MACHINE_FEATURES += " pci wifi bluetooth nxp8987-sdio"
```
