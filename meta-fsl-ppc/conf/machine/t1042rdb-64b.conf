## meta-fsl-ppc/conf/machine/t1042rdb-64b.conf
```bitbake
#@TYPE: Machine
#@NAME: Freescale T1042RDB
#@SOC: t1042
#@DESCRIPTION: Machine configuration for running T1042RDB in 64-bit mode
#@MAINTAINER: Chunrong Guo <B40290@freescale.com>

require e5500-64b.inc
require conf/machine/include/soc-family.inc

SOC_FAMILY = "t1042"
UBOOT_MACHINES ?= "T1042RDB_PI"
KERNEL_DEVICETREE ?= "t1042rdb_pi.dtb"
KERNEL_DEFCONFIG ?= "${S}/arch/powerpc/configs/t1040_64bit_smp_defconfig"

JFFS2_ERASEBLOCK = "0x10000"

SERIAL_CONSOLES = "115200;ttyS0 115200;ttyS1 115200;ttyEHV0"
SERIAL_CONSOLES_CHECK = "${SERIAL_CONSOLES}"
USE_VT = "0"

PREFERRED_PROVIDER_virtual/xserver ?= "xserver-xorg"
XSERVER = " \
    xserver-xorg \
    xf86-input-evdev \
    xf86-input-mouse \
    xf86-input-keyboard \
    xf86-video-fbdev \
"
```

## meta-fsl-ppc/conf/machine/t1042rdb-pi-64b.conf
```bitbake
#@TYPE: Machine
#@NAME: Freescale T1042RDB-PI
#@SOC: t1042
#@DESCRIPTION: Machine configuration for running T1042RDB-PI in 64-bit mode
#@MAINTAINER: Chunrong Guo <B40290@freescale.com>

require conf/machine/include/e5500-64b.inc

SOC_FAMILY = "t1:t1042"
UBOOT_MACHINES ?= "T1042RDB_PI"
KERNEL_DEVICETREE ?= "t1042rdb_pi.dtb"
KERNEL_DEFCONFIG ?= "${S}/arch/powerpc/configs/corenet64_fmanv3_smp_defconfig"

JFFS2_ERASEBLOCK = "0x10000"

PREFERRED_PROVIDER_virtual/xserver ?= "xserver-xorg"
XSERVER = " \
    xserver-xorg \
    xf86-input-evdev \
    xf86-input-mouse \
    xf86-input-keyboard \
    xf86-video-fbdev \
"
```

## meta-fsl-ppc/conf/machine/t1042rdb-pi.conf
```bitbake
#@TYPE: Machine
#@NAME: Freescale T1042RDB-PI
#@SOC: t1042
#@DESCRIPTION: Machine configuration for running T1042RDB-PI in 32-bit mode
#@MAINTAINER: Chunrong Guo <B40290@freescale.com>

require conf/machine/include/e5500.inc

SOC_FAMILY = "t1:t1042"
UBOOT_MACHINES ?= "T1042RDB_PI"
KERNEL_DEVICETREE ?= "t1042rdb_pi.dtb"
KERNEL_DEFCONFIG ?= "${S}/arch/powerpc/configs/t1040_32bit_smp_defconfig"

JFFS2_ERASEBLOCK = "0x10000"

PREFERRED_PROVIDER_virtual/xserver ?= "xserver-xorg"
XSERVER = " \
    xserver-xorg \
    xf86-input-evdev \
    xf86-input-mouse \
    xf86-input-keyboard \
    xf86-video-fbdev \
"
```

## meta-fsl-ppc/conf/machine/t1042rdb.conf
```bitbake
#@TYPE: Machine
#@NAME: Freescale T1042RDB
#@SOC: t1042
#@DESCRIPTION: Machine configuration for running T1042RDB in 32-bit mode
#@MAINTAINER: Chunrong Guo <B40290@freescale.com>

require conf/machine/include/e5500.inc
require conf/machine/include/soc-family.inc

SOC_FAMILY = "t1042"
UBOOT_MACHINES ?= "T1042RDB_PI"
KERNEL_DEVICETREE ?= "t1042rdb_pi.dtb"
KERNEL_DEFCONFIG ?= "${S}/arch/powerpc/configs/t1040_32bit_smp_defconfig"

JFFS2_ERASEBLOCK = "0x10000"

SERIAL_CONSOLES = "115200;ttyS0 115200;ttyS1 115200;ttyEHV0"
SERIAL_CONSOLES_CHECK = "${SERIAL_CONSOLES}"
USE_VT = "0"

PREFERRED_PROVIDER_virtual/xserver ?= "xserver-xorg"
XSERVER = " \
    xserver-xorg \
    xf86-input-evdev \
    xf86-input-mouse \
    xf86-input-keyboard \
    xf86-video-fbdev \
"
```

## meta-fsl-ppc/conf/machine/t2080qds-64b.conf
```bitbake
#@TYPE: Machine
#@DESCRIPTION: Machine configuration for running T2080QDS in 64-bit mode

require e6500-64b.inc
require conf/machine/include/soc-family.inc

SOC_FAMILY = "t2080"
# TODO: fix 32bit build of u-boot
UBOOT_MACHINES ?= "T2080QDS T2080QDS_SDCARD T2080QDS_SPIFLASH T2080QDS_NAND T2080QDS_SRIO_PCIE_BOOT"
KERNEL_DEVICETREE ?= "t2080qds.dtb t2080qds-usdpaa.dtb"
KERNEL_DEFCONFIG ?= "${S}/arch/powerpc/configs/85xx/e6500rev2_defconfig"

JFFS2_ERASEBLOCK = "0x10000"

SERIAL_CONSOLES = "115200;ttyS0 115200;ttyS1 115200;ttyEHV0"
SERIAL_CONSOLES_CHECK = "${SERIAL_CONSOLES}"
USE_VT = "0"
```

## meta-fsl-ppc/conf/machine/t2080qds.conf
```bitbake
#@TYPE: Machine
#@NAME: Freescale T2080QDS
#@SOC: t2080
#@DESCRIPTION: Machine configuration for running T2080QDS in 32-bit mode
#@MAINTAINER: Chunrong Guo <B40290@freescale.com>

require conf/machine/include/e6500.inc

SOC_FAMILY = "t2:t2080"
UBOOT_MACHINES ?= "T2080QDS T2080QDS_SDCARD T2080QDS_SPIFLASH \
    T2080QDS_NAND T2080QDS_SRIO_PCIE_BOOT T2080QDS_SECURE_BOOT \
"
KERNEL_DEVICETREE ?= "t2080qds.dtb t2080qds-usdpaa.dtb"
KERNEL_DEFCONFIG ?= "${S}/arch/powerpc/configs/85xx/e6500rev2_defconfig"

JFFS2_ERASEBLOCK = "0x10000"
```

## meta-fsl-ppc/conf/machine/t2080rdb-64b.conf
```bitbake
#@TYPE: Machine
#@NAME: Freescale T2080RDB
#@SOC: t2080
#@DESCRIPTION: Machine configuration for running T2080RDB in 64-bit mode
#@MAINTAINER: Chunrong Guo <B40290@freescale.com>

require e6500-64b.inc
require conf/machine/include/soc-family.inc

SOC_FAMILY = "t2080"
# TODO: fix 32bit build of u-boot
UBOOT_MACHINES ?= "T2080RDB T2080RDB_SDCARD T2080RDB_SPIFLASH T2080RDB_NAND T2080RDB_SRIO_PCIE_BOOT"
KERNEL_DEVICETREE ?= "t2080rdb.dtb t2080rdb-usdpaa.dtb"
KERNEL_DEFCONFIG ?= "${S}/arch/powerpc/configs/85xx/e6500rev2_defconfig"

JFFS2_ERASEBLOCK = "0x10000"

SERIAL_CONSOLES = "115200;ttyS0 115200;ttyS1 115200;ttyEHV0"
SERIAL_CONSOLES_CHECK = "${SERIAL_CONSOLES}"
USE_VT = "0"
```

## meta-fsl-ppc/conf/machine/t2080rdb.conf
```bitbake
#@TYPE: Machine
#@NAME: Freescale T2080RDB
#@SOC: t2080
#@DESCRIPTION: Machine configuration for running T2080RDB in 32-bit mode
#@MAINTAINER: Chunrong Guo <B40290@freescale.com>

require conf/machine/include/e6500.inc

SOC_FAMILY = "t2:t2080"
UBOOT_MACHINES ?= "T2080RDB T2080RDB_SDCARD T2080RDB_SPIFLASH T2080RDB_NAND T2080RDB_SRIO_PCIE_BOOT"
KERNEL_DEVICETREE ?= "t2080rdb.dtb t2080rdb-usdpaa.dtb"
KERNEL_DEFCONFIG ?= "${S}/arch/powerpc/configs/85xx/e6500rev2_defconfig"

JFFS2_ERASEBLOCK = "0x10000"
```

## meta-fsl-ppc/conf/machine/t4160qds-64b.conf
```bitbake
#@TYPE: Machine
#@NAME: Freescale T4160QDS-64B
#@SOC: t4160
#@DESCRIPTION: Machine configuration for running T4160QDS in 64-bit mode
#@MAINTAINER: Chunrong Guo <B40290@freescale.com>

require conf/machine/include/e6500-64b.inc

SOC_FAMILY = "t4:t4160"
UBOOT_MACHINES ?= "T4160QDS T4160QDS_SECURE_BOOT"
KERNEL_DEVICETREE ?= "t4240qds.dtb t4240qds-usdpaa.dtb"
KERNEL_DEFCONFIG ?= "${S}/arch/powerpc/configs/corenet64_fmanv3h_smp_defconfig"

JFFS2_ERASEBLOCK = "0x10000"
```

## meta-fsl-ppc/conf/machine/t4160qds.conf
```bitbake
#@TYPE: Machine
#@NAME: Freescale T4160QDS
#@SOC: t4160
#@DESCRIPTION: Machine configuration for running T4160QDS in 32-bit mode
#@MAINTAINER: Chunrong Guo <B40290@freescale.com>

require conf/machine/include/e6500.inc

SOC_FAMILY = "t4:t4160"
UBOOT_MACHINES ?= "T4160QDS"
KERNEL_DEVICETREE ?= "t4240qds.dtb t4240qds-usdpaa.dtb"
KERNEL_DEFCONFIG ?= "${S}/arch/powerpc/configs/85xx/e6500rev2_defconfig"

JFFS2_ERASEBLOCK = "0x10000"
```

## meta-fsl-ppc/conf/machine/t4240qds-64b.conf
```bitbake
#@TYPE: Machine
#@NAME: Freescale T4240QDS-64B
#@SOC: t4240
#@DESCRIPTION: Machine configuration for running T4240QDS in 64-bit mode
#@MAINTAINER: Chunrong Guo <B40290@freescale.com>

require conf/machine/include/e6500-64b.inc

SOC_FAMILY = "t4240"
UBOOT_MACHINES ?= "T4240QDS"
KERNEL_DEVICETREE ?= "t4240qds.dtb t4240qds-usdpaa.dtb"
KERNEL_DEFCONFIG ?= "${S}/arch/powerpc/configs/85xx/e6500rev2_defconfig"

JFFS2_ERASEBLOCK = "0x10000"
```

## meta-fsl-ppc/conf/machine/t4240qds.conf
```bitbake
#@TYPE: Machine
#@NAME: Freescale T4240QDS
#@SOC: t4240
#@DESCRIPTION: Machine configuration for running T4240QDS in 32-bit mode
#@MAINTAINER: Chunrong Guo <B40290@freescale.com>

require conf/machine/include/e6500.inc

SOC_FAMILY = "t4:t4240"
UBOOT_MACHINES ?= "T4240QDS T4240QDS_SECURE_BOOT"
KERNEL_DEVICETREE ?= "t4240qds.dtb t4240qds-usdpaa.dtb"
KERNEL_DEFCONFIG ?= "${S}/arch/powerpc/configs/85xx/e6500rev2_defconfig"

JFFS2_ERASEBLOCK = "0x10000"
```

## meta-fsl-ppc/conf/machine/t4240rdb-64b.conf
```bitbake
#@TYPE: Machine
#@NAME: Freescale T4240RDB
#@SOC: t4240
#@DESCRIPTION: Machine configuration for running T4240RDB in 64-bit mode
#@MAINTAINER: Chunrong Guo <B40290@freescale.com>

require conf/machine/include/e6500-64b.inc

SOC_FAMILY = "t4:t4240"
UBOOT_MACHINES ?= "T4240RDB"
KERNEL_DEVICETREE ?= "t4240rdb.dtb t4240rdb-usdpaa.dtb t4240rdb-usdpaa-shared-interfaces.dtb"
KERNEL_DEFCONFIG ?= "${S}/arch/powerpc/configs/85xx/e6500rev2_defconfig"

JFFS2_ERASEBLOCK = "0x10000"
```

## meta-fsl-ppc/conf/machine/t4240rdb.conf
```bitbake
#@TYPE: Machine
#@NAME: Freescale T4240RDB
#@SOC: t4240
#@DESCRIPTION: Machine configuration for running T4240RDB in 32-bit mode
#@MAINTAINER: Chunrong Guo <B40290@freescale.com>

require conf/machine/include/e6500.inc

SOC_FAMILY = "t4:t4240"
UBOOT_MACHINES ?= "T4240RDB"
KERNEL_DEVICETREE ?= "t4240rdb.dtb t4240rdb-usdpaa.dtb \
    t4240rdb-usdpaa-shared-interfaces.dtb \
"
KERNEL_DEFCONFIG ?= "${S}/arch/powerpc/configs/corenet64_fmanv3h_smp_defconfig"

JFFS2_ERASEBLOCK = "0x10000"
```

## recipes-bsp/ppa/ppa/ppa.its
```
/dts-v1/;

/{
	description = "PPA Firmware";
#address-cells = <1>;
	images {
		firmware@1 {
			description = "PPA Firmware: Version 0.1";
			data = /incbin/("obj/monitor.bin");
			type = "firmware";
			arch = "arm64";
			compression = "none";
		};
	};

	configurations {
		default = "config@1";
		config@1 {
			description = "Boot PPA firmware";
			firmware = "firmware@1";
		};
	};
};
```

## recipes-kernel/linux/linux-timesys-3.0.15/defconfig
```kconfig
CONFIG_EXPERIMENTAL=y
CONFIG_SYSVIPC=y
CONFIG_IKCONFIG=m
CONFIG_IKCONFIG_PROC=y
CONFIG_LOG_BUF_SHIFT=14
CONFIG_EMBEDDED=y
CONFIG_MODULES=y
CONFIG_MODULE_UNLOAD=y
CONFIG_MODULE_FORCE_UNLOAD=y
CONFIG_MODVERSIONS=y
CONFIG_ARCH_MXC=y
CONFIG_ARCH_MVF=y
CONFIG_MACH_MVFA5_TWR_VF700=y
CONFIG_DMA_ZONE_SIZE=16
CONFIG_ARM_ERRATA_743622=y
CONFIG_ARM_ERRATA_754322=y
CONFIG_NO_HZ=y
CONFIG_HIGH_RES_TIMERS=y
CONFIG_VMSPLIT_2G=y
CONFIG_AEABI=y
# CONFIG_OABI_COMPAT is not set
CONFIG_COMPACTION=y
CONFIG_KSM=y
CONFIG_ZBOOT_ROM_TEXT=0x0
CONFIG_ZBOOT_ROM_BSS=0x0
CONFIG_CMDLINE="root=/dev/nfs rw nfsroot=10.193.20.106:/tftpboot/10.193.20.115 ip=10.193.20.115:10.193.20.106:10.193.20.254:255.255.255.0::eth0:off console=ttymxc1,115200 mem=128M"
CONFIG_VFP=y
CONFIG_NEON=y
# CONFIG_CORE_DUMP_DEFAULT_ELF_HEADERS is not set
CONFIG_PM_RUNTIME=y
CONFIG_NET=y
CONFIG_PACKET=y
CONFIG_UNIX=y
CONFIG_INET=y
CONFIG_IP_MULTICAST=y
CONFIG_IP_PNP=y
CONFIG_IP_PNP_DHCP=y
CONFIG_IP_PNP_BOOTP=y
# CONFIG_INET_LRO is not set
# CONFIG_IPV6 is not set
CONFIG_DEVTMPFS=y
CONFIG_MTD=y
CONFIG_MTD_CMDLINE_PARTS=y
CONFIG_MTD_CHAR=y
CONFIG_MTD_BLOCK=y
CONFIG_MTD_NAND=y
CONFIG_MTD_NAND_FSL_NFC=y
CONFIG_MTD_NAND_FSL_NFC_SWECC=y
CONFIG_BLK_DEV_RAM=y
CONFIG_MISC_DEVICES=y
CONFIG_SCSI=y
CONFIG_BLK_DEV_SD=y
CONFIG_SCSI_MULTI_LUN=y
# CONFIG_SCSI_LOWLEVEL is not set
CONFIG_NETDEVICES=y
CONFIG_MICREL_PHY=y
CONFIG_NET_ETHERNET=y
# CONFIG_NETDEV_1000 is not set
# CONFIG_NETDEV_10000 is not set
CONFIG_INPUT_POLLDEV=y
CONFIG_INPUT_EVDEV=y
CONFIG_KEYBOARD_GPIO=y
# CONFIG_INPUT_MOUSE is not set
CONFIG_INPUT_TOUCHSCREEN=y
CONFIG_TOUCHSCREEN_CRTOUCH=y
CONFIG_INPUT_MISC=y
CONFIG_INPUT_UINPUT=y
# CONFIG_CONSOLE_TRANSLATIONS is not set
CONFIG_LEGACY_PTY_COUNT=4
CONFIG_SERIAL_IMX=y
CONFIG_SERIAL_IMX_CONSOLE=y
CONFIG_HW_RANDOM=y
CONFIG_I2C=y
CONFIG_I2C_CHARDEV=y
CONFIG_I2C_IMX=y
CONFIG_SPI=y
CONFIG_SPI_MVF_DSPI_EDMA=y
CONFIG_GPIO_SYSFS=y
# CONFIG_HWMON is not set
# CONFIG_MFD_SUPPORT is not set
CONFIG_MEDIA_SUPPORT=y
CONFIG_VIDEO_DEV=y
CONFIG_USB_VIDEO_CLASS=y
CONFIG_FB=y
CONFIG_FB_MVF_DCU=y
CONFIG_FRAMEBUFFER_CONSOLE=y
CONFIG_FRAMEBUFFER_CONSOLE_DETECT_PRIMARY=y
CONFIG_FRAMEBUFFER_CONSOLE_ROTATION=y
CONFIG_FONTS=y
CONFIG_FONT_8x8=y
CONFIG_FONT_8x16=y
CONFIG_LOGO=y
CONFIG_SOUND=y
# CONFIG_SOUND_OSS_CORE_PRECLAIM is not set
CONFIG_SND=y
CONFIG_SND_PCM_OSS=y
CONFIG_SND_SOC=y
CONFIG_USB=y
CONFIG_USB_EHCI_HCD=y
CONFIG_USB_EHCI_ARC=y
CONFIG_USB_EHCI_ROOT_HUB_TT=y
CONFIG_USB_STORAGE=y
CONFIG_USB_GADGET=y
CONFIG_USB_ETH=m
CONFIG_MMC=y
CONFIG_MMC_SDHCI=y
CONFIG_MMC_SDHCI_PLTFM=y
CONFIG_MMC_SDHCI_ESDHC_IMX=y
CONFIG_RTC_CLASS=y
CONFIG_RTC_DRV_SNVS=y
CONFIG_DMADEVICES=y
# CONFIG_MXC_HMP4E is not set
# CONFIG_MXC_HWEVENT is not set
CONFIG_EXT2_FS=y
CONFIG_EXT3_FS=y
# CONFIG_EXT3_DEFAULTS_TO_ORDERED is not set
CONFIG_EXT4_FS=y
CONFIG_AUTOFS4_FS=m
CONFIG_MSDOS_FS=y
CONFIG_VFAT_FS=y
CONFIG_TMPFS=y
CONFIG_TMPFS_POSIX_ACL=y
CONFIG_JFFS2_FS=y
CONFIG_CRAMFS=y
CONFIG_NFS_FS=y
CONFIG_NFS_V3=y
CONFIG_ROOT_NFS=y
CONFIG_PARTITION_ADVANCED=y
CONFIG_EFI_PARTITION=y
CONFIG_NLS_CODEPAGE_437=y
CONFIG_NLS_ASCII=m
CONFIG_NLS_ISO8859_1=y
CONFIG_NLS_UTF8=m
# CONFIG_ARM_UNWIND is not set
CONFIG_CRYPTO_TEST=m
CONFIG_CRYPTO_CBC=y
CONFIG_CRYPTO_ECB=y
CONFIG_CRYPTO_MICHAEL_MIC=y
CONFIG_CRYPTO_AES=y
CONFIG_CRYPTO_ARC4=y
CONFIG_CRYPTO_DEFLATE=y
CONFIG_CRYPTO_LZO=y
# CONFIG_CRYPTO_ANSI_CPRNG is not set
CONFIG_CRC_CCITT=m
```

## scripts/lib/image/canned-wks/imx-barebox.wks
```
# short-description: Create SD card image with a boot partition
# long-description:
# Create an image that can be written onto a SD card using dd for use
# with i.MX SoC family
# It uses barebox
#
# The disk layout used is:
#  - --------- ------------ --------- --------------
# | | barebox | bareboxenv |  /boot  |    rootfs    |
#  - --------- ------------ --------- --------------
# ^ ^         ^            ^         ^              ^
# | |         |            |         |              |
# 0 512B      512kiB       4MiB   4MiB + 8MiB    4MiB + 8Mib + rootfs + IMAGE_EXTRA_SPACE (default 10MiB)
#
part barebox --source rawcopy --sourceparams="file=barebox.bin,skip=512" --ondisk mmcblk --no-table
part bareboxenv --source rawcopy --sourceparams="file=bareboxenv.bin" --ondisk mmcblk --no-table --align 512
part /boot --source bootimg-partition --ondisk mmcblk --fstype=vfat --label boot --active --align 4096 --size 8M --extra-space 0
part / --source rootfs --ondisk mmcblk --fstype=ext4 --label root --align 4096
```

## scripts/lib/image/canned-wks/imx-uboot.wks
```
# short-description: Create SD card image with a boot partition
# long-description:
# Create an image that can be written onto a SD card using dd for use
# with i.MX SoC family
# It uses u-boot
#
# The disk layout used is:
#  - --------- --------------
# | | u-boot  |    rootfs    |
#  - --------- --------------
# ^ ^         ^              ^
# | |         |              |
# 0 1kiB    4MiB + rootfs + IMAGE_EXTRA_SPACE (default 10MiB)
#
part u-boot --source rawcopy --sourceparams="file=u-boot.imx" --ondisk mmcblk --no-table --align 1
part / --source rootfs --ondisk mmcblk --fstype=ext4 --label root --align 4096
```

## scripts/lib/wic/canned-wks/imx-barebox.wks
```
# short-description: Create SD card image with a boot partition
# long-description:
# Create an image that can be written onto a SD card using dd for use
# with i.MX SoC family
# It uses barebox
#
# The disk layout used is:
#  - --------- ------------ --------------
# | | barebox | bareboxenv |    rootfs    |
#  - --------- ------------ --------------
# ^ ^         ^            ^              ^
# | |         |            |              |
# 0 512B      512kiB     4MiB + rootfs + IMAGE_EXTRA_SPACE (default 10MiB)
#
part barebox --source rawcopy --sourceparams="file=barebox.bin,skip=512" --ondisk mmcblk --no-table
part bareboxenv --source rawcopy --sourceparams="file=bareboxenv.bin" --ondisk mmcblk --no-table --align 512
part / --source rootfs --ondisk mmcblk --fstype=ext4 --label root --align 4096
```

## scripts/lib/wic/canned-wks/imx-uboot-spl.wks
```
# short-description: Create SD card image with a boot partition
# long-description:
# Create an image that can be written onto a SD card using dd for use
# with i.MX SoC family.
# It uses SPL and u-boot
#
# The disk layout used is:
#  - ----- --------- --------------
# | | SPL | u-boot  |    rootfs    |
#  - ----- --------- --------------
# ^ ^     ^         ^              ^
# | |     |         |              |
# 0 1kiB  69kiB   4MiB + rootfs + IMAGE_EXTRA_SPACE (default 10MiB)
#
part SPL --source rawcopy --sourceparams="file=SPL" --ondisk mmcblk --no-table --align 1
part u-boot --source rawcopy --sourceparams="file=u-boot.img" --ondisk mmcblk --no-table --align 69
part / --source rootfs --ondisk mmcblk --fstype=ext4 --label root --align 4096
```
