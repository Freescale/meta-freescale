## meta-fsl-ppc/conf/machine/p1020rdb.conf
```bitbake
#@TYPE: Machine
#@DESCRIPTION: Machine configuration for running 

require e500v2.inc
require conf/machine/include/soc-family.inc

SOC_FAMILY = "p1020"
BOOTFORMAT_CONFIG = "config_ddr3_1gb_p1_p2_rdb_pc_800M.dat"
UBOOT_MACHINES ?= " P1020RDB-PC P1020RDB-PC_SPIFLASH P1020RDB-PC_NAND P1020RDB-PC_SDCARD P1020RDB-PC_36BIT P1020RDB-PC_36BIT_SPIFLASH P1020RDB-PC_36BIT_NAND P1020RDB-PC_36BIT_SDCARD"

KERNEL_DEVICETREE = "${S}/arch/powerpc/boot/dts/p1020rdb-pc_32b.dts"

KERNEL_DEFCONFIG = "${S}/arch/powerpc/configs/mpc85xx_smp_defconfig"

JFFS2_ERASEBLOCK = "0x20000"

SERIAL_CONSOLES = "115200;ttyS0 115200;ttyS1 115200;ttyEHV0"
SERIAL_CONSOLES_CHECK = "${SERIAL_CONSOLES}"
USE_VT = "0"
```

## meta-fsl-ppc/conf/machine/p1020utm.conf
```bitbake
#@TYPE: Machine
#@Name: Freescale P1020UTM
#@DESCRIPTION: Machine configuration for the Freescale P1020UTM

require e500v2.inc

BOOTFORMAT_CONFIG = "config_ddr3_1gb_p1_p2_rdb_pc_800M.dat"
UBOOT_MACHINES ?= "P1020UTM-PC P1020UTM-PC_SDCARD P1020UTM-PC_36BIT P1020UTM-PC_36BIT_SDCARD"
KERNEL_DEVICETREE = "${S}/arch/powerpc/boot/dts/p1020utm-pc_32b.dts"
KERNEL_DEFCONFIG = "${S}/arch/powerpc/configs/mpc85xx_smp_defconfig"

JFFS2_ERASEBLOCK = "0x20000"

SYSVINIT_ENABLED_GETTYS = ""
USE_VT = ""
SERIAL_CONSOLES = "115200;ttyS0 115200;ttyS1 115200;ttyEHV0"
SERIAL_CONSOLES_CHECK = "${SERIAL_CONSOLES}"
USE_VT = "0"
```

## meta-fsl-ppc/conf/machine/p1021rdb.conf
```bitbake
#@TYPE: Machine
#@Name: Freescale P1021RDB
#@SOC: p1021
#@DESCRIPTION: Machine configuration for running P1021RDB
#@MAINTAINER: Chunrong Guo <B40290@freescale.com>

require e500v2.inc
require conf/machine/include/soc-family.inc

SOC_FAMILY = "p1021"
BOOTFORMAT_CONFIG = "config_sram_p1022ds.dat"
UBOOT_MACHINES ?= "P1021RDB-PC P1021RDB-PC_NAND P1021RDB-PC_SDCARD P1021RDB-PC_SPIFLASH P1021RDB-PC_36BIT P1021RDB-PC_36BIT_SPIFLASH P1021RDB-PC_36BIT_NAND P1021RDB-PC_36BIT_SDCARD"
KERNEL_DEVICETREE ?= "p1021rdb-pc_32b.dtb"
KERNEL_DEFCONFIG ?= "${S}/arch/powerpc/configs/mpc85xx_smp_defconfig"

JFFS2_ERASEBLOCK = "0x20000"

SERIAL_CONSOLES = "115200;ttyS0 115200;ttyS1 115200;ttyEHV0"
SERIAL_CONSOLES_CHECK = "${SERIAL_CONSOLES}"
USE_VT = "0"
```

## meta-fsl-ppc/conf/machine/p1022ds.conf
```bitbake
#@TYPE: Machine
#@DESCRIPTION: Machine configuration for running 

require e500v2.inc
require conf/machine/include/soc-family.inc

SOC_FAMILY = "p1022"
BOOTFORMAT_CONFIG = "config_sram_p1022ds.dat"
UBOOT_MACHINES ?= "P1022DS P1022DS_NAND P1022DS_SPIFLASH P1022DS_SDCARD P1022DS_36BIT P1022DS_36BIT_SPIFLASH P1022DS_36BIT_NAND P1022DS_36BIT_SDCARD"
KERNEL_DEVICETREE = "p1022ds_32b.dtb"
KERNEL_DEFCONFIG = "${S}/arch/powerpc/configs/mpc85xx_smp_defconfig"

PREFERRED_PROVIDER_virtual/xserver ?= "xserver-xorg"

XSERVER = " \
	xserver-xorg \
	xf86-input-evdev \
	xf86-input-mouse \
	xf86-input-keyboard \
	xf86-video-fbdev \
"

JFFS2_ERASEBLOCK = "0x20000"

SERIAL_CONSOLES = "115200;ttyS0 115200;ttyS1 115200;ttyEHV0"
SERIAL_CONSOLES_CHECK = "${SERIAL_CONSOLES}"
USE_VT = "0"
```

## meta-fsl-ppc/conf/machine/p1023rdb.conf
```bitbake
#@TYPE: Machine
#@NAME: Freescale P1023RDB
#@SOC: p1023
#@DESCRIPTION: Machine configuration for running P1023RDB
#@MAINTAINER: Chunrong Guo <B40290@freescale.com>

require conf/machine/include/e500v2.inc

SOC_FAMILY = "p1023"
UBOOT_MACHINES ?= "P1023RDB"
KERNEL_DEVICETREE ?= "p1023rdb.dtb"
KERNEL_DEFCONFIG ?= "${S}/arch/powerpc/configs/85xx/p1023_defconfig"

JFFS2_ERASEBLOCK = "0x10000"
```

## meta-fsl-ppc/conf/machine/p1023rds.conf
```bitbake
#@TYPE: Machine
#@DESCRIPTION: Machine configuration for running 

require e500v2.inc
require conf/machine/include/soc-family.inc

SOC_FAMILY = "p1023"
UBOOT_MACHINES ?= "P1023RDS P1023RDS_NAND"
KERNEL_DEVICETREE = "${S}/arch/powerpc/boot/dts/p1023rds.dts"
KERNEL_DEFCONFIG = "${S}/arch/powerpc/configs/85xx/p1023rds_defconfig"

PREFERRED_VERSION_fmc = "0.9.23"

JFFS2_ERASEBLOCK = "0x10000"

SERIAL_CONSOLES = "115200;ttyS0 115200;ttyS1 115200;ttyEHV0"
SERIAL_CONSOLES_CHECK = "${SERIAL_CONSOLES}"
USE_VT = "0"
```

## meta-fsl-ppc/conf/machine/p1024rdb.conf
```bitbake
#@TYPE: Machine
#@Name: Freescale P1024RDB
#@DESCRIPTION: Machine configuration for the Freescale P1024RDB

require e500v2.inc

UBOOT_MACHINES = "P1024RDB"
KERNEL_DEVICETREE = "${S}/arch/powerpc/boot/dts/p1024rdb.dts"
KERNEL_DEFCONFIG = "${S}/arch/powerpc/configs/mpc85xx_smp_defconfig"
```

## meta-fsl-ppc/conf/machine/p1025rdb.conf
```bitbake
#@TYPE: Machine
#@Name: Freescale P1025RDB
#@DESCRIPTION: Machine configuration for the Freescale P1025RDB

require e500v2.inc


BOOTFORMAT_CONFIG = "config_ddr3_1gb_p1_p2_rdb_pc_667M.dat"
UBOOT_MACHINES = "P1025RDB P1025RDB_36BIT P1025RDB_NAND P1025RDB_SDCARD P1025RDB_SPIFLASH"
KERNEL_DEVICETREE = "${S}/arch/powerpc/boot/dts/p1025rdb_32b.dts"
KERNEL_DEFCONFIG = "${S}/arch/powerpc/configs/mpc85xx_smp_defconfig"

JFFS2_ERASEBLOCK = "0x20000"
```

## meta-fsl-ppc/conf/machine/p1025twr.conf
```bitbake
#@TYPE: Machine
#@Name: Freescale P1025TWR
#@SOC: p1025
#@DESCRIPTION: Machine configuration for running P1025TWR
#@MAINTAINER: Chunrong Guo <B40290@freescale.com>

require conf/machine/include/e500v2.inc

SOC_FAMILY = "p1025"
BOOTFORMAT_CONFIG = "config_ddr3_1gb_p1_p2_rdb_pc_667M.dat"
UBOOT_MACHINES ?= "TWR-P1025"
KERNEL_DEVICETREE ?= "p1025twr_32b.dtb"
KERNEL_DEFCONFIG ?= "${S}/arch/powerpc/configs/mpc85xx_smp_defconfig"

JFFS2_ERASEBLOCK = "0x20000"
```

## meta-fsl-ppc/conf/machine/p2020ds.conf
```bitbake
#@TYPE: Machine
#@NAME: Freescale P2020DS
#@SOC: p2020
#@DESCRIPTION: Machine configuration for running P2020DS
#@MAINTAINER: Chunrong Guo <B40290@freescale.com>

require conf/machine/include/e500v2.inc
require conf/machine/include/soc-family.inc

SOC_FAMILY = "p2020"
BOOTFORMAT_CONFIG = "config_sram_p2020ds.dat"
UBOOT_MACHINES ?= "P2020DS P2020DS_36BIT P2020DS_DDR2 P2020DS_SDCARD P2020DS_SPIFLASH"
KERNEL_DEVICETREE ?= "p2020ds.dtb"
KERNEL_DEFCONFIG ?= "${S}/arch/powerpc/configs/mpc85xx_smp_defconfig"

JFFS2_ERASEBLOCK = "0x20000"

SERIAL_CONSOLES = "115200;ttyS0 115200;ttyS1 115200;ttyEHV0"
SERIAL_CONSOLES_CHECK = "${SERIAL_CONSOLES}"
USE_VT = "0"
```

## meta-fsl-ppc/conf/machine/p2020rdb.conf
```bitbake
#@TYPE: Machine
#@Name: Freescale P2020RDB
#@SOC: p2020
#@DESCRIPTION: Machine configuration for running P2020RDB
#@MAINTAINER: Chunrong Guo <B40290@freescale.com>

require conf/machine/include/e500v2.inc

SOC_FAMILY = "p2020"
BOOTFORMAT_CONFIG = "config_sram_p1022ds.dat"
UBOOT_MACHINES ?= " P2020RDB-PC P2020RDB-PC_NAND P2020RDB-PC_SDCARD P2020RDB-PC_SPIFLASH P2020RDB-PC_36BIT P2020RDB-PC_36BIT_SPIFLASH P2020RDB-PC_36BIT_NAND P2020RDB-PC_36BIT_SDCARD"
KERNEL_DEVICETREE ?= "p2020rdb-pc_32b.dtb"
KERNEL_DEFCONFIG ?= "${S}/arch/powerpc/configs/mpc85xx_smp_defconfig"

JFFS2_ERASEBLOCK = "0x20000"
```

## meta-fsl-ppc/conf/machine/p2041rdb.conf
```bitbake
#@TYPE: Machine
#@NAME: Freescale P2041RDB
#@SOC: p2041
#@DESCRIPTION: Machine configuration for running P2041RDB
#@MAINTAINER: Chunrong Guo <B40290@freescale.com>

require conf/machine/include/e500mc.inc

SOC_FAMILY = "p2041"
UBOOT_MACHINES ?= "P2041RDB P2041RDB_NAND P2041RDB_SECURE_BOOT P2041RDB_SDCARD P2041RDB_SPIFLASH"
KERNEL_DEVICETREE ?= "p2041rdb.dtb p2041rdb-usdpaa.dtb"
KERNEL_DEFCONFIG ?= "${S}/arch/powerpc/configs/corenet32_smp_defconfig"

JFFS2_ERASEBLOCK = "0x10000"
```

## meta-fsl-ppc/conf/machine/p3041ds.conf
```bitbake
#@TYPE: Machine
#@NAME: Freescale P3041DS
#@SOC: p3041
#@DESCRIPTION: Machine configuration for running P3041DS
#@MAINTAINER: Chunrong Guo <B40290@freescale.com>

require conf/machine/include/e500mc.inc

SOC_FAMILY = "p3041"
UBOOT_MACHINES ?= "P3041DS P3041DS_NAND P3041DS_SECURE_BOOT \
    P3041DS_SDCARD P3041DS_SPIFLASH \
"
KERNEL_DEVICETREE ?= "p3041ds.dtb p3041ds-usdpaa.dtb \
    p3041ds-usdpaa-shared-interfaces.dtb \
"
KERNEL_DEFCONFIG ?= "${S}/arch/powerpc/configs/corenet32_smp_defconfig"

JFFS2_ERASEBLOCK = "0x10000"
```

## meta-fsl-ppc/conf/machine/p3060qds.conf
```bitbake
#@TYPE: Machine
#@DESCRIPTION: Machine configuration for running 

require e500mc.inc

UBOOT_MACHINES = "P3060QDS P3060QDS_NAND P3060QDS_SECURE_BOOT "
KERNEL_DEVICETREE = "${S}/arch/powerpc/boot/dts/p3060qds.dts \
			${S}/arch/powerpc/boot/dts/p3060qds-usdpaa.dts"
KERNEL_DEFCONFIG = "${S}/arch/powerpc/configs/corenet32_smp_defconfig"
```

## meta-fsl-ppc/conf/machine/p4080ds.conf
```bitbake
#@TYPE: Machine
#@NAME: Freescale P4080DS
#@SOC: p4080
#@DESCRIPTION: Machine configuration for running P4080DS
#@MAINTAINER: Chunrong Guo <B40290@freescale.com>

require conf/machine/include/e500mc.inc

SOC_FAMILY = "p4080"
UBOOT_MACHINES ?= "P4080DS P4080DS_SECURE_BOOT P4080DS_SDCARD P4080DS_SPIFLASH "
KERNEL_DEVICETREE ?= "p4080ds.dtb p4080ds-usdpaa.dtb"
KERNEL_DEFCONFIG ?= "${S}/arch/powerpc/configs/corenet32_smp_defconfig"

JFFS2_ERASEBLOCK = "0x10000"
```

## meta-fsl-ppc/conf/machine/p5020ds-64b.conf
```bitbake
#@TYPE: Machine
#@NAME: Freescale P5020DS-64B
#@SOC: p5020
#@DESCRIPTION: Machine configuration for running P5020DS in 64-bit mode
#@MAINTAINER: Chunrong Guo <B40290@freescale.com>

require conf/machine/include/e5500-64b.inc

SOC_FAMILY = "p5020"
UBOOT_MACHINES ?= "P5020DS P5020DS_NAND P5020DS_SECURE_BOOT \
    P5020DS_SDCARD P5020DS_SPIFLASH \
"
KERNEL_DEVICETREE ?= "p5020ds.dtb p5020ds-usdpaa.dtb \
    p5020ds-usdpaa-shared-interfaces.dtb \
"
KERNEL_DEFCONFIG ?= "${S}/arch/powerpc/configs/corenet64_smp_defconfig"

JFFS2_ERASEBLOCK = "0x10000"
```

## meta-fsl-ppc/conf/machine/p5020ds.conf
```bitbake
#@TYPE: Machine
#@NAME: Freescale P5020DS
#@SOC: p5020
#@DESCRIPTION: Machine configuration for running P5020DS in 32-bit mode
#@MAINTAINER: Chunrong Guo <B40290@freescale.com>

require conf/machine/include/e5500.inc
require conf/machine/include/soc-family.inc

SOC_FAMILY = "p5020"
UBOOT_MACHINES ?= "P5020DS P5020DS_NAND P5020DS_SECURE_BOOT P5020DS_SDCARD P5020DS_SPIFLASH "
KERNEL_DEVICETREE ?= "p5020ds.dtb p5020ds-usdpaa.dtb"
KERNEL_DEFCONFIG ?= "${S}/arch/powerpc/configs/corenet32_smp_defconfig"

JFFS2_ERASEBLOCK = "0x10000"

SERIAL_CONSOLES = "115200;ttyS0 115200;ttyS1 115200;ttyEHV0"
SERIAL_CONSOLES_CHECK = "${SERIAL_CONSOLES}"
USE_VT = "0"
```

## meta-fsl-ppc/conf/machine/p5040ds-64b.conf
```bitbake
#@TYPE: Machine
#@NAME: Freescale P5040DS-64B
#@SOC: p5040
#@DESCRIPTION: Machine configuration for running P5040DS in 64-bit mode
#@MAINTAINER: Chunrong Guo <B40290@freescale.com>

require conf/machine/include/e5500-64b.inc

SOC_FAMILY = "p5040"
UBOOT_MACHINES ?= "P5040DS  P5040DS_NAND P5040DS_SECURE_BOOT P5040DS_SDCARD P5040DS_SPIFLASH"
KERNEL_DEVICETREE ?= "p5040ds.dtb p5040ds-usdpaa.dtb"
KERNEL_DEFCONFIG ?= "${S}/arch/powerpc/configs/corenet64_smp_defconfig"

JFFS2_ERASEBLOCK = "0x10000"
```

## meta-fsl-ppc/conf/machine/p5040ds.conf
```bitbake
#@TYPE: Machine
#@DESCRIPTION: Machine configuration for running 

require e5500.inc

UBOOT_MACHINES ?= "P5040DS"
KERNEL_DEVICETREE = "${S}/arch/powerpc/boot/dts/p5040ds.dts \
	${S}/arch/powerpc/boot/dts/p5040ds-usdpaa.dts"
KERNEL_DEFCONFIG = "${S}/arch/powerpc/configs/corenet32_smp_defconfig"

JFFS2_ERASEBLOCK = "0x10000"

SYSVINIT_ENABLED_GETTYS = ""
USE_VT = ""
SERIAL_CONSOLES = "115200;ttyS0 115200;ttyS1 115200;ttyEHV0"
SERIAL_CONSOLES_CHECK = "${SERIAL_CONSOLES}"
USE_VT = "0"
```

## meta-fsl-ppc/conf/machine/t1024qds-64b.conf
```bitbake
#@TYPE: Machine
#@NAME: Freescale T1024QDS
#@SOC: t1024
#@DESCRIPTION: Machine configuration for running T1024QDS in 64-bit mode
#@MAINTAINER: Chunrong Guo <B40290@freescale.com>

require conf/machine/include/e5500-64b.inc

SOC_FAMILY = "t1:t1024"
UBOOT_MACHINES ?= "T1024QDS T1024QDS_D4 T1024QDS_NAND T1024QDS_SDCARD T1024QDS_SPIFLASH T1024QDS_SECURE_BOOT"
KERNEL_DEVICETREE ?= "t1024qds.dtb t1024qds-usdpaa.dtb t1024qds-usdpaa-capwap.dtb"
KERNEL_DEFCONFIG ?= "${S}/arch/powerpc/configs/corenet64_fmanv3_smp_defconfig"

JFFS2_ERASEBLOCK = "0x10000"
```

## meta-fsl-ppc/conf/machine/t1024rdb-64b.conf
```bitbake
#@TYPE: Machine
#@NAME: Freescale T1024RDB
#@SOC: t1024
#@DESCRIPTION: Machine configuration for running T1024RDB in 64-bit mode
#@MAINTAINER: Chunrong Guo <B40290@freescale.com>

require conf/machine/include/e5500-64b.inc

SOC_FAMILY = "t1:t1024"
UBOOT_MACHINES ?= "T1024RDB T1024RDB_NAND T1024RDB_SDCARD T1024RDB_SPIFLASH T1024RDB_SECURE_BOOT"
KERNEL_DEVICETREE ?= "t1024rdb.dtb t1024rdb-usdpaa.dtb t1024rdb-usdpaa-capwap.dtb"
KERNEL_DEFCONFIG ?= "${S}/arch/powerpc/configs/corenet64_fmanv3_smp_defconfig"

JFFS2_ERASEBLOCK = "0x10000"
```

## meta-fsl-ppc/conf/machine/t1040d4rdb-64b.conf
```bitbake
#@TYPE: Machine
#@NAME: Freescale T1040D4RDB
#@SOC: t1040
#@DESCRIPTION: Machine configuration for running T1040D4RDB in 64-bit mode
#@MAINTAINER: Chunrong Guo <B40290@freescale.com>

require conf/machine/include/e5500-64b.inc

SOC_FAMILY = "t1:t1040"
UBOOT_MACHINES ?= "T1040D4RDB T1040D4RDB_NAND T1040D4RDB_SDCARD \
    T1040D4RDB_SPIFLASH T1040D4RDB_SECURE_BOOT \
"
KERNEL_DEVICETREE ?= "t1040d4rdb.dtb t1040d4rdb-usdpaa-lag.dtb"
KERNEL_DEFCONFIG ?= "${S}/arch/powerpc/configs/corenet64_fmanv3l_smp_defconfig"

JFFS2_ERASEBLOCK = "0x10000"

QE_UCODE = "iram_Type_A_T1040_r1.0.bin"
```

## meta-fsl-ppc/conf/machine/t1040rdb-64b.conf
```bitbake
#@TYPE: Machine
#@NAME: Freescale T1040RDB
#@SOC: t1040
#@DESCRIPTION: Machine configuration for running T1040RDB in 64-bit mode
#@MAINTAINER: Chunrong Guo <B40290@freescale.com>

require conf/machine/include/e5500-64b.inc

SOC_FAMILY = "t1:t1040"
UBOOT_MACHINES ?= "T1040RDB T1040RDB_SECURE_BOOT"
KERNEL_DEVICETREE ?= "t1040rdb.dtb t1040rdb-usdpaa.dtb"
KERNEL_DEFCONFIG ?= "${S}/arch/powerpc/configs/corenet64_fmanv3_smp_defconfig"

JFFS2_ERASEBLOCK = "0x10000"
```

## meta-fsl-ppc/conf/machine/t1040rdb.conf
```bitbake
#@TYPE: Machine
#@NAME: Freescale T1040RDB
#@SOC: t1040
#@DESCRIPTION: Machine configuration for running T1040RDB in 32-bit mode
#@MAINTAINER: Chunrong Guo <B40290@freescale.com>

require conf/machine/include/e5500.inc

SOC_FAMILY = "t1:t1040"
UBOOT_MACHINES ?= "T1040RDB T1040RDB_SECURE_BOOT"
KERNEL_DEVICETREE ?= "t1040rdb.dtb t1040rdb-usdpaa.dtb"
KERNEL_DEFCONFIG ?= "${S}/arch/powerpc/configs/corenet32_fmanv3_smp_defconfig"

JFFS2_ERASEBLOCK = "0x10000"
```

## meta-fsl-ppc/conf/machine/t1042d4rdb-64b.conf
```bitbake
#@TYPE: Machine
#@NAME: Freescale T1042D4RDB
#@SOC: t1042
#@DESCRIPTION: Machine configuration for running T1042D4RDB in 64-bit mode
#@MAINTAINER: Chunrong Guo <B40290@freescale.com>

require conf/machine/include/e5500-64b.inc

SOC_FAMILY = "t1:t1042"
UBOOT_MACHINES ?= "T1042D4RDB T1042D4RDB_NAND T1042D4RDB_SDCARD \
    T1042D4RDB_SPIFLASH T1042D4RDB_SECURE_BOOT \
"
KERNEL_DEVICETREE ?= "t1042d4rdb.dtb"
KERNEL_DEFCONFIG ?= "${S}/arch/powerpc/configs/corenet64_fmanv3l_smp_defconfig"

JFFS2_ERASEBLOCK = "0x10000"

QE_UCODE = "iram_Type_A_T1040_r1.0.bin"
```
