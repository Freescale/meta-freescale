## meta-fsl-ppc/conf/machine/b4420qds-64b.conf
```bitbake
#@TYPE: Machine
#@NAME: Freescale B4420QDS-64B
#@SOC: b4420
#@DESCRIPTION: Machine configuration for running B4420QDS in 64-bit mode
#@MAINTAINER: Chunrong Guo <B40290@freescale.com>

require conf/machine/include/e6500-64b.inc

SOC_FAMILY = "b4:b4420"
UBOOT_MACHINES ?= "B4420QDS"
KERNEL_DEVICETREE ?= "b4420qds.dtb b4420qds-usdpaa.dtb"
KERNEL_DEFCONFIG ?= "${S}/arch/powerpc/configs/85xx/e6500rev2_defconfig"

JFFS2_ERASEBLOCK = "0x10000"
```

## meta-fsl-ppc/conf/machine/b4420qds.conf
```bitbake
#@TYPE: Machine
#@NAME: Freescale B4420QDS
#@SOC: b4420
#@DESCRIPTION: Machine configuration for running B4420QDS in 32-bit mode
#@MAINTAINER: Chunrong Guo <B40290@freescale.com>

require conf/machine/include/e6500.inc

SOC_FAMILY = "b4420"
UBOOT_MACHINES ?= "B4420QDS"
KERNEL_DEVICETREE ?= "b4420qds.dtb b4420qds-usdpaa.dtb"
KERNEL_DEFCONFIG ?= "${S}/arch/powerpc/configs/85xx/e6500rev2_defconfig"

JFFS2_ERASEBLOCK = "0x10000"
```

## meta-fsl-ppc/conf/machine/b4860qds-64b.conf
```bitbake
#@TYPE: Machine
#@NAME: Freescale B4860QDS-64B
#@SOC: b4860
#@DESCRIPTION: Machine configuration for running B4860QDS in 64-bit mode
#@MAINTAINER: Chunrong Guo <B40290@freescale.com>

require conf/machine/include/e6500-64b.inc

SOC_FAMILY = "b4:b4860"
UBOOT_MACHINES ?= "B4860QDS B4860QDS_SECURE_BOOT"
KERNEL_DEVICETREE ?= "b4860qds.dtb b4860qds-usdpaa.dtb"
KERNEL_DEFCONFIG ?= "${S}/arch/powerpc/configs/85xx/e6500rev2_defconfig"

JFFS2_ERASEBLOCK = "0x10000"
```

## meta-fsl-ppc/conf/machine/b4860qds.conf
```bitbake
#@TYPE: Machine
#@NAME: Freescale B4860QDS
#@SOC: b4860
#@DESCRIPTION: Machine configuration for running B4860QDS in 32-bit mode
#@MAINTAINER: Chunrong Guo <B40290@freescale.com>

require conf/machine/include/e6500.inc

SOC_FAMILY = "b4:b4860"
UBOOT_MACHINES ?= "B4860QDS"
KERNEL_DEVICETREE ?= "b4860qds.dtb b4860qds-usdpaa.dtb"
KERNEL_DEFCONFIG ?= "${S}/arch/powerpc/configs/85xx/e6500rev2_defconfig"

JFFS2_ERASEBLOCK = "0x10000"
```

## meta-fsl-ppc/conf/machine/bsc9131rdb.conf
```bitbake
#@TYPE: Machine
#@NAME: Freescale BSC9131RDB
#@SOC: bsc9131
#@DESCRIPTION: Machine configuration for running BSC9131RDB
#@MAINTAINER: Chunrong Guo <B40290@freescale.com> 

require conf/machine/include/e500v2.inc

SOC_FAMILY = "bsc9131"
UBOOT_MACHINES ?= "BSC9131RDB_SPIFLASH BSC9131RDB_NAND BSC9131RDB_NAND_SYSCLK100 BSC9131RDB_SPIFLASH_SYSCLK100"
KERNEL_DEVICETREE ?= "bsc9131rdb.dtb"
KERNEL_DEFCONFIG ?= "${S}/arch/powerpc/configs/85xx/bsc913x_defconfig"

JFFS2_ERASEBLOCK = "0x10000"
```

## meta-fsl-ppc/conf/machine/bsc9132qds.conf
```bitbake
#@TYPE: Machine
#@NAME: Freescale BSC9132QDS
#@SOC: bsc9132
#@DESCRIPTION: Machine configuration for running BSC9132QDS
#@MAINTAINER: Chunrong Guo <B40290@freescale.com>

require conf/machine/include/e500v2.inc

SOC_FAMILY = "bsc9132"
UBOOT_MACHINES ?= " BSC9132QDS_NAND_DDRCLK133 BSC9132QDS_NAND_DDRCLK100 BSC9132QDS_NOR_DDRCLK100 BSC9132QDS_NOR_DDRCLK133 BSC9132QDS_SDCARD_DDRCLK100 BSC9132QDS_SDCARD_DDRCLK133 BSC9132QDS_SPIFLASH_DDRCLK100 BSC9132QDS_SPIFLASH_DDRCLK133"
KERNEL_DEVICETREE ?= "bsc9132qds.dtb"
KERNEL_DEFCONFIG ?= "${S}/arch/powerpc/configs/85xx/bsc913x_smp_defconfig"

JFFS2_ERASEBLOCK = "0x10000"
```

## meta-fsl-ppc/conf/machine/c293pcie.conf
```bitbake
#@TYPE: Machine
#@NAME: Freescale C293PCIE
#@SOC: c293pcie
#@DESCRIPTION: Machine configuration for running C293PCIE in 36-bit mode
#@MAINTAINER: Chunrong Guo <B40290@freescale.com>

require conf/machine/include/e500v2.inc

SOC_FAMILY = "c293pcie"
BOOTFORMAT_CONFIG = "config_ddr3_512m_c29xpcie_800M.dat"
UBOOT_MACHINES ?= "C29XPCIE C29XPCIE_SPIFLASH C29XPCIE_SECBOOT C29XPCIE_SPIFLASH_SECBOOT"
KERNEL_DEVICETREE ?= "c293pcie_36b.dtb"
KERNEL_DEFCONFIG ?= "${S}/arch/powerpc/configs/mpc85xx_defconfig"

JFFS2_ERASEBLOCK = "0x10000"
```

## meta-fsl-ppc/conf/machine/e500mc.inc
```bitbake
TARGET_FPU = "hard"

require conf/machine/include/tune-ppce500mc.inc

MACHINE_FEATURES = "kernel26 keyboard pci ext2 ext3 serial"
MACHINE_FEATURES_RRECOMMENDS = ""

PREFERRED_PROVIDER_virtual/kernel ?= "linux-qoriq-sdk"
PREFERRED_VERSION_virtual/kernel ?= "3.0.34"
PREFERRED_PROVIDER_linux-libc-headers ?= "linux-qoriq-sdk-headers"

KERNEL_IMAGETYPE ?= "uImage"
# disable the images below for now
#		ext2.bz2 ext2.lzma \
#		ext2.gz.u-boot ext2.bz2.u-boot ext2.lzma.u-boot"

MACHINEOVERRIDES .= ":e500mc:fslmachine"
```

## meta-fsl-ppc/conf/machine/e500v2.inc
```bitbake
require conf/machine/include/tune-ppce500v2.inc

MACHINE_FEATURES = "kernel26 pci ext2 ext3 serial"
MACHINE_EXTRA_RRECOMMENDS = "u-boot udev-extraconf"

# FIXME
# Workaround for ICE of gcc-4.8.x when passing -mfloat-gprs=double
# Bug: http://gcc.gnu.org/bugzilla/show_bug.cgi?id=57717#c1
# Replace double-float with single-float, revert the commit when above bug is fixed
TUNE_CCARGS := "${@d.getVar('TUNE_CCARGS', True).replace('-mfloat-gprs=double', '-mfloat-gprs=single')}"

PREFERRED_PROVIDER_virtual/kernel ?= "linux-qoriq-sdk"
PREFERRED_VERSION_virtual/kernel ?= "3.0.34"
PREFERRED_PROVIDER_linux-libc-headers ?= "linux-qoriq-sdk-headers"
PREFERRED_VERSION_qemu = "1.4+fsl"

KERNEL_IMAGETYPE ?= "uImage"
# disable the images below for now
#		ext2.bz2 ext2.lzma \
#		ext2.gz.u-boot ext2.bz2.u-boot ext2.lzma.u-boot"

MACHINEOVERRIDES .= ":e500v2:fslmachine"
```

## meta-fsl-ppc/conf/machine/e5500-64b.inc
```bitbake
TARGET_FPU = "hard"

DEFAULTTUNE ?= "ppc64e5500"
require conf/machine/include/tune-ppce5500.inc

MACHINE_FEATURES = "kernel26 keyboard pci ext2 ext3 serial"
MACHINE_EXTRA_RRECOMMENDS = "u-boot"

PREFERRED_PROVIDER_virtual/kernel ?= "linux-qoriq-sdk"
PREFERRED_VERSION_virtual/kernel ?= "3.0.34"
PREFERRED_PROVIDER_linux-libc-headers ?= "linux-qoriq-sdk-headers"
PREFERRED_VERSION_qemu = "1.0+fsl"
PREFERRED_VERSION_oprofile = "0.9.6"

KERNEL_IMAGETYPE ?= "uImage"
# disable the images below for now
#		ext2.bz2 ext2.lzma \
#		ext2.gz.u-boot ext2.bz2.u-boot ext2.lzma.u-boot"

MACHINEOVERRIDES .= ":e5500-64b:fslmachine"
```

## meta-fsl-ppc/conf/machine/include/e500mc.inc
```bitbake
TARGET_FPU = "hard"

require conf/machine/include/tune-ppce500mc.inc
require conf/machine/include/qoriq-base.inc

MACHINEOVERRIDES .= ":e500mc"
```

## meta-fsl-ppc/conf/machine/include/e500v2.inc
```bitbake
require conf/machine/include/tune-ppce500v2.inc
require conf/machine/include/qoriq-base.inc

MACHINEOVERRIDES .= ":e500v2:fslmachine"
```

## meta-fsl-ppc/conf/machine/include/e5500-64b.inc
```bitbake
TARGET_FPU = "hard"
DEFAULTTUNE ?= "ppc64e5500"

require conf/machine/include/tune-ppce5500.inc
require conf/machine/include/qoriq-base.inc

MACHINEOVERRIDES .= ":e5500-64b:fslmachine"
```

## meta-fsl-ppc/conf/machine/include/e6500-64b.inc
```bitbake
TARGET_FPU = "hard"
DEFAULTTUNE ?= "ppc64e6500"

require conf/machine/include/tune-ppce6500.inc
require conf/machine/include/qoriq-base.inc

MACHINEOVERRIDES .= ":e6500-64b"
```

## meta-fsl-ppc/conf/machine/include/e6500.inc
```bitbake
TARGET_FPU = "hard"

require conf/machine/include/tune-ppce6500.inc
require conf/machine/include/qoriq-base.inc

MACHINEOVERRIDES .= ":e6500"

BUILD_64BIT_KERNEL = "1"
```

## meta-fsl-ppc/conf/machine/include/qoriq-base.inc
```bitbake
# Provides the QorIQ common settings

require conf/machine/include/qoriq-default-settings.inc
require conf/machine/include/qoriq-default-versions.inc
require conf/machine/include/qoriq-default-providers.inc

require conf/machine/include/soc-family.inc
```

## meta-fsl-ppc/conf/machine/include/qoriq-default-settings.inc
```bitbake
MACHINE_FEATURES = "keyboard pci ext2 ext3 serial"
MACHINE_EXTRA_RRECOMMENDS += "udev-extraconf kernel-modules"

IMAGE_CLASSES += "image_types_uboot"
EXTRA_IMAGEDEPENDS += "u-boot"

KERNEL_IMAGETYPE ?= "uImage"
# disable the images below for now
#       ext2.bz2 ext2.lzma \
#       ext2.gz.u-boot ext2.bz2.u-boot ext2.lzma.u-boot"

MACHINEOVERRIDES .= ":qoriq-ppc"

SERIAL_CONSOLES ?= "115200;ttyS0 115200;ttyS1 115200;ttyEHV0"
SERIAL_CONSOLES_CHECK ?= "${SERIAL_CONSOLES}"

USE_VT = "0"

MKUBIFS_ARGS ??= "-m 512 -e 15360 -c 3600"
UBINIZE_ARGS ??= "-m 512 -p 16KiB -s 512"
```

## meta-fsl-ppc/conf/machine/mpc8536ds.conf
```bitbake
#@TYPE: Machine
#@Name: Freescale MPC8536DS
#@DESCRIPTION: Machine configuration for the Freescale MPC8536DS

require e500v2.inc
require conf/machine/include/soc-family.inc

SOC_FAMILY = "mpc8536"
BOOTFORMAT_CONFIG = "config_ddr2_512m_mpc8536ds_667M.dat"
UBOOT_MACHINES ?= "MPC8536DS MPC8536DS_36BIT MPC8536DS_NAND MPC8536DS_SDCARD MPC8536DS_SPIFLASH"
KERNEL_DEVICETREE = "${S}/arch/powerpc/boot/dts/mpc8536ds.dts \
                    ${S}/arch/powerpc/boot/dts/mpc8536ds_36b.dts"
KERNEL_DEFCONFIG = "${S}/arch/powerpc/configs/mpc85xx_defconfig"

JFFS2_ERASEBLOCK = "0x20000"

SERIAL_CONSOLES = "115200;ttyS0 115200;ttyS1 115200;ttyEHV0"
SERIAL_CONSOLES_CHECK = "${SERIAL_CONSOLES}"
USE_VT = "0"
```

## meta-fsl-ppc/conf/machine/mpc8544ds.conf
```bitbake
#@TYPE: Machine
#@Name: Freescale MPC8544DS
#@DESCRIPTION: Machine configuration for the Freescale MPC8544DS

require e500v2.inc
require conf/machine/include/soc-family.inc

SOC_FAMILY = "mpc8544"
UBOOT_MACHINES ?= "MPC8544DS"
KERNEL_DEVICETREE = "${S}/arch/powerpc/boot/dts/mpc8544ds.dts"
KERNEL_DEFCONFIG = "${S}/arch/powerpc/configs/mpc85xx_defconfig"

JFFS2_ERASEBLOCK = "0x20000"

SYSVINIT_ENABLED_GETTYS = ""
USE_VT = ""
SERIAL_CONSOLES = "115200;ttyS0 115200;ttyS1 115200;ttyEHV0"
SERIAL_CONSOLES_CHECK = "${SERIAL_CONSOLES}"
USE_VT = "0"
```

## meta-fsl-ppc/conf/machine/mpc8548cds.conf
```bitbake
#@TYPE: Machine
#@Name: Freescale MPC8548CDS
#@DESCRIPTION: Machine configuration for the Freescale MPC8548CDS

require e500v2.inc
require conf/machine/include/soc-family.inc

SOC_FAMILY = "mpc8548"
UBOOT_MACHINES ?= "MPC8548CDS MPC8548CDS_36BIT"
KERNEL_DEVICETREE = "${S}/arch/powerpc/boot/dts/mpc8548cds_32b.dts \
                    ${S}/arch/powerpc/boot/dts/mpc8548cds_36b.dts"
KERNEL_DEFCONFIG = "${S}/arch/powerpc/configs/mpc85xx_defconfig"

JFFS2_ERASEBLOCK = "0x20000"

SYSVINIT_ENABLED_GETTYS = ""
USE_VT = ""
SERIAL_CONSOLES = "115200;ttyS0 115200;ttyS1 115200;ttyEHV0"
SERIAL_CONSOLES_CHECK = "${SERIAL_CONSOLES}"
USE_VT = "0"
```

## meta-fsl-ppc/conf/machine/mpc8572ds.conf
```bitbake
#@TYPE: Machine
#@DESCRIPTION: Machine configuration for running 

require e500v2.inc
require conf/machine/include/soc-family.inc

SOC_FAMILY = "mpc8572"
UBOOT_MACHINES ?= "MPC8572DS MPC8572DS_36BIT MPC8572DS_NAND"
KERNEL_DEVICETREE = "${S}/arch/powerpc/boot/dts/mpc8572ds.dts \
                    ${S}/arch/powerpc/boot/dts/mpc8572ds_36b.dts"
KERNEL_DEFCONFIG = "${S}/arch/powerpc/configs/mpc85xx_smp_defconfig"

JFFS2_ERASEBLOCK = "0x20000"

SYSVINIT_ENABLED_GETTYS = ""
USE_VT = ""
SERIAL_CONSOLES = "115200;ttyS0 115200;ttyS1 115200;ttyEHV0"
SERIAL_CONSOLES_CHECK = "${SERIAL_CONSOLES}"
USE_VT = "0"
```

## meta-fsl-ppc/conf/machine/p1010rdb.conf
```bitbake
#@TYPE: Machine
#@Name: Freescale P1010RDB
#@SOC: p1010
#@DESCRIPTION: Machine configuration for running P1010RDB
#@MAINTAINER: Chunrong Guo <B40290@freescale.com>

require conf/machine/include/e500v2.inc

SOC_FAMILY = "p1010"
BOOTFORMAT_CONFIG = "config_sram_p1010rdb.dat"
UBOOT_MACHINES ?= "P1010RDB-PB_NAND P1010RDB-PB_NOR \
    P1010RDB-PB_SPIFLASH P1010RDB-PB_36BIT_NOR P1010RDB-PB_36BIT_NAND \
    P1010RDB-PB_36BIT_SPIFLASH"
KERNEL_DEVICETREE ?= "p1010rdb-pa.dtb p1010rdb-pb.dtb"
KERNEL_DEFCONFIG ?= "${S}/arch/powerpc/configs/mpc85xx_defconfig"

JFFS2_ERASEBLOCK = "0x20000"
```

## meta-fsl-ppc/conf/machine/p1020mbg.conf
```bitbake
#@TYPE: Machine
#@Name: Freescale P1020MBG
#@DESCRIPTION: Machine configuration for the Freescale P1020MBG

require e500v2.inc
require conf/machine/include/soc-family.inc

SOC_FAMILY = "p1020"
BOOTFORMAT_CONFIG = "config_ddr3_1gb_p1_p2_rdb_pc_800M.dat"
UBOOT_MACHINES ?= "P1020MBG-PC P1020MBG-PC_SDCARD P1020MBG-PC_36BIT P1020MBG-PC_36BIT_SDCARD"
KERNEL_DEVICETREE = "${S}/arch/powerpc/boot/dts/p1020mbg-pc_32b.dts"
KERNEL_DEFCONFIG = "${S}/arch/powerpc/configs/mpc85xx_smp_defconfig"

JFFS2_ERASEBLOCK = "0x20000"

SERIAL_CONSOLES = "115200;ttyS0 115200;ttyS1 115200;ttyEHV0"
SERIAL_CONSOLES_CHECK = "${SERIAL_CONSOLES}"
USE_VT = "0"
```
